AUTOSAR XML (schema 4-2-2)
package /ArcCore/EcucDefs/Generic
  module definition BswM [0..1]: refined-module-def=BswM, variants link-time/pre-compile/post-build  # Configuration of the BswM (Basic SW Mode Manager) module.
    container BswMConfig  # This container contains the configuration parameters and sub containers of the AUTOSAR BswM module. This container is a MultipleConfigurationContainer, i.e. this container and its sub-containers exist once per configuration set.
      container BswMArbitration  # This container includes all configuration sub-containers and parameters related to the mode arbitration functionality of the BswM.
        integer ArcBswMMaxRuleCount: 0.., set at pre-compile, origin=ARCCORE_ECUC, default-value=20  # If implementationConfigVariant is VARIANT_POST_BUILD (i.e; Post Build configuration), this defines the maximum number of rules that can be configured If implementationConfigVariant is VARIANT_PRE_COMPILE(i.e; Pre Compile configuration) this parameter becomes dummy, The maximum number of rules is obtained from parameter BswMConfig->BswMArbitration->BswMRules
        container BswMLogicalExpression [0..*]  # This container describes the logical expressions that can be used for the mode arbitration. The logical expressions are built of a set of arguments and a logical operator. | Each argument can either be a mode condition or a sub-expression to allow definition of more complex logical expressions. There may be an unlimited number of arguments in each logical expression. Note that the order of evaluation of the expressions is not defined.
          enumeration BswMLogicalOperator [0..1]: {BSWM_AND, BSWM_NAND, BSWM_OR, BSWM_XOR}, set at link in variant link-time / pre-compile in variant pre-compile+post-build  # This parameter specifies the logical operator to be used in the logical expression. If the expression only consists of a single condition this parameter shall not be used.
          choice reference BswMArgumentRef [1..*]: set at link in variant link-time / pre-compile in variant pre-compile+post-build, destination=[BswMLogicalExpression, BswMModeCondition]  # This is a choice reference either to a mode condition or a sub-expression. | In case the BswMLogicalExpression.BswMLogicalOperator equals BSWM_NAND only two operands are supported.
        container BswMModeCondition [0..*]  # This container describes the BswM mode conditions that can be used either by itself to form a rule or as a part of a logical expression.
          enumeration BswMConditionType: {BSWM_EQUALS, BSWM_EQUALS_NOT}, set at link in variant link-time / pre-compile in variant pre-compile+post-build  # This parameter specifies what kind of comparison that is made for the evaluation of the mode condition.
          reference BswMConditionMode: set at link in variant link-time / pre-compile in variant pre-compile+post-build, destination=BswMModeRequestPort  # This parameter references the mode request port that is used for the condition.
          choice container BswMConditionValue [0..1]  # This container holds the parameters and references necessary to identify the mode type and the value that the mode request is compared to.
            container BswMBswMode [0..1]  # This container defines the value and type of a mode in the BSW.
              string BswMBswRequestedMode: set at link in variant link-time / pre-compile in variant pre-compile+post-build  # This parameter contains the symbolic name (as a string) of a certain mode/state that can be requested/indicated by the BSW modules.
            container BswMModeDeclaration [0..1]  # When the mode corresponds to a mode request or mode indication interface the mode is defined by a mode declaration. The mode declarations are defined in the SW-C Template and hence a foreign reference to the corresponding Mode Declaration is used.
              foreign reference BswMModeValueRef: set at link in variant link-time / pre-compile in variant pre-compile+post-build, destination-type=MODE-DECLARATION  # This is a foreign reference to the Mode Declaration used for the mode requests corresponding to this condition.
        container BswMModeRequestPort [0..*]  # Each instance of this container defines a mode request interface that is used to requests or indicate modes from/to the BswM. These interfaces are implemented as ports or as ordinary C-functions based upon if the request is made by an SW-C or a BSW module. | There are different types of mode requests: 1. Mode requests from the SW-C:s 2. Mode Requests from other BSW modules such as the DCM. 3. State/mode indications from the RTE or other BSW modules such as the bus specific State Managers. Note that the BswM treats all request and indications in the exact same way.
          enumeration BswMRequestProcessing: {BSWM_DEFERRED, BSWM_IMMEDIATE}, set at link in variant link-time / pre-compile in variant pre-compile / post-build in variant post-build, post-build-variant-value=true  # This parameter defines if the processing of the mode arbitration shall be done immediately when a mode request is received or if it shall be deferred to the processing of the main function of BswM.
          choice container BswMModeInitValue [0..1]: post-build-changeable=true, post-build-variant-multiplicity=true  # This container defines the initial mode value that is used by BswM for the corresponding mode request after initialization. This container is optional and shall only be used for Mode Requests that do not already have an initial value. | If this container is not present the requested mode is undefined after initialization of BswM. The requested mode will remain undefined until the requester performs a request.
            container BswMBswModeInitValue [0..1]: post-build-changeable=true, post-build-variant-multiplicity=true  # This is the choice for a initial mode value used for the initialization of mode requests in case the request is made by a BSW module.
              string BswMBswModeInitValueMode: set at link in variant link-time / pre-compile in variant pre-compile / post-build in variant post-build, post-build-variant-multiplicity=true, post-build-variant-value=true  # This parameter defines the initial mode value that is used by BswM for the corresponding mode request after initialization.
            container BswMSwcModeInitValue [0..1]: post-build-changeable=true, post-build-variant-multiplicity=true  # This is the choice for a foreign reference to the Mode Declaration used for the initialization of mode requests in case the request is made by a SW-C.
              foreign reference BswMSwcModeInitValueRef: set at link in variant link-time / pre-compile in variant pre-compile / post-build in variant post-build, post-build-variant-multiplicity=true, post-build-variant-value=true, destination-type=MODE-DECLARATION  # This is a foreign reference to the Mode Declaration used for the initialization of mode requests.
          choice container BswMModeRequestSource  # This choice container specifies the source of the mode request or state/mode indication. The requester of a mode can be both SW-C:s and other BSW Modules, such as the bus specific State Managers.
            container BswMBswModeNotification [0..1]  # The source of the mode request is a Bsw Module. | If the BswMRequestProcessing of this BswMModeRequestPort is set to BSWM_IMMEDIATE then it is assumed that the Basic Software Module Description of the BswM contains a BswSchedulableEntity which is activated by a BswModeSwitchEvent. This BswModeSwitchEvent shall refer to the ModeDeclarationGroupPrototype which is referenced by BswMBswModeDeclarationGroupPrototypeRef. If the BswMRequestProcessing of this BswMModeRequestPort is set to BSWM_DEFERRED then it is up to the implementer of the BswM tooling whether a BswSchedulableEntity is used to update the BswM internal mode mirror or whether the BswM internal mode mirror is updated during the main function execution.
              foreign reference BswMBswModeDeclarationGroupPrototypeRef: set at link in variant link-time / pre-compile in variant pre-compile+post-build, destination-type=MODE-DECLARATION-GROUP-PROTOTYPE  # This is a foreign reference to the Mode Declaration Group Prototype.
            container BswMCanSMIndication [0..1]  # This is an indication of the current state of the CAN State Manager.
              symbolic name reference BswMCanSMChannelRef: set at link in variant link-time / pre-compile in variant pre-compile+post-build, destination=ComMChannel  # This is a reference to the CAN channel handle that the mode request corresponds to.
            container BswMComMIndication [0..1]  # This is an indication of the current communication mode of a channel in the Communication Manager.
              symbolic name reference BswMComMChannelRef: set at link in variant link-time / pre-compile in variant pre-compile+post-build, destination=ComMChannel  # This is a reference to the Communication Manager channel handle that the indication corresponds to.
            container BswMComMPncRequest [0..1]  # This is a request of the current communication mode of a Partial Network Cluster in the Communication Manager.
              symbolic name reference BswMComMPncRef: set at link in variant link-time / pre-compile in variant pre-compile+post-build, destination=ComMPnc  # This is a reference to the Communication Manager PNC handle of the Partial Network Cluster that the request corresponds to.
            container BswMDcmApplicationUpdatedIndication [0..1]  # This is a request to update application data from the DCM. This container does not contain any parameters since there are no further configuration needed for this type of request.
            container BswMDcmComModeRequest [0..1]  # The source of the mode request is the Diagnostic Communication Manager.
              string BswMDcmComMNetwork: set at link in variant link-time / pre-compile in variant pre-compile+post-build  # This parameter specifies the network the request relates to.
            container BswMEcuMIndication [0..1]  # This is a notification of the current operation mode of the ECU State Manager. This container does not contain any parameters since there are no further configuration needed for this type of request.
            container BswMEcuMWakeupSource [0..1]  # This is a notification of the current state of an ECU State Manager wakeup source.
              symbolic name reference BswMEcuMWakeupSrcRef: set at link in variant link-time / pre-compile in variant pre-compile+post-build, destination=EcuMWakeupSource  # This is a reference to the ECU State Manager Wakeup Source that the indication corresponds to.
            container BswMEthSMIndication [0..1]  # This is an indication of the current state of the Ethernet State Manager.
              symbolic name reference BswMEthSMChannelRef: set at link in variant link-time / pre-compile in variant pre-compile+post-build, destination=ComMChannel  # This is a reference to the Ethernet channel handle that the mode request corresponds to.
            container BswMFrSMIndication [0..1]  # This is an indication of the current state of the FlexRay State Manager.
              symbolic name reference BswMFrSMChannelRef: set at link in variant link-time / pre-compile in variant pre-compile+post-build, destination=ComMChannel  # This is a reference to the FlexRay Cluster handle that the mode request corresponds to.
            container BswMGenericRequest [0..1]  # This mode request originates from a requester that is not among the list of standardized mode requesters (i.e. the different resource managers).
              integer BswMModeRequesterId: 0..65535, set at link in variant link-time / pre-compile in variant pre-compile+post-build  # This parameters identifies the different users of the generic mode request interface.
              integer BswMRequestedModeMax: 0..65535, set at link in variant link-time / pre-compile in variant pre-compile+post-build  # This parameter defines the upper limit for the modes requested by this mode requester.
            container BswMLinSMIndication [0..1]  # This is an indication of the current state of the LIN State Manager.
              symbolic name reference BswMLinSMChannelRef: set at link in variant link-time / pre-compile in variant pre-compile+post-build, destination=ComMChannel  # This is a reference to the LIN channel handle that the mode request corresponds to.
            container BswMLinScheduleIndication [0..1]  # This is an indication of the currently active LIN Schedule Table for a specific LIN Interface.
              symbolic name reference BswMLinScheduleRef: set at link in variant link-time / pre-compile in variant pre-compile+post-build, destination=LinSMSchedule  # This is a reference to the LIN Schedule Table handle that the mode request corresponds to.
            container BswMLinTpModeRequest [0..1]  # This is a LinTp mode request from the LinIf. This port corresponds to a call of the BswM_LinTp_RequestMode API.
              symbolic name reference BswMLinTpChannelRef: set at link in variant link-time / pre-compile in variant pre-compile+post-build, destination=LinIfChannel  # This is a reference to the LIN Interface Channel that the mode | request corresponds to.
            container BswMNvMJobModeIndication [0..1]  # Indicates the current status of the multiblock job. The job is identified via BswMNvmService, e.g. 0x0c for NvmReadAll, 0x0d for NvmWriteAll. Possible Values are: | NvM_RequestResultType NVM_REQ_OK NVM_REQ_NOT_OK NVM_REQ_PENDING NVM_REQ_INTEGRITY_FAILED NVM_REQ_BLOCK_SKIPPED NVM_REQ_NV_INVALIDATED NVM_REQ_CANCELED NVM_REQ_REDUNDANCY_FAILED NVM_REQ_RESTORED_FROM_ROM
              enumeration BswMNvmService: {NvmReadAll, NvmWriteAll}  # Identifies the Nvm job which is related to the mode request.
            container BswMNvMRequest [0..1]  # Via this Mode Request Source the NvM indicates the current status of the specified block. Possible Values are: | NvM_RequestResultType NVM_REQ_OK NVM_REQ_NOT_OK NVM_REQ_PENDING NVM_REQ_INTEGRITY_FAILED NVM_REQ_BLOCK_SKIPPED NVM_REQ_NV_INVALIDATED NVM_REQ_CANCELED NVM_REQ_REDUNDANCY_FAILED NVM_REQ_RESTORED_FROM_ROM
              symbolic name reference BswMNvMBlockRef: set at link in variant link-time / pre-compile in variant pre-compile+post-build, destination=NvMBlockDescriptor  # This is a reference to the NvM Block Descriptor that the request corresponds to.
            container BswMSwcModeNotification [0..1]  # This is a mode switch notification associated with a RTE switch interface.
              foreign reference BswMSwcModeNotificationModeDeclarationGroupPrototypeRef: set at link in variant link-time / pre-compile in variant pre-compile+post-build, destination-type=MODE-DECLARATION-GROUP-PROTOTYPE  # This is a foreign reference to the ModeDeclarationGroupPrototype.
            container BswMSwcModeRequest [0..1]  # The source of the mode request is a SW Component.
              foreign reference BswMSwcModeRequestModeDeclarationGroupPrototypeRef: set at link in variant link-time / pre-compile in variant pre-compile+post-build, destination-type=MODE-DECLARATION-GROUP-PROTOTYPE  # This is a foreign reference to the ModeDeclarationGroupPrototype. As the mode request is SR-Communication the BswM shall provide a SR-Interface which corresponds to the ModeDeclarationGroupPrototype. | The SR-Interface shall contain one ApplicationPrimitiveDataType which is defined as an enumeration (compuMethod) with the enumeration literals matching the ModeDeclarations.
            container BswMWdgMRequestPartitionReset [0..1]  # This is a Partition Reset request from from the WdgM. This port | corresponds to a call of the BswM_WdgM_RequestPartitionReset API.
              reference BswMWdgMRequestPartitionResetRef: set at link in variant link-time / pre-compile in variant pre-compile+post-build, destination=EcucPartition  # This is a reference to the partition that shall be reset.
            container BswMSdClientServiceCurrentState [0..1]  # Used by Service Discovery module to indicate current state of the Client Service (available/down).
              symbolic name reference BswMSdClientMethodsRef: set at pre-compile, destination=SdClientService  # This is a reference to a client service in the Sd module.
            container BswMSdConsumedEventGroupCurrentState [0..1]  # Used by Service Discovery to indicate current status of the EventHandler (requested/released).
              symbolic name reference BswMSdConsumedEventGroupRef: set at pre-compile, destination=SdConsumedEventGroup  # This is a reference to an eventGroup that is defined within a client service in the Sd module.
            container BswMSdEventHandlerCurrentState [0..1]  # Used by Service Discovery to indicate current status of the EventHandler (requested/released).
              symbolic name reference BswMSdEventHandlerRef: set at pre-compile, destination=SdEventHandler  # This is a reference to an event handler that is defined within a server service in the Sd module.
        container BswMRule [0..*]: post-build-changeable=true, post-build-variant-multiplicity=true  # Each instance of this container describes a BswM arbitration rule. The rule either consists of a simple mode condition or a more complex logical expression. This container also references the action lists that shall be invoked when the rule is evaluated to True or False.
          boolean BswMNestedExecutionOnly: set at link in variant link-time / pre-compile in variant pre-compile / post-build in variant post-build, post-build-variant-value=true, default-value=false  # This parameter defines for its related Rule if the Rule is an Independent rule or a Subordinate rule; | false: an Independent rule, i.e. to be evaluated each time applicable (both as standalone Rule driven by its own BswMModeRequestSource and when referenced by another Rule). true: a Subordinated rule, to be evaluated ONLY as a result of being referenced in one or more Action Lists.
          enumeration BswMRuleInitState: {BSWM_FALSE, BSWM_TRUE, BSWM_UNDEFINED}, set at link in variant link-time / pre-compile in variant pre-compile / post-build in variant post-build, post-build-variant-value=true  # This parameter is a part of the reset/initialization behavior of BswM. | Action lists are executed when the result of a rule evaluation have changed since the last evaluation. This parameter defines the "previous evaluation result" of a rule to be used after initialization of the BswM. If this parameter is set to BSWM_UNDEFINED, the evaluation result is always treated as changed at the first evaluation of the rule after initialization. If this parameter is set to BSWM_TRUE, the evaluation result is treated as changed if the rule is evaluated to false. If this parameter is set to BSWM_FALSE, the evaluation result is treated as changed if the rule is evaluated to true.
          reference BswMRuleExpressionRef: set at link in variant link-time / pre-compile in variant pre-compile / post-build in variant post-build, post-build-variant-value=true, destination=BswMLogicalExpression  # This choice reference either references the mode condition or the logical expression that is evaluated for each rule.
          reference BswMRuleFalseActionList [0..1]: set at link in variant link-time / pre-compile in variant pre-compile / post-build in variant post-build, post-build-variant-multiplicity=true, post-build-variant-value=true, destination=BswMActionList  # This is a reference to the action list that shall be executed when the rule is evaluated to False
          reference BswMRuleTrueActionList [0..1]: set at link in variant link-time / pre-compile in variant pre-compile / post-build in variant post-build, post-build-variant-multiplicity=true, post-build-variant-value=true, destination=BswMActionList  # This is a reference to the action list that shall be executed when the rule is evaluated to True
      container BswMDataTypeMappingSets [0..1]  # Collection of references to DataTypeMappingSet.
        foreign reference BswMDataTypeMappingSetRef [1..*]: set at link in variant link-time / pre-compile in variant pre-compile+post-build, destination-type=DATA-TYPE-MAPPING-SET  # Reference to DataTypeMappingSet.
      container BswMModeControl  # This container includes all configuration sub-containers and parameters related to the mode control functionality of the BswM.
        container BswMAction [0..*]  # Each container of this type defines an action. These actions can be part of one or several action lists.
          choice container BswMAvailableActions  # Choice container including the available actions to be used in the action lists.
            container BswMComMAllowCom [0..1]  # This container includes all parameters for the action to allow or to block communication for a ComM Channel. ComM_CommunicationAllowed is called when this action is configured.
              boolean BswMComAllowed: set at link in variant link-time / pre-compile in variant pre-compile+post-build  # The parameter BswMComMAllowChannelRef refers to a channel which will allow or block communication using the function ComM_CommunicationAllowed(). | This parameter corresponds to the parameter "Allowed" of the function ComM_CommunicationAllowed().
              symbolic name reference BswMComMAllowChannelRef: set at link in variant link-time / pre-compile in variant pre-compile+post-build, destination=ComMChannel  # This is a reference to the ComM Channel for which communication shall be allowed or blocked. | This reference corresponds to the parameter "Channel" of the function ComM_CommunicationAllowed().
            container BswMComMModeLimitation [0..1]  # This container includes all parameters related to a limitation of communication mode for a ComM Channel. ComM_LimitChannelToNoComMode is called when this action is configured.
              boolean BswMComMLimitMode: set at link in variant link-time / pre-compile in variant pre-compile+post-build  # The function ComM_LimitChannelToNoComMode() takes in this boolean parameter to limit the channel's com mode to no-com mode. | This parameter corresponds to the parameter "Status" of the function ComM_LimitChannelToNoComMode.
              symbolic name reference BswMComMLimitChannelRef: set at link in variant link-time / pre-compile in variant pre-compile+post-build, destination=ComMChannel  # This is a reference to the ComM channel for which the communication mode should be limited. | This reference corresponds to the parameter "Channel" of the function ComM_LimitChannelToNoComMode.
            container BswMComMModeSwitch [0..1]  # This container includes all parameters related to a switch of communication mode for a ComM User. ComM_RequestComMode is called when this action is configured.
              enumeration BswMComMRequestedMode: {BSWM_FULL_COM, BSWM_NO_COM}, set at link in variant link-time / pre-compile in variant pre-compile+post-build  # This parameter specifies if the requested communication mode. | This parameter corresponds to the parameter "ComMode" of the function ComM_RequestComMode.
              symbolic name reference BswMComMUserRef: set at link in variant link-time / pre-compile in variant pre-compile+post-build, destination=ComMUser  # This is a reference to the ComM User that is associated to the Communication channel for which the communication mode should be requested. | This reference corresponds to the parameter "User" of the function ComM_RequestComMode.
            container BswMDeadlineMonitoringControl [0..1]  # This container includes all parameters related to enabling and disabling of deadline monitoring for one or several PDUs in COM. | COM_ReceptionDMControl is called when this action is configured.
              symbolic name reference BswMDisabledDMPduGroupRef [0..*]: set at link in variant link-time / pre-compile in variant pre-compile / post-build in variant post-build, post-build-variant-multiplicity=true, post-build-variant-value=true, destination=ComIPduGroup  # This is a reference to a PDU Group for which the Deadline Monitoring should be disabled. | Together with the BswMEnabledDMPduGroupRef this reference corresponds to the parameter "ipduGroupVector" of the function COM_ReceptionDMControl.
              symbolic name reference BswMEnabledDMPduGroupRef [0..*]: set at link in variant link-time / pre-compile in variant pre-compile / post-build in variant post-build, post-build-variant-multiplicity=true, post-build-variant-value=true, destination=ComIPduGroup  # This is a reference to a PDU Group for which the Deadline Monitoring should be enabled. | Together with the BswMDisabledDMPduGroupRef this reference corresponds to the parameter "ipduGroupVector" of the function COM_ReceptionDMControl.
            container BswMEcuMGoDown [0..1]  # This container defines the UserId which shall be forwarded to the GoDown request.
              symbolic name reference BswMEcuMUserIdRef: set at link in variant link-time / pre-compile in variant pre-compile+post-build, destination=EcuMFlexUserConfig  # This is a reference to a EcuM UserId.
            container BswMEcuMSelectShutdownTarget [0..1]  # This container defines the shutdown target.
              symbolic name reference BswMEcuMShutdownTargetRef: set at link in variant link-time / pre-compile in variant pre-compile+post-build, destination=EcuMSleepMode  # This is a reference to a shutdown target.
            container BswMLinScheduleSwitch [0..1]  # This container includes all parameters related to a switch of LIN schedule table. LinSM_ScheduleRequest is called when this action is configured. | The configuration for the "network" parameter can be accessed via the reference LinSMComMNetworkHandleRef contained in the parent container LinSMChannel of the container referenced by BswMLinScheduleRef.
              symbolic name reference BswMLinScheduleRef: set at link in variant link-time / pre-compile in variant pre-compile / post-build in variant post-build, post-build-variant-multiplicity=true, post-build-variant-value=true, destination=LinSMSchedule  # This is a reference to the LIN schedule table that the LIN SM shall change to. | This reference corresponds to the parameter "schedule" of the function LinSM_ScheduleRequest.
            container BswMNMControl [0..1]  # This container includes all parameters related to enabling and disabling of Network Management communication. Disabling of NM communication can be requested by DCM. | Nm_EnableCommunication or Nm_DisableCommunication is called when this action is configured.
              enumeration BswMNMAction: {BSWM_NM_DISABLE, BSWM_NM_ENABLE}, set at link in variant link-time / pre-compile in variant pre-compile+post-build  # This parameter specifies if the communication of the corresponding NM channel should be enabled or disabled.
              symbolic name reference BswMComMNetworkHandleRef: set at link in variant link-time / pre-compile in variant pre-compile+post-build, destination=ComMChannel  # This reference points to the unique channel defined by the ComMChannel and provides access to the unique channel index value in ComMChannelId. | This reference corresponds to the parameter "NetworkHandle" of the function Nm_EnableCommunication and Nm_DisableCommunication.
            container BswMPduGroupSwitch [0..1]  # This container includes references to the PDU groups that shall be enabled and disabled. Com_IpduGroupControl is called when this action is configured.
              boolean BswMPduGroupSwitchReinit: set at link in variant link-time / pre-compile in variant pre-compile / post-build in variant post-build, post-build-variant-multiplicity=true, post-build-variant-value=true, default-value=false  # This parameter defines if the values for the parameters like periodical timer, minimum delay timer etc is retainer or reinitialized during a PDU Group Switch. | This parameter corresponds to the parameter "initialize" of the function Com_IpduGroupControl.
              symbolic name reference BswMDisabledPduGroupRef [0..*]: set at link in variant link-time / pre-compile in variant pre-compile / post-build in variant post-build, post-build-variant-multiplicity=true, post-build-variant-value=true, destination=ComIPduGroup  # This is a reference to a PDU Group that should be disabled. | Together with the BswMEnabledIPduGroupRef this reference corresponds to the parameter "ipduGroupVector" of the function Com_IpduGroupControl.
              symbolic name reference BswMEnabledPduGroupRef [0..*]: set at link in variant link-time / pre-compile in variant pre-compile, post-build-variant-multiplicity=true, post-build-variant-value=true, destination=ComIPduGroup  # This is a reference to a PDU Group that should be enabled. | Together with the BswMDisabledIPduGroupRef this reference corresponds to the parameter "ipduGroupVector" of the function Com_IpduGroupControl.
            container BswMPduRouterControl [0..1]  # This container includes all parameters related to enabling and disabling of routing of Routing Path Groups in the PDU Router. PduR_EnableRouting or PduR_DisableRouting is called when this action is configured.
              enumeration BswPduRouterAction: {BSWM_PDUR_DISABLE, BSWM_PDUR_ENABLE}, set at link in variant link-time / pre-compile in variant pre-compile / post-build in variant post-build, post-build-variant-value=true  # This parameter specifies if the routing of the corresponding PDU should be enabled or disabled.
              symbolic name reference BswMPduRoutingPathGroupRef [0..*]: set at link in variant link-time / pre-compile in variant pre-compile / post-build in variant post-build, post-build-variant-multiplicity=true, post-build-variant-value=true, destination=PduRRoutingPathGroup  # This is a reference to the PDU Routing Path Group for which the routing in the PDU Router should be enabled or disabled. | This reference corresponds to the parameter "id" of the function PduR_EnableRouting and PduR_DisableRouting.
            container BswMRteSwitch [0..1]  # This container defines a mode switch indication that the BswM provides to the SW-C that need to be notified about the mode switch. RTE_Switch is called when this action is configured.
              foreign reference BswMSwitchedMode: set at link in variant link-time / pre-compile in variant pre-compile+post-build, destination-type=MODE-DECLARATION  # This parameter contains the integer value that corresponds to a certain mode in a Mode Declaration Group.
              reference BswMRteSwitchPortRef: set at link in variant link-time / pre-compile in variant pre-compile+post-build, destination=BswMSwitchPort  # This is a reference to the BswMSwitchPort.
            container BswMSchMSwitch [0..1]  # This container defines a mode switch indication that the BswM provides to the SW-C that need to be notified about the mode switch. SchM_Switch is called when this action is configured.
              foreign reference BswMSchMSwitchedMode: set at link in variant link-time / pre-compile in variant pre-compile+post-build, destination-type=MODE-DECLARATION  # This parameter contains the integer value that corresponds to a certain mode in a Mode Declaration Group.
              reference BswMSchMSwitchPortRef: set at link in variant link-time / pre-compile in variant pre-compile+post-build, destination=BswMSwitchPort  # This is a reference to the BswMSwitchPort.
            container BswMSwitchIPduMode [0..1]  # This container includes all parameters related to the selection of the transmission mode an I-PDU to be sent by COM. Com_SwitchIpduTxMode is called when this action is configured.
              boolean BswMSwitchIPduModeValue: set at link in variant link-time / pre-compile in variant pre-compile+post-build  # This parameter defines which transmission mode shall be selected during this call. | This parameter corresponds to the parameter "truefalsemode" of the function Com_SwitchIpduTxMode.
              symbolic name reference BswMSwitchIPduModeRef: set at link in variant link-time / pre-compile in variant pre-compile+post-build, destination=ComIPdu  # This is a reference to an I-PDU for which the transmission mode shall be set. | This reference corresponds to the parameter "PduId" of the function Com_SwitchIpduTxMode.
            container BswMTriggerIPduSend [0..1]  # This container includes all parameters related to the triggering of an I-PDU to be sent by COM. Com_TriggerIPDUSend is called when this action is configured.
              symbolic name reference BswMTriggeredIPduRef [0..*]: set at link in variant link-time / pre-compile in variant pre-compile+post-build, destination=ComIPdu  # This is a reference to an I-PDU that should be triggered for transmission. | This reference corresponds to the parameter "PduId" of the function Com_TriggerIPDUSend.
            container BswMTriggerSlaveRTEStop [0..1]  # This container includes all parameters needed to stop the RTE on a slave core. This choice shall only be chosen if multicore is used.
              integer BswMCoreId: 0..18446744073709551615, set at link in variant link-time / pre-compile in variant pre-compile+post-build  # This parameter defines the identifier of the slave core that is used as input parameter for the BswM_TriggerStartUpPhase2 and BswM_TriggerSlaveRTEStop functions. The value of this parameter shall be synchronized with the OsApplicationCoreAssignment parameter.
            container BswMTriggerStartUpPhase2 [0..1]  # This container includes all parameters needed to start phase two on a slave core. This choice shall only be chosen if multicore is used.
              integer BswMCoreId: 0..18446744073709551615, set at link in variant link-time / pre-compile in variant pre-compile+post-build  # This parameter defines the identifier of the slave core that is used as input parameter for the BswM_TriggerStartUpPhase2 and BswM_TriggerSlaveRTEStop functions. The value of this parameter shall be synchronized with the OsApplicationCoreAssignment parameter.
            container BswMUserCallout [0..1]  # This container includes all details needed for a user defined function call.
              string BswMUserCalloutFunction: set at link in variant link-time / pre-compile in variant pre-compile+post-build  # This parameter specifies the complete function call including all parameters. The parameters are specified during configuration time, and cannot be changed during run time. Any return values passed by the callout will be ignored. | Example usage can be: Actions to initialize other BSW modules Action to call Rte_Start() Action to call Rte_Stop() Action to call NvM_ReadAll() Action to call NvM_WriteAll()
            container BswMRteModeRequest [0..1]  # This container defines a mode request that the BswM may send to a SW-C which is acting as a mode-manager. RTE_Write is called when this action is configured.
              foreign reference BswMRequestedModeRef: set at pre-compile, destination-type=MODE-DECLARATION  # This is a foreign reference to the Mode Declaration used for the mode request
              reference BswMRteModeRequestPortRef: set at pre-compile, destination=BswMRteModeRequestPort  # This is a reference to a BswMRteModeRequestPort.
            container BswMSdClientServiceModeRequest [0..1]  # This container includes all parameters related to the selection of an client service of Sd. Sd_ClientServiceSetState is called when this action is configured.
              enumeration BswMSdClientServiceState: {BSWM_SD_CLIENT_SERVICE_RELEASED, BSWM_SD_CLIENT_SERVICE_REQUESTED}, set at pre-compile  # This parameter specifies if the corresponding client service shall be released or requested.
              symbolic name reference BswMSdClientMethodsRef: set at pre-compile, destination=SdClientService  # This is a reference to a client service in the Sd module.
            container BswMSdConsumedEventGroupModeRequest [0..1]  # This container includes all parameters related to the selection of a consumed EventGroup of Sd. Sd_ConsumedEventGroupSetState is called when this action is configured.
              enumeration BswMSdConsumedEventGroupState: {BSWM_SD_CONSUMED_EVENTGROUP_RELEASED, BSWM_SD_CONSUMED_EVENTGROUP_REQUESTED}, set at pre-compile  # This parameter specifies if the corresponding consumed event group shall be released or requested.
              symbolic name reference BswMSdConsumedEventGroupRef: set at pre-compile, destination=SdConsumedEventGroup  # This is a reference to an eventGroup that is defined within a client service in the Sd module.
            container BswMSdServerServiceModeRequest [0..1]  # This container includes all parameters related to the selection of a server service of Sd. Sd_ServerServiceSetState is called when this action is configured.
              enumeration BswMSdServerServiceState: {BSWM_SD_SERVER_SERVICE_AVAILABLE, BSWM_SD_SERVER_SERVICE_DOWN}, set at pre-compile  # This parameter specifies if the corresponding server service shall be down or available.
              symbolic name reference BswMSdServerMethodsRef: set at pre-compile, destination=SdServerService  # This is a reference to a server service in the Sd module.
        container BswMActionList [0..*]: post-build-changeable=true, post-build-variant-multiplicity=true  # Each instance of this container defines an action list that is invoked based on the BswM Rules. An action list contains a list of numbered action items to be processed. An action list can also include other action lists.
          enumeration BswMActionListExecution: {BSWM_CONDITION, BSWM_TRIGGER}, set at link in variant link-time / pre-compile in variant pre-compile / post-build in variant post-build, post-build-variant-value=true  # This parameter controls if the corresponding action list shall be executed every time the rule is evaluated or only when the result of the evaluation changes.
          container BswMActionListItem [1..*]: post-build-changeable=true, post-build-variant-multiplicity=true  # This container defines an item in an action list.
            boolean BswMAbortOnFail: set at link in variant link-time / pre-compile in variant pre-compile / post-build in variant post-build, post-build-variant-value=true, default-value=false  # This parameter defines if the execution of the action list shall be aborted if this specific action returns E_NOT_OK. Note that this is only applicable for actions that have E_NOT_OK as a possible return value.
            integer BswMActionListItemIndex: 0..255, set at link in variant link-time / pre-compile in variant pre-compile / post-build in variant post-build, post-build-variant-value=true  # This parameter defines the index of the action in the action list. It is used define in which order the actions shall be performed.
            choice reference BswMActionListItemRef: set at link in variant link-time / pre-compile in variant pre-compile / post-build in variant post-build, post-build-variant-value=true, destination=[BswMAction, BswMActionList, BswMRule]  # The action item can either be an atomic action or a reference to another action list or rule.
            symbolic name reference BswMReportFailToDemRef [0..1]: set at link in variant link-time / pre-compile in variant pre-compile / post-build in variant post-build, post-build-variant-multiplicity=true, post-build-variant-value=true, destination=DemEventParameter  # If the reference is given, the DEM event shall be reported failed if this specific action returns E_NOT_OK; it shall be reported passed if this specific action returns E_OK.
        container BswMSwitchPort [0..*]  # This container specifies PPorts and/or providedModeDeclarationGroups, which the BswM has to create in its SWCD resp. BSWMD. | If the container is referenced by one or more BswMRteSwitchActions the BswM shall create a corresponding PPort in its Service Description. If the container is referenced by a BswMSchMSwitch action the BswM shall create the corresponding ModeDeaclarationGroupPrototype as providedModeDeclarationGroup in it BSWMD. If the container is referenced by BswMSchMSwitch AND BswmRteSwitchActions the a providedModeDeclarationGroup as well as a PPort shall be created. In the corresponding SwcBswMapping a synchronizedModeGroup has to be created. See also chapter 4.4.7 in SWS_RTE.
          foreign reference BswMModeSwitchInterfaceRef: set at link in variant link-time / pre-compile in variant pre-compile+post-build, destination-type=MODE-SWITCH-INTERFACE  # Reference to the ModeSwitchInterface of this BswMModeSwitchPort.
        container BswMRteModeRequestPort [0..*]  # This container defines a mode request port which the BswM may utilize to send a mode request to a SW-C which is acting as a mode-manager. If this container is referenced by a BswMRteModeRequest, the BswM shall create a corresponding PPort in its service description.
          foreign reference BswMRteModeRequestPortInterfaceMappingRef [0..1]: set at pre-compile, destination-type=VARIABLE-AND-PARAMETER-INTERFACE-MAPPING  # This is a foreign reference to the variable and parameter interface mapping used for the mode request.
          instance reference BswMRteModeRequestPortInterfaceRef: set at pre-compile, destination-context=SW-COMPONENT-PROTOTYPE* PORT-PROTOTYPE, destination-type=VARIABLE-DATA-PROTOTYPE  # This is an instance reference to the variable data prototype used for the mode request.
    container BswMGeneral  # General configuration parameters of the Basic SW Mode Manager.
      boolean BswMCanSMEnabled [0..1]: set at pre-compile, default-value=false  # enable/disable CanSM module related BswM API: | true: Enabled false: Disabled
      boolean BswMComMEnabled [0..1]: set at pre-compile, default-value=false  # enable/disable ComM module related BswM API: | true: Enabled false: Disabled
      boolean BswMDcmEnabled [0..1]: set at pre-compile, default-value=false  # enable/disable Dcm module related BswM API: | true: Enabled false: Disabled
      boolean BswMDevErrorDetect: set at pre-compile, default-value=false  # Switches the Development Error Detection and Notification ON or OFF. | true: Enabled false: Disabled
      boolean BswMEcuMEnabled [0..1]: set at pre-compile, default-value=false  # enable/disable EcuM module related BswM API: | true: Enabled false: Disabled
      boolean BswMEthSMEnabled [0..1]: set at pre-compile, default-value=false  # enable/disable EthSM module related BswM API: | true: Enabled false: Disabled
      boolean BswMFrSMEnabled [0..1]: set at pre-compile, default-value=false  # enable/disable FrSM module related BswM API: | true: Enabled false: Disabled
      boolean BswMGenericRequestEnabled [0..1]: set at pre-compile, default-value=false  # enable/disable Generic Request related BswM API: | true: Enabled false: Disabled
      boolean BswMLinSMEnabled [0..1]: set at pre-compile, default-value=false  # enable/disable LinSM module related BswM API: | true: Enabled false: Disabled
      boolean BswMLinTPEnabled [0..1]: set at pre-compile, default-value=false  # enable/disable LinTP module related BswM API: | true: Enabled false: Disabled
      float BswMMainFunctionPeriod [0..1]: 0..Inf, set at link in variant link-time / pre-compile in variant pre-compile+post-build  # The cycle time of the periodic main function of BswM. Defined in seconds .
      boolean BswMNvMEnabled [0..1]: set at pre-compile, default-value=false  # enable/disable NvM module related BswM API: | true: Enabled false: Disabled
      boolean BswMSchMEnabled [0..1]: set at pre-compile, default-value=false  # enable/disable SchM module related BswM API: | true: Enabled false: Disabled
      boolean BswMVersionInfoApi: set at pre-compile, default-value=true  # Switches the possibility to read the version information with the service BswM_GetVersionInfo(). | true: Enabled false: Disabled
      boolean BswMWdgMEnabled [0..1]: set at pre-compile, default-value=false  # enable/disable WdgM module related BswM API: | true: Enabled false: Disabled
      boolean BswMSdEnabled: set at pre-compile, default-value=false  # enable/disable Sd module related BswM API. | true: Enabled false: Disabled
      container BswMUserIncludeFiles [0..1]  # Collection of header file names which shall be included by the BswM.
        string BswMUserIncludeFile [1..*]: set at pre-compile  # Header file name which shall be included by the BswM. | The value of this parameter shall be used as h-char-sequence or q-char-sequence according to ISO C90 section 6.10.2 "source file inclusion". The parameter value MUST NOT represent a path, since ISO C90 does not specify how such a path is treated (i.e., this is implementation defined (and additionally depends on the operating system and the underlying file system)).
package /ArcCore/EcucDefs/Generic/Implementations
  bsw implementation BswM: programming-language=C, sw-version=4.0.1, used-code-generator=system::BswM::gen::BswM::main, vendor-id=60, ar-release-version=4.0.3, vendor-specific-module-def=BswM
