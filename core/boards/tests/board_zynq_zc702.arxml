AUTOSAR XML (schema 4-1-1)
package /Tests/Boards/zynq_zv702
  ecuc value collection board_zynq_zc702: ecuc-values=[Mcu, EcuM]
  module config EcuM: implementation-config-variant=VARIANT-PRE-COMPILE, module-description=EcuM
    EcuMConfiguration
      EcuMCommonConfiguration: EcuMConfigConsistencyHash=(unset), EcuMDefaultAppMode=(unset), EcuMOSResource=(unset)
        EcuMDefaultShutdownTarget: EcuMDefaultState=EcuMStateOff
        EcuMSleepMode: EcuMSleepModeId=(unset), EcuMSleepModeSuspend=(unset), EcuMSleepModeMcuModeRef=SLEEP, EcuMWakeupSourceMask=EcuMWakeupSource
        EcuMWakeupSource: EcuMWakeupSourceId=(unset), EcuMWakeupSourcePolling=0, EcuMResetReasonRef=(unset)
      EcuMFixedConfiguration: EcuMNvramReadallTimeout=10.0, EcuMNvramWriteallTimeout=10.0, EcuMRunMinimumDuration=10.0, EcuMNormalMcuModeRef=NORMAL
        EcuMFixedUserConfig: EcuMFixedUser=(unset)
    EcuMGeneral: EcuMDevErrorDetect=0, EcuMIncludeDem=0, EcuMIncludeDet=0, EcuMMainFunctionPeriod=0.2, EcuMVersionInfoApi=0
  module config Mcu: implementation-config-variant=VARIANT-PRE-COMPILE, module-description=Mcu
    McuGeneralConfiguration: McuDevErrorDetect=1, McuGetRamStateApi=1, McuInitClock=1, McuNoPll=0, McuPerformResetApi=1, McuVersionInfoApi=1
    McuModuleConfiguration: McuClockSrcFailureNotification=DISABLED, McuNumberOfMcuModes=(unset), McuRamSectors=(unset), ArcDefaultClockRef=Cpu667Mhz
      Cpu667Mhz (McuClockSettingConfig): McuClockSettingId=(unset)
        Crystal33Mhz (McuClockReferencePoint): McuClockReferencePointFrequency=33333333.33
        ArcPLLSettings: ARM_PLL_FDIV=40, ARM_PLL_LOCK_CNT=250, ARM_PLL_CP=2, ARM_PLL_RES=2, IO_PLL_FDIV=30, IO_PLL_LOCK_CNT=325, IO_PLL_CP=2, IO_PLL_RES=12
        ArcClockSettings:
          LQSPI_DIVISOR = 5
          GEM0_DIVISOR = 8
          SMC_DIVISOR = 0
          SDIO_DIVISOR = 0
          SPI_DIVISOR = 6
          CPU_DIVISOR = 2
          UART_DIVISOR = 1
          CAN_DIVISOR1 = 3
          PCAP_DIVISOR = 0
          GEM0_RCLK_CTRL = 0
          CAN_DIVISOR = 14
          CAN_MIOCLK_CTRL = 0
          GEM0_DIVISOR1 = 5
          GEM1_DIVISOR = 0
          GEM1_DIVISOR1 = 0
          GEM1_RCLK_CTRL = 0
          CAN_CLKACT = 1
          CAN_CLKACT1 = 1
          CPU_1XCLKACT = 1
          CPU_2XCLKACT = 1
          CPU_3OR2XCLKACT = 1
          CPU_6OR4XCLKACT = 1
          GEM0_CLKACT = 1
          GEM1_CLKACT = 0
          SPI_CLKACT = 1
          SPI_CLKACT1 = 1
          UART_CLKACT = 1
          UART_CLKACT1 = 1
          LQSPI_CLKACT = 1
          SDIO_CLKACT1 = 0
          SDIO_CLKACT = 0
          SMC_CLKACT = 0
          PCAP_CLKACT = 0
          CPU_PERI_CLKACT = 1
          GEM0_RCLK_CTRL = MIO
          GEM1_RCLK_CTRL = UNSET
          GEM0_RCLK_CLKACT = 1
          GEM1_RCLK_CLKACT = 0
      3 x McuModeSettingConf, all with McuMode=(unset):
        NORMAL
        SLEEP
        RUN
      McuRamSectorSettingConf: McuRamDefaultValue=171, McuRamSectionBaseAddress=1048576, McuRamSectionSize=500
    McuPublishedInformation
      McuResetReasonConf: McuResetReason=(unset)
