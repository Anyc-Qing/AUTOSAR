AUTOSAR XML (schema 4-1-1)
package /Tests/Boards/board_rh850f1h
  ecuc value collection MyEcu: ecuc-values=[Mcu, EcuM]
  module config Mcu: implementation-config-variant=VARIANT-PRE-COMPILE, module-description=Mcu
    McuGeneralConfiguration: McuDevErrorDetect=1, McuGetRamStateApi=0, McuInitClock=1, McuNoPll=0, McuPerformResetApi=1, McuVersionInfoApi=1
    McuModuleConfiguration: McuClockSrcFailureNotification=DISABLED, McuNumberOfMcuModes=(unset), McuRamSectors=(unset), ArcDefaultClockRef=Cpu120MHzCrystal16MHz
      Cpu120MHzCrystal16MHz (McuClockSettingConfig): McuClockSettingId=(unset)
        Crystal16Mhz (McuClockReferencePoint): McuClockReferencePointFrequency=16000000.0
        ArcPLLSettings: PLL1N=39, PLL0ADJ=1, PLL0MD=0, PLL0N=29, PLL0P=2, PLL0MF=0, PLL1P=2, PLL0M=0, PLL1M=1
      NORMAL (McuModeSettingConf): McuMode=(unset)
      SLEEP (McuModeSettingConf): McuMode=(unset)
      Cpu120MHzCrystal8MHz (McuClockSettingConfig): McuClockSettingId=(unset)
        Crystal8Mhz (McuClockReferencePoint): McuClockReferencePointFrequency=8000000.0
        ArcPLLSettings: PLL1N=39, PLL0ADJ=1, PLL0MD=0, PLL0N=59, PLL0P=2, PLL0MF=0, PLL1P=2, PLL0M=0, PLL1M=0
      RUN (McuModeSettingConf): McuMode=(unset)
    McuPublishedInformation
      McuResetReasonConf: McuResetReason=(unset)
  module config EcuM: implementation-config-variant=VARIANT-PRE-COMPILE, module-description=EcuM
    EcuMConfiguration
      EcuMCommonConfiguration: EcuMConfigConsistencyHash=(unset), EcuMDefaultAppMode=(unset), EcuMOSResource=(unset)
        EcuMDefaultShutdownTarget: EcuMDefaultState=EcuMStateOff
        EcuMSleepMode: EcuMSleepModeId=(unset), EcuMSleepModeSuspend=(unset), EcuMSleepModeMcuModeRef=NORMAL, EcuMWakeupSourceMask=EcuMWakeupSource
        EcuMWakeupSource: EcuMWakeupSourceId=(unset), EcuMWakeupSourcePolling=(unset), EcuMResetReasonRef=(unset)
      EcuMFixedConfiguration: EcuMNvramReadallTimeout=0.01, EcuMNvramWriteallTimeout=0.01, EcuMRunMinimumDuration=(unset), EcuMNormalMcuModeRef=NORMAL
        EcuMFixedUserConfig: EcuMFixedUser=(unset)
    EcuMGeneral: EcuMDevErrorDetect=1, EcuMIncludeDem=(unset), EcuMIncludeDet=(unset), EcuMMainFunctionPeriod=0.01, EcuMVersionInfoApi=1
