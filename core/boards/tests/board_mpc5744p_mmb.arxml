AUTOSAR XML (schema 4-2-2)
package /Tests/Boards/mpc5744p_mmb
  ecuc value collection MyEcu: ecuc-values=[EcuM, Mcu]
  module config EcuM: implementation-config-variant=VARIANT-PRE-COMPILE, module-description=EcuM
    EcuMConfiguration
      EcuMCommonConfiguration: EcuMConfigConsistencyHash=, EcuMDefaultAppMode=(unset), EcuMOSResource=(unset)
        EcuMDefaultShutdownTarget: EcuMDefaultState=EcuMStateOff
        EcuMSleepMode: EcuMSleepModeId=, EcuMSleepModeSuspend=, EcuMSleepModeMcuModeRef=SLEEP, EcuMWakeupSourceMask=EcuMWakeupSource
        EcuMWakeupSource: EcuMWakeupSourceId=, EcuMWakeupSourcePolling=false, EcuMResetReasonRef=(unset)
      EcuMFixedConfiguration: EcuMNvramReadallTimeout=10.0, EcuMNvramWriteallTimeout=10.0, EcuMRunMinimumDuration=10.0, EcuMNormalMcuModeRef=NORMAL
        User_1 (EcuMFixedUserConfig): EcuMFixedUser=
    EcuMGeneral: EcuMDevErrorDetect=false, EcuMIncludeDem=false, EcuMIncludeDet=false, EcuMMainFunctionPeriod=0.2, EcuMVersionInfoApi=false
  module config Mcu: implementation-config-variant=VARIANT-PRE-COMPILE, module-description=Mcu
    McuGeneralConfiguration: McuDevErrorDetect=true, McuGetRamStateApi=false, McuInitClock=true, McuNoPll=false, McuPerformResetApi=true, McuVersionInfoApi=false
    McuModuleConfiguration: McuClockSrcFailureNotification=DISABLED, McuNumberOfMcuModes=, McuRamSectors=, ArcDefaultClockRef=XOSC40Mhz
      XOSC40Mhz (McuClockSettingConfig): McuClockSettingId=
        McuClockReferencePoint: Frequency=, McuClockReferencePointFrequency=40000000.0
        ArcPLLSettings: PLL0_PREDIV=5, PLL0_MFD=60, PLL0_RFDPHI=3, PLL1_MFD=30, PLL1_RFDPHI=3, PLL1FM_MODPRD=0, PLL1FM_INCSTP=0, PLL1FM_MODEN=false
      3 x McuModeSettingConf, all with McuMode=:
        RUN
        NORMAL
        SLEEP
    McuPublishedInformation
      McuResetReasonConf: McuResetReason=
