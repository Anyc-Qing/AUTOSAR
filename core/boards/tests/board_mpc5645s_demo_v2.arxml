AUTOSAR XML (schema 4-1-1)
package /Tests/Boards/mpc5645s_demo_v2
  ecuc value collection board_mpc5645s_demo_v2: ecuc-values=[Mcu, EcuM, Dio, Port]
  module config Mcu: implementation-config-variant=VARIANT-PRE-COMPILE, module-description=Mcu
    McuGeneralConfiguration: McuDevErrorDetect=1, McuGetRamStateApi=1, McuInitClock=1, McuNoPll=0, McuPerformResetApi=1, McuVersionInfoApi=1
    McuModuleConfiguration: McuClockSrcFailureNotification=DISABLED, McuNumberOfMcuModes=(unset), McuRamSectors=(unset), ArcDefaultClockRef=McuClockSettingConfig
      McuClockSettingConfig: McuClockSettingId=(unset)
        PLLSettings124MHzOn8MHzOsc (PLLSettings): IDF=0, NDIV=62, ODF=0
        McuClockReferencePoint: Frequency=(unset), McuClockReferencePointFrequency=8000000.0
      3 x McuModeSettingConf, all with McuMode=(unset):
        SLEEP
        RUN
        NORMAL
    McuPublishedInformation
      McuResetReasonConf: McuResetReason=(unset)
        McuResetReasonConf: McuResetReason=(unset)
  module config EcuM: implementation-config-variant=VARIANT-PRE-COMPILE, module-description=EcuM
    EcuMConfiguration
      EcuMCommonConfiguration: EcuMConfigConsistencyHash=(unset), EcuMDefaultAppMode=(unset), EcuMOSResource=(unset)
        EcuMDefaultShutdownTarget: EcuMDefaultState=EcuMStateOff
        EcuMSleepMode: EcuMSleepModeId=(unset), EcuMSleepModeSuspend=(unset), EcuMSleepModeMcuModeRef=SLEEP, EcuMWakeupSourceMask=EcuMWakeupSource
        EcuMWakeupSource: EcuMWakeupSourceId=(unset), EcuMWakeupSourcePolling=0, EcuMResetReasonRef=(unset)
      EcuMFixedConfiguration: EcuMNvramReadallTimeout=10.0, EcuMNvramWriteallTimeout=10.0, EcuMRunMinimumDuration=10.0, EcuMNormalMcuModeRef=RUN
        EcuMFixedUserConfig: EcuMFixedUser=(unset)
    EcuMGeneral: EcuMDevErrorDetect=0, EcuMIncludeDem=0, EcuMIncludeDet=0, EcuMMainFunctionPeriod=0.2, EcuMVersionInfoApi=0
  module config Dio: implementation-config-variant=VARIANT-PRE-COMPILE, module-description=Dio
    DioConfig
      5 x DioPort:
        PORT_F: DioPortId=5
          LED_GREEN (DioChannel): DioChannelId=70
        PORT_K: DioPortId=10
          LED_RED (DioChannel): DioChannelId=121
        PORT_E: DioPortId=4
          DioChannelGroup: DioChannelGroupIdentification=, DioPortMask=3, DioPortOffset=(unset)
          4 x DioChannel:
            DioChannel_GPIO_E0: DioChannelId=62
            DioChannel_GPIO_E1: DioChannelId=63
            DioChannel_GPIO_E2: DioChannelId=64
            DioChannel_GPIO_E3: DioChannelId=65
          DioChannelGroupW (DioChannelGroup): DioChannelGroupIdentification=, DioPortMask=8192, DioPortOffset=(unset)
          DioChannelGroupR (DioChannelGroup): DioChannelGroupIdentification=, DioPortMask=4096, DioPortOffset=(unset)
          DioChannel_LinSlvTrcv_Enable (DioChannel): DioChannelId=68
        PORT_C: DioPortId=2
          DioChannel_SpiCs (DioChannel): DioChannelId=43
        PORT_B: DioPortId=1
          LinSlvTxForcedDio (DioChannel): DioChannelId=18
          LinSlvTrcvRstnDummy (DioChannel): DioChannelId=71
    DioGeneral: DioDevErrorDetect=1, DioFlipChannelApi=(unset), DioVersionInfoApi=1
  module config Port: implementation-config-variant=VARIANT-PRE-COMPILE, module-description=Port
    PortConfigSet
      7 x PortContainer, all with PortNumberOfPortPins=(unset):
        DSPI_1
          4 x PortPin, all with PortPinDirectionChangeable=0, PortPinInitialMode=PORT_PIN_MODE_SPI, PortPinLevelValue=PORT_PIN_LEVEL_LOW, PortPinMode=PORT_PIN_MODE_SPI, PortPinModeChangeable=0, ArcPortPinPull=PORT_PIN_PULL_NONE, ArcPortPinSlewRate=PORT_PIN_SLEW_RATE_MAX, ArcPortPinOpenDrainEnable=0:
            DSPI_1_SCK_1: PortPinDirection=PORT_PIN_OUT, PortPinId=20
            DSPI_1_SOUT_1: PortPinDirection=PORT_PIN_OUT, PortPinId=21
            DSPI_1_SIN_1: PortPinDirection=PORT_PIN_IN, PortPinId=22
            DSPI_1_CS0_1: PortPinDirection=PORT_PIN_OUT, PortPinId=43
        GPIO
          5 x PortPin, all with PortPinInitialMode=PORT_PIN_MODE_DIO, PortPinMode=PORT_PIN_MODE_DIO, ArcPortPinPull=PORT_PIN_PULL_NONE, ArcPortPinSlewRate=PORT_PIN_SLEW_RATE_MIN, ArcPortPinOpenDrainEnable=0:
            SIUL_GPIO_62: PortPinDirection=PORT_PIN_OUT, PortPinDirectionChangeable=1, PortPinId=62, PortPinLevelValue=PORT_PIN_LEVEL_LOW, PortPinModeChangeable=1
            SIUL_GPIO_63: PortPinDirection=PORT_PIN_OUT, PortPinDirectionChangeable=1, PortPinId=63, PortPinLevelValue=PORT_PIN_LEVEL_LOW, PortPinModeChangeable=1
            SIUL_GPIO_150: PortPinDirection=PORT_PIN_OUT, PortPinDirectionChangeable=1, PortPinId=150, PortPinLevelValue=PORT_PIN_LEVEL_HIGH, PortPinModeChangeable=1
            SIUL_GPIO_64: PortPinDirection=PORT_PIN_OUT, PortPinDirectionChangeable=0, PortPinId=64, PortPinLevelValue=PORT_PIN_LEVEL_LOW, PortPinModeChangeable=0
            SIUL_GPIO_65: PortPinDirection=PORT_PIN_IN, PortPinDirectionChangeable=0, PortPinId=65, PortPinLevelValue=PORT_PIN_LEVEL_LOW, PortPinModeChangeable=0
        LED
          SIUL_GPIO_70 (PortPin):
            PortPinDirection = PORT_PIN_OUT
            PortPinDirectionChangeable = 0
            PortPinId = 70
            PortPinInitialMode = PORT_PIN_MODE_DIO
            PortPinLevelValue = PORT_PIN_LEVEL_LOW
            PortPinMode = PORT_PIN_MODE_DIO
            PortPinModeChangeable = 0
            ArcPortPinPull = PORT_PIN_PULL_NONE
            ArcPortPinSlewRate = PORT_PIN_SLEW_RATE_MAX
            ArcPortPinOpenDrainEnable = 0
          SIUL_GPIO_121 (PortPin):
            PortPinDirection = PORT_PIN_OUT
            PortPinDirectionChangeable = 0
            PortPinId = 121
            PortPinInitialMode = PORT_PIN_MODE_DIO
            PortPinLevelValue = PORT_PIN_LEVEL_LOW
            PortPinMode = PORT_PIN_MODE_DIO
            PortPinModeChangeable = 0
            ArcPortPinPull = PORT_PIN_PULL_NONE
            ArcPortPinSlewRate = PORT_PIN_SLEW_RATE_MAX
            ArcPortPinOpenDrainEnable = 0
        ADC
          5 x PortPin, all with PortPinDirection=PORT_PIN_IN, PortPinDirectionChangeable=0, PortPinInitialMode=PORT_PIN_MODE_ADC, PortPinLevelValue=PORT_PIN_LEVEL_LOW, PortPinMode=PORT_PIN_MODE_ADC, PortPinModeChangeable=0, ArcPortPinSlewRate=PORT_PIN_SLEW_RATE_MAX, ArcPortPinOpenDrainEnable=0:
            ANS_8: PortPinId=38, ArcPortPinPull=PORT_PIN_PULL_UP
            ANS_9: PortPinId=39, ArcPortPinPull=PORT_PIN_PULL_UP
            ANS_10: PortPinId=40, ArcPortPinPull=PORT_PIN_PULL_NONE
            ANS_11: PortPinId=41, ArcPortPinPull=PORT_PIN_PULL_NONE
            ANS_12: PortPinId=42, ArcPortPinPull=PORT_PIN_PULL_NONE
        Lin
          LINFlex_1_RXD_1 (PortPin):
            PortPinDirection = PORT_PIN_IN
            PortPinDirectionChangeable = 0
            PortPinId = 28
            PortPinInitialMode = PORT_PIN_MODE_LIN
            PortPinLevelValue = PORT_PIN_LEVEL_LOW
            PortPinMode = PORT_PIN_MODE_LIN
            PortPinModeChangeable = 0
            ArcPortPinPull = PORT_PIN_PULL_UP
            ArcPortPinSlewRate = PORT_PIN_SLEW_RATE_MAX
            ArcPortPinOpenDrainEnable = 0
          LINFlex_1_TXD_1 (PortPin):
            PortPinDirection = PORT_PIN_OUT
            PortPinDirectionChangeable = 0
            PortPinId = 29
            PortPinInitialMode = PORT_PIN_MODE_LIN
            PortPinLevelValue = PORT_PIN_LEVEL_LOW
            PortPinMode = PORT_PIN_MODE_LIN
            PortPinModeChangeable = 0
            ArcPortPinPull = PORT_PIN_PULL_UP
            ArcPortPinSlewRate = PORT_PIN_SLEW_RATE_MAX
            ArcPortPinOpenDrainEnable = 0
        ICU
          ICU_eMIOS1_10 (PortPin):
            PortPinDirection = PORT_PIN_IN
            PortPinDirectionChangeable = 0
            PortPinId = 143
            PortPinInitialMode = PORT_PIN_MODE_ICU
            PortPinLevelValue = PORT_PIN_LEVEL_LOW
            PortPinMode = PORT_PIN_MODE_PWM
            PortPinModeChangeable = 0
            ArcPortPinPull = PORT_PIN_PULL_NONE
            ArcPortPinSlewRate = PORT_PIN_SLEW_RATE_MAX
            ArcPortPinOpenDrainEnable = 0
          ICU_eMIOS1_11 (PortPin):
            PortPinDirection = PORT_PIN_IN
            PortPinDirectionChangeable = 0
            PortPinId = 144
            PortPinInitialMode = PORT_PIN_MODE_ICU
            PortPinLevelValue = PORT_PIN_LEVEL_LOW
            PortPinMode = PORT_PIN_MODE_PWM
            PortPinModeChangeable = 0
            ArcPortPinPull = PORT_PIN_PULL_NONE
            ArcPortPinSlewRate = PORT_PIN_SLEW_RATE_MAX
            ArcPortPinOpenDrainEnable = 0
        LinSlv
          4 x PortPin, all with PortPinDirectionChangeable=0, ArcPortPinPull=PORT_PIN_PULL_UP, ArcPortPinSlewRate=PORT_PIN_SLEW_RATE_MAX, ArcPortPinOpenDrainEnable=0:
            LINFlex_0_RXD_0: PortPinDirection=PORT_PIN_IN, PortPinId=19, PortPinInitialMode=PORT_PIN_MODE_LIN, PortPinLevelValue=PORT_PIN_LEVEL_LOW, PortPinMode=PORT_PIN_MODE_LIN, PortPinModeChangeable=0
            LINFlex_0_TXD_0: PortPinDirection=PORT_PIN_OUT, PortPinId=18, PortPinInitialMode=PORT_PIN_MODE_LIN, PortPinLevelValue=PORT_PIN_LEVEL_HIGH, PortPinMode=PORT_PIN_MODE_LIN, PortPinModeChangeable=1
            LinTrcvEnable: PortPinDirection=PORT_PIN_OUT, PortPinId=68, PortPinInitialMode=PORT_PIN_MODE_DIO, PortPinLevelValue=PORT_PIN_LEVEL_LOW, PortPinMode=PORT_PIN_MODE_DIO, PortPinModeChangeable=0
            RstnDummy: PortPinDirection=PORT_PIN_IN, PortPinId=71, PortPinInitialMode=PORT_PIN_MODE_DIO, PortPinLevelValue=PORT_PIN_LEVEL_HIGH, PortPinMode=PORT_PIN_MODE_DIO, PortPinModeChangeable=0
    PortGeneral: PortDevErrorDetect=1, PortSetPinDirectionApi=1, PortSetPinModeApi=1, PortVersionInfoApi=1
