AUTOSAR XML (schema 4-1-1)
package /Tests/Boards/board_mpc5516it
  ecuc value collection board_mpc5516it
  module config Mcu: implementation-config-variant=VARIANT-PRE-COMPILE, module-description=Mcu
    McuGeneralConfiguration: McuDevErrorDetect=1, McuGetRamStateApi=0, McuInitClock=1, McuNoPll=0, McuPerformResetApi=1, McuVersionInfoApi=1
    McuModuleConfiguration: McuClockSrcFailureNotification=DISABLED, McuNumberOfMcuModes=(unset), McuRamSectors=(unset), ArcDefaultClockRef=EXT_REF_80MHZ
      EXT_REF_66MHZ (McuClockSettingConfig): McuClockSettingId=(unset)
        McuClockReferencePoint: McuClockReferencePointFrequency=16000000.0
        PLLSettings: EPREDIV=3, EMFD=83, ERFD=5
      RUN (McuModeSettingConf): McuMode=(unset)
      SLEEP (McuModeSettingConf): McuMode=(unset)
      EXT_REF_80MHZ (McuClockSettingConfig): McuClockSettingId=(unset)
        McuClockReferencePoint: McuClockReferencePointFrequency=8000000.0
        PLLSettings: EPREDIV=1, EMFD=104, ERFD=5
      XOSC_CAN (McuClockSettingConfig): McuClockSettingId=(unset)
        McuClockReferencePoint: McuClockReferencePointFrequency=8000000.0
        PLLSettings: EPREDIV=0, EMFD=0, ERFD=0
      NORMAL (McuModeSettingConf): McuMode=(unset)
    McuPublishedInformation
      McuResetReasonConf: McuResetReason=(unset)
  module config Port: implementation-config-variant=VARIANT-PRE-COMPILE, module-description=Port
    PortConfigSet
      7 x PortContainer, all with PortNumberOfPortPins=(unset):
        CAN_A
          CNTX_A (PortPin):
            PortPinDirection = PORT_PIN_OUT
            PortPinDirectionChangeable = 0
            PortPinId = 48
            PortPinInitialMode = PORT_PIN_MODE_CAN
            PortPinLevelValue = PORT_PIN_LEVEL_LOW
            PortPinMode = PORT_PIN_MODE_CAN
            PortPinModeChangeable = 0
            ArcPortPinPull = PORT_PIN_PULL_NONE
            ArcPortPinSlewRate = PORT_PIN_SLEW_RATE_MIN
            ArcPortPinOpenDrainEnable = 0
          CNRX_A (PortPin):
            PortPinDirection = PORT_PIN_IN
            PortPinDirectionChangeable = 0
            PortPinId = 49
            PortPinInitialMode = PORT_PIN_MODE_CAN
            PortPinLevelValue = PORT_PIN_LEVEL_LOW
            PortPinMode = PORT_PIN_MODE_CAN
            PortPinModeChangeable = 0
            ArcPortPinPull = PORT_PIN_PULL_NONE
            ArcPortPinSlewRate = PORT_PIN_SLEW_RATE_MIN
            ArcPortPinOpenDrainEnable = 0
        LED
          PD[4] (PortPin):
            PortPinDirection = PORT_PIN_OUT
            PortPinDirectionChangeable = 0
            PortPinId = 52
            PortPinInitialMode = PORT_PIN_MODE_DIO
            PortPinLevelValue = PORT_PIN_LEVEL_LOW
            PortPinMode = PORT_PIN_MODE_DIO
            PortPinModeChangeable = 0
            ArcPortPinPull = PORT_PIN_PULL_NONE
            ArcPortPinSlewRate = PORT_PIN_SLEW_RATE_MIN
            ArcPortPinOpenDrainEnable = 0
          PD[5] (PortPin):
            PortPinDirection = PORT_PIN_OUT
            PortPinDirectionChangeable = 0
            PortPinId = 53
            PortPinInitialMode = PORT_PIN_MODE_DIO
            PortPinLevelValue = PORT_PIN_LEVEL_LOW
            PortPinMode = PORT_PIN_MODE_DIO
            PortPinModeChangeable = 0
            ArcPortPinPull = PORT_PIN_PULL_NONE
            ArcPortPinSlewRate = PORT_PIN_SLEW_RATE_MIN
            ArcPortPinOpenDrainEnable = 0
        LIN_B
          TXD_B (PortPin):
            PortPinDirection = PORT_PIN_OUT
            PortPinDirectionChangeable = 0
            PortPinId = 56
            PortPinInitialMode = PORT_PIN_MODE_OTHER1
            PortPinLevelValue = PORT_PIN_LEVEL_LOW
            PortPinMode = PORT_PIN_MODE_OTHER_1
            PortPinModeChangeable = 0
            ArcPortPinPull = PORT_PIN_PULL_NONE
            ArcPortPinSlewRate = PORT_PIN_SLEW_RATE_MAX
            ArcPortPinOpenDrainEnable = 0
          RXD_B (PortPin):
            PortPinDirection = PORT_PIN_IN
            PortPinDirectionChangeable = 0
            PortPinId = 57
            PortPinInitialMode = PORT_PIN_MODE_OTHER1
            PortPinLevelValue = PORT_PIN_LEVEL_LOW
            PortPinMode = PORT_PIN_MODE_OTHER_1
            PortPinModeChangeable = 0
            ArcPortPinPull = PORT_PIN_PULL_NONE
            ArcPortPinSlewRate = PORT_PIN_SLEW_RATE_MAX
            ArcPortPinOpenDrainEnable = 0
        Misc
          3 x PortPin, all with PortPinDirectionChangeable=0, PortPinLevelValue=PORT_PIN_LEVEL_LOW, PortPinModeChangeable=0, ArcPortPinPull=PORT_PIN_PULL_NONE, ArcPortPinSlewRate=PORT_PIN_SLEW_RATE_MIN, ArcPortPinOpenDrainEnable=0:
            BOOTCFG: PortPinDirection=PORT_PIN_IN, PortPinId=50, PortPinInitialMode=PORT_PIN_MODE_OTHER3, PortPinMode=PORT_PIN_MODE_OTHER_3
            PF[0]: PortPinDirection=PORT_PIN_OUT, PortPinId=80, PortPinInitialMode=PORT_PIN_MODE_DIO, PortPinMode=PORT_PIN_MODE_DIO
            PF[15]: PortPinDirection=PORT_PIN_IN, PortPinId=95, PortPinInitialMode=PORT_PIN_MODE_DIO, PortPinMode=PORT_PIN_MODE_DIO
        SerialPort
          TXD_D (PortPin):
            PortPinDirection = PORT_PIN_OUT
            PortPinDirectionChangeable = 0
            PortPinId = 92
            PortPinInitialMode = PORT_PIN_MODE_OTHER2
            PortPinLevelValue = PORT_PIN_LEVEL_LOW
            PortPinMode = PORT_PIN_MODE_OTHER_2
            PortPinModeChangeable = 0
            ArcPortPinPull = PORT_PIN_PULL_NONE
            ArcPortPinSlewRate = PORT_PIN_SLEW_RATE_MIN
            ArcPortPinOpenDrainEnable = 0
          RXD_D (PortPin):
            PortPinDirection = PORT_PIN_IN
            PortPinDirectionChangeable = 0
            PortPinId = 93
            PortPinInitialMode = PORT_PIN_MODE_OTHER2
            PortPinLevelValue = PORT_PIN_LEVEL_LOW
            PortPinMode = PORT_PIN_MODE_OTHER_2
            PortPinModeChangeable = 0
            ArcPortPinPull = PORT_PIN_PULL_NONE
            ArcPortPinSlewRate = PORT_PIN_SLEW_RATE_MIN
            ArcPortPinOpenDrainEnable = 0
        SPI_A
          7 x PortPin, all with PortPinDirectionChangeable=0, PortPinModeChangeable=0, ArcPortPinPull=PORT_PIN_PULL_NONE, ArcPortPinOpenDrainEnable=0:
            PCS_A[2]: PortPinDirection=PORT_PIN_OUT, PortPinId=64, PortPinInitialMode=PORT_PIN_MODE_SPI, PortPinLevelValue=PORT_PIN_LEVEL_LOW, PortPinMode=PORT_PIN_MODE_SPI, ArcPortPinSlewRate=PORT_PIN_SLEW_RATE_MAX
            PCS_A[1]: PortPinDirection=PORT_PIN_OUT, PortPinId=65, PortPinInitialMode=PORT_PIN_MODE_SPI, PortPinLevelValue=PORT_PIN_LEVEL_LOW, PortPinMode=PORT_PIN_MODE_SPI, ArcPortPinSlewRate=PORT_PIN_SLEW_RATE_MAX
            SCK_A: PortPinDirection=PORT_PIN_OUT, PortPinId=67, PortPinInitialMode=PORT_PIN_MODE_SPI, PortPinLevelValue=PORT_PIN_LEVEL_LOW, PortPinMode=PORT_PIN_MODE_SPI, ArcPortPinSlewRate=PORT_PIN_SLEW_RATE_MIN
            SOUT_A: PortPinDirection=PORT_PIN_OUT, PortPinId=68, PortPinInitialMode=PORT_PIN_MODE_SPI, PortPinLevelValue=PORT_PIN_LEVEL_LOW, PortPinMode=PORT_PIN_MODE_SPI, ArcPortPinSlewRate=PORT_PIN_SLEW_RATE_MAX
            SIN_A: PortPinDirection=PORT_PIN_IN, PortPinId=69, PortPinInitialMode=PORT_PIN_MODE_SPI, PortPinLevelValue=PORT_PIN_LEVEL_LOW, PortPinMode=PORT_PIN_MODE_SPI, ArcPortPinSlewRate=PORT_PIN_SLEW_RATE_MAX
            PG[1]: PortPinDirection=PORT_PIN_OUT, PortPinId=97, PortPinInitialMode=PORT_PIN_MODE_DIO, PortPinLevelValue=PORT_PIN_LEVEL_HIGH, PortPinMode=PORT_PIN_MODE_DIO, ArcPortPinSlewRate=PORT_PIN_SLEW_RATE_MAX
            PG[5]: PortPinDirection=PORT_PIN_OUT, PortPinId=101, PortPinInitialMode=PORT_PIN_MODE_DIO, PortPinLevelValue=PORT_PIN_LEVEL_LOW, PortPinMode=PORT_PIN_MODE_DIO, ArcPortPinSlewRate=PORT_PIN_SLEW_RATE_MAX
        SPI_B
          5 x PortPin, all with PortPinDirectionChangeable=0, PortPinModeChangeable=0, ArcPortPinPull=PORT_PIN_PULL_NONE, ArcPortPinOpenDrainEnable=0:
            PCS_B[0]: PortPinDirection=PORT_PIN_OUT, PortPinId=60, PortPinInitialMode=PORT_PIN_MODE_SPI, PortPinLevelValue=PORT_PIN_LEVEL_LOW, PortPinMode=PORT_PIN_MODE_SPI, ArcPortPinSlewRate=PORT_PIN_SLEW_RATE_MAX
            SCK_B: PortPinDirection=PORT_PIN_OUT, PortPinId=61, PortPinInitialMode=PORT_PIN_MODE_SPI, PortPinLevelValue=PORT_PIN_LEVEL_LOW, PortPinMode=PORT_PIN_MODE_SPI, ArcPortPinSlewRate=PORT_PIN_SLEW_RATE_MIN
            SOUT_B: PortPinDirection=PORT_PIN_OUT, PortPinId=62, PortPinInitialMode=PORT_PIN_MODE_SPI, PortPinLevelValue=PORT_PIN_LEVEL_LOW, PortPinMode=PORT_PIN_MODE_SPI, ArcPortPinSlewRate=PORT_PIN_SLEW_RATE_MIN
            SIN_B: PortPinDirection=PORT_PIN_IN, PortPinId=63, PortPinInitialMode=PORT_PIN_MODE_SPI, PortPinLevelValue=PORT_PIN_LEVEL_LOW, PortPinMode=PORT_PIN_MODE_SPI, ArcPortPinSlewRate=PORT_PIN_SLEW_RATE_MIN
            PG[6]: PortPinDirection=PORT_PIN_OUT, PortPinId=102, PortPinInitialMode=PORT_PIN_MODE_DIO, PortPinLevelValue=PORT_PIN_LEVEL_HIGH, PortPinMode=PORT_PIN_MODE_DIO, ArcPortPinSlewRate=PORT_PIN_SLEW_RATE_MIN
    PortGeneral: PortDevErrorDetect=1, PortSetPinDirectionApi=1, PortSetPinModeApi=1, PortVersionInfoApi=1
  module config Dio: implementation-config-variant=VARIANT-PRE-COMPILE, module-description=Dio
    DioConfig
      4 x DioPort:
        LEDPORT: DioPortId=3
          LEDS_LED4 (DioChannel): DioChannelId=52
          LED_GRP_PTR (DioChannelGroup): DioChannelGroupIdentification=, DioPortMask=48, DioPortOffset=(unset)
          LEDS_LED5 (DioChannel): DioChannelId=53
        MISC_PORT: DioPortId=4
          S1 (DioChannel): DioChannelId=95
        PLAY: DioPortId=5
          OUTIN_0 (DioChannel): DioChannelId=80
          OUTIN_1 (DioChannel): DioChannelId=81
        SPI_HOLD: DioPortId=6
          3 x DioChannel:
            SPI_A_HOLD_M95256: DioChannelId=97
            SPI_B_HOLD_M95256: DioChannelId=102
            SPI_A_HOLD_S25FL016: DioChannelId=101
    DioGeneral: DioDevErrorDetect=1, DioFlipChannelApi=(unset), DioVersionInfoApi=1
  module config EcuM: implementation-config-variant=VARIANT-PRE-COMPILE, module-description=EcuM
    EcuMConfiguration
      EcuMCommonConfiguration: EcuMConfigConsistencyHash=(unset), EcuMDefaultAppMode=(unset), EcuMOSResource=(unset)
        EcuMDefaultShutdownTarget: EcuMDefaultState=EcuMStateReset
        SleepMode_1 (EcuMSleepMode): EcuMSleepModeId=(unset), EcuMSleepModeSuspend=(unset), EcuMSleepModeMcuModeRef=SLEEP, EcuMWakeupSourceMask=WakeupSource_1
        WakeupSource_1 (EcuMWakeupSource): EcuMWakeupSourceId=(unset), EcuMWakeupSourcePolling=False, EcuMResetReasonRef=(unset)
      EcuMFixedConfiguration: EcuMNvramReadallTimeout=10.0, EcuMNvramWriteallTimeout=10.0, EcuMRunMinimumDuration=10.0, EcuMNormalMcuModeRef=NORMAL
        User_1 (EcuMFixedUserConfig): EcuMFixedUser=(unset)
    EcuMGeneral: EcuMDevErrorDetect=0, EcuMIncludeDem=0, EcuMIncludeDet=0, EcuMMainFunctionPeriod=0.2, EcuMVersionInfoApi=0
    EcuMFixedGeneral: EcuMIncludeComM=(unset), EcuMIncludeNvM=(unset), EcuMIncludeNvramMgr=(unset), EcuMTTIIEnabled=(unset), EcuMTTIIWakeupSourceRef=(unset)
