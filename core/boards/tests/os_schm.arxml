AUTOSAR XML (schema 3-2-1)
package /os_schm
  ecu configuration os_schm: ecu-sw-composition=SwComposition_os_schm, module=Os
  ecu sw composition SwComposition_os_schm
  module config Os
    OsOS:
      OsStackMonitoring = true
      OsStatus = EXTENDED
      OsUseGetServiceId = true
      OsUseParameterAccess = true
      OsUseResScheduler = true
      OsTickFrequency = 100
      OsInterruptStackSize = 2048
      OsIdleStackSize = 512
      OsNumberOfCores = 1
      ArcOsIsrMaxCount = 100
      ArcCoreOsUseDebug = false
      ArcCoreOsDebugTask = false
      ArcCoreOsDebugAlarm = false
      ArcCoreOsDebugResource = false
      ArcCoreOsDebugScheduleTable = false
      ArcCoreOsDebugEvent = false
      OsHooks: OsErrorHook=true, OsPostTaskHook=true, OsPreTaskHook=true, OsProtectionHook=false, OsShutdownHook=true, OsStartupHook=true
    OsApplication1 (OsApplication):
      ArcOsAppCoreId = 0
      OsTrusted = false
      OsAppTaskRef = SchM_BswService
      OsAppTaskRef = SchM_Startup
      OsAppAlarmRef = Alarm_BswService
      OsAppCounterRef = Counter1
      OsAppTaskRef = Application
      OsApplicationHooks: OsAppErrorHook=false, OsAppShutdownHook=false, OsAppStartupHook=false
    SchM_BswService (OsTask): OsTaskActivation=1, OsTaskPriority=10, OsTaskProcessType=BASIC, ArcCoreOsTaskStackSize=2048, OsTaskSchedule=FULL
    SchM_Startup (OsTask): OsTaskActivation=1, OsTaskPriority=4, OsTaskProcessType=BASIC, ArcCoreOsTaskStackSize=2048, OsTaskSchedule=FULL
      OsTaskAutostart
    Alarm_BswService (OsAlarm): OsAlarmCounterRef=Counter1
      OsAlarmActivateTask: OsAlarmActivateTaskRef=SchM_BswService
    Counter1 (OsCounter): OsCounterMaxAllowedValue=65535, OsCounterMinCycle=1, OsCounterTicksPerBase=0, OsCounterType=OS_TICK
    Application (OsTask): OsTaskActivation=1, OsTaskPriority=7, OsTaskProcessType=EXTENDED, ArcCoreOsTaskStackSize=2048, OsTaskSchedule=FULL, OsTaskEventRef=EcuMEnterRUN
      OsTaskAutostart
    EcuMEnterRUN (OsEvent): ArcOsEventId=0, ArcOsEventAutoMask=true
