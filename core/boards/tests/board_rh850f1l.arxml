AUTOSAR XML (schema 4-2-1)
package /Tests/Boards/rh850f1l
  ecuc value collection board_rh850f1l: ecuc-values=[Mcu, EcuM]
  module config Mcu: implementation-config-variant=VARIANT-PRE-COMPILE, module-description=Mcu
    McuGeneralConfiguration: McuDevErrorDetect=true, McuGetRamStateApi=false, McuInitClock=true, McuNoPll=false, McuPerformResetApi=true, McuVersionInfoApi=false
    McuModuleConfiguration: McuClockSrcFailureNotification=DISABLED, McuNumberOfMcuModes=, McuRamSectors=, ArcDefaultClockRef=McuClockSettingConfig
      McuClockSettingConfig: McuClockSettingId=
        ArcPLLSettings: PLLN=39, PLLP=2, PLLM=1
        Cpu80MhzCrystal16Mhz (McuClockReferencePoint): McuClockReferencePointFrequency=16000000.0
      NORMAL (McuModeSettingConf): McuMode=
      RUN (McuModeSettingConf): McuMode=
    McuPublishedInformation
      McuResetReasonConf: McuResetReason=
  module config EcuM: implementation-config-variant=VARIANT-PRE-COMPILE, module-description=EcuM
    EcuMConfiguration
      EcuMCommonConfiguration: EcuMConfigConsistencyHash=(unset), EcuMDefaultAppMode=(unset), EcuMOSResource=(unset)
        EcuMDefaultShutdownTarget: EcuMDefaultState=EcuMStateOff
        EcuMSleepMode: EcuMSleepModeId=(unset), EcuMSleepModeSuspend=(unset), EcuMSleepModeMcuModeRef=RUN, EcuMWakeupSourceMask=EcuMWakeupSource
        EcuMWakeupSource: EcuMWakeupSourceId=(unset), EcuMWakeupSourcePolling=(unset), EcuMResetReasonRef=(unset)
      EcuMFixedConfiguration: EcuMNvramReadallTimeout=0.01, EcuMNvramWriteallTimeout=0.01, EcuMRunMinimumDuration=(unset), EcuMNormalMcuModeRef=NORMAL
        User_1 (EcuMFixedUserConfig): EcuMFixedUser=(unset)
    EcuMGeneral: EcuMDevErrorDetect=1, EcuMIncludeDem=(unset), EcuMIncludeDet=(unset), EcuMMainFunctionPeriod=0.01, EcuMVersionInfoApi=1
