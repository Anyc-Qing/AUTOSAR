AUTOSAR XML (schema 4-2-2)
package /ArcCore/Implementations/mpc5645s
  bsw implementation CddLinSlv: programming-language=C, sw-version=0.1.0, used-code-generator=cdd::LinSlv::generator::CDD_LinSlv::main, vendor-id=60, ar-release-version=4.1.2, vendor-specific-module-def=CDD_LinSlv
