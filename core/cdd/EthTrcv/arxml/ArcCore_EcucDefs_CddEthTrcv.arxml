AUTOSAR XML (schema 4-2-2)
package /ArcCore/EcucDefs/Generic
  module definition CddEthTrcv [0..1]: variants post-build/pre-compile/link-time  # This container includes all necessary configuration sub-containers according the CAN Interface configuration structure.
    container EthTrcvConfigSet  # This container contains the configuration parameters and sub containers of the AUTOSAR EthTrcv module.
      container EthTrcvAddress [000..1]  # Possible known address of the connected tranceiver
        integer TrcvAddress: 0..31, set at pre-compile  # Known possible tranceiver address
    container EthTrcvGeneral  # General configuration of Ethernet Driver module
      boolean EthTrcvAutoNegotiate: set at pre-compile, origin=ARCCORE_ECUC, default-value=0  # Enables/disables auto negotiatition process | true: Enabled. false: Disabled.
      boolean EthTrcvAutoFindAddress: set at pre-compile, origin=ARCCORE_ECUC, default-value=0  # Enables/disables auto finding of tranceiver address on the MDIO bus | true: Enabled. false: Disabled.
package /ArcCore/EcucDefs/Generic/Implementations
  bsw implementation CddEthTrcv: programming-language=C, sw-version=1.0.0, used-code-generator=cdd::EthTrcv::generator::CddEthTrcv::main, vendor-id=60, ar-release-version=4.0.3, vendor-specific-module-def=CddEthTrcv
