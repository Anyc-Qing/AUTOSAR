AUTOSAR XML (schema 4-2-2)
package /ArcCore/EcucDefs/Generic
  module definition Det [0..1]: refined-module-def=Det, variants pre-compile  # Det configuration includes the functions to be called at notification. On one | side the application functions are specified and in general it can be decided whether Dlt shall be called at each call of Det.
    container DetGeneral  # Generic configuration parameters of the Det module.
      boolean DetForwardToDlt [0..1]: set at pre-compile, default-value=0  # Only if the parameter is present and set to true, the Det requires the Dlt interface and forwards it's call to the function Dlt_DetForwardErrorTrace. In this case the optional interface to Dlt_Det is required.
      boolean DetVersionInfoApi: set at pre-compile, default-value=0  # Pre-processor switch to enable / disable the API to read out the modules version information. | true: Version info API enabled. false: Version info API disabled.
      boolean DetUseRamlog: set at pre-compile, default-value=1  # Switch ON / OFF the logging of errors to ramlog
      boolean DetEnableCallbacks: set at pre-compile, default-value=0  # Switches the Development Error Tracer callbacks interface ON or OFF
      boolean DetWrapRamlog: set at pre-compile, default-value=1  # True if the DET ramlog should wrap when reaching the end.
      boolean DetUseStdErr: set at pre-compile, default-value=0  # Switch ON / OFF the logging of errors to STDERR
      boolean DetDeInitAPI: set at pre-compile, default-value=0  # Enable / Disable the DeInitAPI of this module.
      integer DetNumberOfCallbacks: 1..255, set at pre-compile, default-value=5  # Specifies the number of callbacks that can be registered in DET.
      integer DetRamlogSize: 1..255, set at pre-compile, default-value=16  # Specifies the number of entries in the DET ramlog.
      boolean DetUseSafetyMonitor: set at pre-compile, default-value=0  # TRUE if DET should report errors to Safety Monitor
      function name DetReportRuntimeErrorCallout [0..*]: set at pre-compile  # This parameter defines the existence and the names of callout functions for the corresponding runtime error handler. | The type of these functions shall be identical the type of Det_ReportRuntimeError itself: Std_ReturnType (*f)(uint16, uint8, uint8, uint8)
      function name DetReportTransientFaultCallout [0..*]: set at pre-compile  # This parameter defines the existence and the names of callout functions for the corresponding transient fault handler. | The type of these functions shall be identical the type of Det_ReportTransientFault itself: Std_ReturnType (*f)(uint16, uint8, uint8, uint8)
      reference DetSafetyMonitorEventRef [0..1]: set at pre-compile, destination=OsEvent  # A reference to the OS Event that should be used to trigger Safety Monitor for new errors.
      reference DetSafetyMonitorTaskRef [0..1]: set at pre-compile, destination=OsTask  # A reference to the OS Task that executes the Safety Monitor.
    container DetNotification [0..1]  # Configuration of the notification functions.
      function name DetErrorHook [0..*]: set at pre-compile, set at pre-compile  # Optional list of functions to be called by the Development Error Tracer in context of each call of Det_ReportError. | The type of these functions shall be identical the type of Det_ReportError itself: Std_ReturnType (*f)(uint16, uint8, uint8, uint8).
    container ArcDetSwcPort [0..*]  # Container defining an interface port to a software component
      integer ModuleId: 4096..65535, set at link in variant link-time / pre-compile in variant pre-compile  # Defines the ModuleId used when SWC reports errors.
    container DetConfigSet [0..1]  # Configuration set container for Det.
      container DetModule [0..*]  # This container describes a non BSW module that is using the Det via Service Interface.
        integer DetModuleId: 4096..65535, set at pre-compile, symbolic-name-value=true  # Unique identifier of the error reporting component. When reporting errors to the DET, a symbolic name derived from the moduleID has to be used to identify the reporter.
        container DetModuleInstance [1..*]: multiplicity set at pre-compile, post-build-variant-multiplicity=true  # Describes the Instance used for the according Service Port. | It shall be used to differentiate software component instances when multiple instantiation is used.
          integer DetInstanceId: 0..255, set at pre-compile, default-value=0  # Describes the InstanceId used for the according Service Port. | It shall be used to differentiate software component instances when multiple instantiation is used. Else it shall be set to 0.
package /ArcCore/EcucDefs/Generic/Implementations
  bsw implementation Det: programming-language=C, sw-version=2.0.0, used-code-generator=diagnostic::Det::gen::Det::main, vendor-id=60, ar-release-version=4.3.0, vendor-specific-module-def=Det
