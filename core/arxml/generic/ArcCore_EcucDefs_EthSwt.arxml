AUTOSAR XML (schema 4-2-2)
package /ArcCore/EcucDefs/Generic
  module definition EthSwt [0..*]: refined-module-def=EthSwt, variants link-time/post-build/pre-compile  # Configuration of the EthSwt (Ethernet Switch Driver) module.
    container EthSwtConfig [1..*]  # Configuration of one Ethernet Switch.
      integer EthSwtIdx: 0..255, symbolic-name-value=true  # Specifies the instance ID of the configured Ethernet Switch.
      container EthSwtDemEventParameterRefs [0..1]  # Container for the references to DemEventParameter elements which shall be invoked using the API Dem_ReportErrorStatus in case the corresponding error occurs. The EventId is taken from the referenced DemEventParameter's DemEventId value. The standardized errors are provided in the container and can be extended by vendor specific error references.
        symbolic name reference ETHSWT_E_ACCESS [0..1]: destination=DemEventParameter  # Reference to the DemEventParameter which shall be issued when the error "Ethernet Switch Access Failure" has occurred.
      container EthSwtNvm [0..1]  # Configuration of one Ethernet Switch Nvm usage in case the module requires non volatile memory in the Ecu to store switch configuration.
        symbolic name reference EthSwtNvmBlockDescriptorRef: destination=NvMBlockDescriptor  # Reference to the Nvm block description in the Nvm module configuration.
      container EthSwtPort [1..*]  # Configuration of one Ethernet Switch Port.
        boolean EthSwtPortEnableLinkDownCallback  # Enables the callback <User>_LinkDown for this EthSwtPort if an IEEE802.1X link loss is detected. | <User> is defined by EthSwtLinkDownUser.
        integer EthSwtPortIdx: 0..255, symbolic-name-value=true  # Specifies the instance ID of the configured Ethernet Switch Port.
        enumeration EthSwtPortPhysicalLayerType: {ETHSWT_PORT_BASE_T, ETHSWT_PORT_BROAD_R_REACH, ETHSWT_PORT_RTPGE, ETHSWT_PORT_X_MII}  # Defines the physical layer type on this EthSwtPort.
        string EthSwtPortPredefinedMacAddresses [0..*]: regular-expression=[0-9a-fA-F]{2}[[:-][0-9a-fA-F]{2}]{5}  # Specifies a list of 48-bit physical addresses (MAC addresses) which can be reached via this port in network byte order. | Note that further addresses can be learned during runtime.
        enumeration EthSwtPortSpeed [0..1]: {ETHSWT_PORT_SPEED_10, ETHSWT_PORT_SPEED_100, ETHSWT_PORT_SPEED_1000}  # Defines the communication speed in Mbit per second on this EthSwtPort in case no EthSwtPortTrcvRef is defined. | Is optional if EthSwtPortTrcvRef is defined.
        symbolic name reference EthSwtPortTrcvRef [0..1]: destination=EthTrcvConfig  # Reference to the ethernet transceiver driver this EthSwtPort is connected with.
        container EthSwtPortEgress  # Configuration of one Ethernet Switch Port Egress behavior.
          reference EthSwtPortEgressLastSchedulerRef: destination=EthSwtPortScheduler  # Reference to the port scheduler which is the last in the egress port structure.
          container EthSwtPortFifo [1..*]  # Represents a Fifo in the egress port.
            integer EthSwtPortFifoTrafficClassAssignment [0..8]: 0..7  # Defines which traffic classes are assigned to this Fifo.
          container EthSwtPortScheduler [1..*]  # Represents a Scheduler in the egress port.
            enumeration EthSwtPortSchedulerAlgorithm: {ETHSWT_SCHEDULER_DEFICIT_ROUND_ROBIN, ETHSWT_SCHEDULER_STRICT_PRIORITY, ETHSWT_SCHEDULER_WEIGHTED_ROUND_ROBIN}  # Defines the scheduler algorithm.
            container EthSwtPortSchedulerPredecessor [1..*]  # Defines an ordered list of predecessors for this scheduler.
              integer EthSwtPortSchedulerPredecessorOrder: 0..18446744073709551615  # Defines the order of the scheduler predecessors.
              choice reference EthSwtPortEgressPredecessorRef: destination=[EthSwtPortFifo, EthSwtPortScheduler, EthSwtPortShaper]  # Choice reference to the scheduler predecessor.
          container EthSwtPortShaper [0..*]  # Represents a Shaper in the egress port.
            integer EthSwtPortShaperIdleSlope [0..1]: 0..18446744073709551615  # Defines the increase of credit in bits per second for the AVB shaper.
            reference EthSwtPortEgressPredecessorFifoRef: destination=EthSwtPortFifo  # Reference to the fifo which is the predecessor for this shaper.
          container EthSwtPortVlanForwarding [0..*]  # Defines how messages with a specific VLAN Id shall be handled at this egress port wrt. their VLAN Id.
            integer EthSwtPortVlanDefaultPriority: 0..7  # Determines the standard output-priority outgoing messages will be tagged with.
            integer EthSwtPortVlanForwardingId: 1..4094  # Determines the VLAN Id the VlanForwarding shall apply to.
            enumeration EthSwtPortVlanForwardingType: {ETHSWT_NOT_SENT, ETHSWT_SENT_TAGGED, ETHSWT_SENT_UNTAGGED}  # Defines how the message with a specific VLAN Id shall be handled.
        container EthSwtPortIngress  # Configuration of one Ethernet Switch Port ingress behavior.
          integer EthSwtPortIngressVlanModification [0..1]: 1..4094  # If this parameter is defined all messages which arrive at this ingress port will be tagged with this VLAN Id. This tagging happen also if the arriving message already has a VLAN Id, it will be overwritten by the defined one. | If this parameter is not defined no changes to the VLAN Id shall happen at this ingress port.
          integer EthSwtPortTrafficClassAssignment [0..1]: 0..7  # If this parameter is defined all arriving messages at this ingress port shall be assigned this traffic class. | If this parameter is not defined no general port based traffic class assignment is done.
          container EthSwtPriorityRegeneration [0..8]  # Defines a priority regeneration where the EthSwtPriorityRegenerationIngressPriority is replaced by EthSwtPriorityRegenerationRegeneratedPriority. | The EthSwtPriorityRegeneration is optional in case no priority regeneration shall be performed. In case a EthSwtPriorityRegeneration is defined it shall have 8 mappings, one for each priority.
            integer EthSwtPriorityRegenerationIngressPriority: 0..7  # Message priority of the incoming message.
            integer EthSwtPriorityRegenerationRegeneratedPriority: 0..7  # Message priority the incoming message will be tagged with.
          container EthSwtPriorityTrafficClassAssignment [0..8]  # Defines a priority based traffic class assignment. All messages with a specific priority (EthSwtPriorityTrafficClassAssignmentPriority) arriving at this ingress port or, if enabled regenerated priorities (EthSwtPriorityRegeneration), shall be assigned to a traffic class (EthSwtPriorityTrafficClassAssignmentTrafficClass).
            integer EthSwtPriorityTrafficClassAssignmentPriority: 0..7  # Message priority.
            integer EthSwtPriorityTrafficClassAssignmentTrafficClass: 0..7  # Traffic Class value.
      container EthSwtSpi [0..1]  # Configuration of one Ethernet Switch SPI access (if SPI is used).
        container EthSwtSpiSequence [1..*]  # Container gives EthSwt driver information about one SPI sequence. | One SPI sequence used by EthSwt driver is in exclusive use for it. No other driver is allowed to access this sequence. EthSwt driver may use one sequence to access n EthSwt hardware chips of the same type or n sequences are used to access one single EthSwt hardware chip. If a EthSwt hardware has no SPI interface, there is no instance of this container.
          boolean EthSwtSpiAccessSynchronous [0..1]  # This parameter is used to define whether the access to the Spi sequence is synchronous or asynchronous. | true: SPI access is synchronous. false: SPI access is asynchronous.
          symbolic name reference EthSwtSpiSequenceName [0..*]: destination=SpiSequence  # Reference to a Spi sequence configuration container.
    container EthSwtGeneral  # General configuration of Ethernet Switch Driver module.
      boolean EthSwtDevErrorDetect  # Switches the Default Error Tracer (Det) detection and notification ON or OFF. | * true: enabled (ON). * false: disabled (OFF).
      boolean EthSwtEnableVlanApi  # Enables / Disables EthSwt_EnableVLAN API.
      boolean EthSwtGetArlTableApi  # Enables / Disables EthSwt_GetArlTable API.
      boolean EthSwtGetBufferLevelApi  # Enables / Disables API to fetch the switch buffer utilization.
      boolean EthSwtGetDropCountApi  # Enables / Disables EthSwt_GetDropCount API.
      boolean EthSwtGetEtherStatsApi  # Enables / Disables EthSwt_GetEtherStats API.
      boolean EthSwtGetMacLearningModeApi  # Enables / Disables EthSwt_GetMacLearningMode API.
      boolean EthSwtGetPortMacAddrApi  # Enables / Disables EthSwt_GetPortMacAddr API.
      boolean EthSwtGetSwitchRegApi  # Enables / Disables EthSwt_GetSwitchReg API.
      integer EthSwtIndex: 0..255  # Specifies the InstanceId of this module instance. If only one instance is present it shall have the Id 0.
      function name EthSwtLinkDownUser [0..1]  # Defines the <User> function name for the <User>_LinkDown callback.
      function name EthSwtLinkUpUser [0..1]  # Defines the <User> function name for the <User>_LinkUp callback.
      boolean EthSwtPersistentConfigurationResult  # Enables / Disables the callback API <User>_PersistentConfigurationResult.
      function name EthSwtPersistentConfigurationResultUser [0..1]  # Defines the <User> function name for the <User>_PersistentConfigurationResult callback.
      string EthSwtPublicCddHeaderFile [0..*]: max-length=32, min-length=1  # Defines header files for callback functions which shall be included in case of CDDs.
      boolean EthSwtReadTrcvRegisterApi  # Enables / Disables EthSwt_ReadTrcvRegister API.
      boolean EthSwtResetConfigurationApi  # Enables / Disables EthSwt_ResetConfiguration API.
      boolean EthSwtSetMacLearningModeApi  # Enables / Disables EthSwt_SetMacLearningMode API.
      boolean EthSwtSetSwitchRegApi  # Enables / Disables EthSwt_SetSwitchReg API.
      boolean EthSwtStoreConfigurationApi  # Enables / Disables EthSwt_StoreConfiguration API.
      boolean EthSwtVersionInfoApi  # Enables / Disables version info API.
      boolean EthSwtWriteTrcvRegisterApi  # Enables / Disables EthSwt_WriteTrcvRegister API.
package /ArcCore/EcucDefs/Generic/Implementations
  bsw implementation EthSwt: programming-language=C, sw-version=1.0.0, used-code-generator=communication::EthIf::gen::EthIf::main, vendor-id=60, ar-release-version=4.2.2, vendor-specific-module-def=EthSwt
