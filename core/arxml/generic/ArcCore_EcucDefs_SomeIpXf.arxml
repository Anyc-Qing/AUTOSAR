AUTOSAR XML (schema 4-2-2)
# The material contained in this specification is protected by copyright and
# other types of Intellectual Property Rights. The commercial exploitation of the
# material contained in this specification requires a license to such
# Intellectual Property Rights.
# This specification may be utilized or reproduced without any modification, in
# any form or by any means, for informational purposes only. For any other
# purpose, no part of the specification may be utilized or reproduced, in any
# form or by any means, without permission in writing from the publisher.
# licensed under the same rules as applicable to the AUTOSAR Standard.
package /ArcCore/EcucDefs/Generic
  module definition SomeIpXf [0..*]: variants link-time/post-build/pre-compile
    container XfrmGeneral  # Contains the general configuration parameters of the module.
      boolean XfrmDevErrorDetect  # Switches the Default Error Tracer (Det) detection and notification ON or OFF. | * true: enabled (ON). * false: disabled (OFF).
      boolean ArcGenerateMessageMap [0..1]  # If ON generates a map between the pdu header id and the related inverse transformer. Used to decode SOME/IP data packets. | * true: enabled (ON). * false: disabled (OFF).
    container XfrmImplementationMapping [0..*]  # For each transformer (TransformationTechnology) in a transformer chain (DataTransformation) which is applied to an ISignal it is necessary to specify the BswModuleEntry which implements it. This is the container to hold these mappings.
      foreign reference XfmTransformationBswModuleEntryRef [0..1]: destination-type=BSW-MODULE-ENTRY  # This parameter is set to obsolete and will be removed in future. Please use XfrmTransformerBswModuleEntryRef instead. Tags: atp.Status=obsolete, atp.StatusRevisionBegin=4.2.2 | Old description: Reference to the BswModuleEntry which implements the referenced transformer on the sending/calling side. This element is obsolete and will be removed in a future revision.
      foreign reference XfrmInvTransformerBswModuleEntryRef [0..1]: destination-type=BSW-MODULE-ENTRY  # Reference to the BswModuleEntry which implements the referenced inverse transformer on the receiving/called side.
      foreign reference XfrmTransformationTechnologyRef: destination-type=TRANSFORMATION-TECHNOLOGY  # Reference to the TransformationTechnology in the DataTransformation of the system description for which the implementation (BswModuleEntry) shall be mapped.
      foreign reference XfrmTransformerBswModuleEntryRef [0..1]: destination-type=BSW-MODULE-ENTRY  # Reference to the BswModuleEntry which implements the referenced transformer on the sending/calling side.
      instance reference XfrmVariableDataPrototypeInstanceRef [0..1]: destination-context=SW-COMPONENT-PROTOTYPE PORT-PROTOTYPE, destination-type=VARIABLE-DATA-PROTOTYPE  # Instance Reference to a VariableDataPrototype in case a dedicated transformer BswModuleEntry is required per VariableDataPrototype access.
      container XfrmDemEventParameterRefs [0..1]  # Container for the references to DemEventParameter elements which shall be invoked using the API Dem_ReportErrorStatus API in case the corresponding error occurs. The EventId is taken from the referenced DemEventParameter's DemEventId value. The standardized errors are provided in the container and can be extended by vendor specific error references.
        symbolic name reference XFRM_E_MALFORMED_MESSAGE [0..1]: destination=DemEventParameter  # Reference to configured DEM event to report if malformed messages were received by the transformer.
      container XfrmSignal [0..1]  # Reference to the signal in the system description that transports the transformed data.
        choice container XfrmSignalChoice  # Choice whether an ISignal or an ISignalGroup shall be referenced.
          container XfrmISignalGroupRefChoice [0..1]  # Reference to the ISignalGroup in the system description that transports the transformed data.
            foreign reference XfrmISignalGroupRef: destination-type=I-SIGNAL-GROUP  # Reference to the ISignalGroup in the system description that transports the transformed data.
          container XfrmISignalRefChoice [0..1]  # Reference to the ISignal in the system description that transports the transformed data.
            foreign reference XfrmISignalRef: destination-type=I-SIGNAL  # Reference to the ISignal in the system description that transports the transformed data.
package /ArcCore/EcucDefs/Generic/Implementations
  bsw implementation SomeIpXf: programming-language=C, used-code-generator=@SomeIpXfGenerator, vendor-id=60, vendor-specific-module-def=SomeIpXf
