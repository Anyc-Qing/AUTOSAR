AUTOSAR XML (schema 4-2-2)
package /AUTOSAR/AISpecification/LifeCycleInfoSets
  life cycle info set KeywordObslt: default-lc-state=obsolete, used-life-cycle-state-definition-group=AutosarLifeCycleStates
    life-cycle-infos:
      lc-object=Ar, period-begin=ar-release-version=4.1.1, remark=p=l-1=harmonisation with basic software abbreviations, use-instead=Area
      lc-object=Gen, period-begin=ar-release-version=4.1.1, remark=p=l-1=harmonisation with generate, generation, generated, generator, use-instead=Generic
      lc-object=Us, period-begin=ar-release-version=4.1.1, remark=p=l-1=Set to obsolete because there might be a different pair of keywords for upstream and downstream in the future
      lc-object=Wind, period-begin=ar-release-version=4.1.1, remark=p=l-1=correction according naming rules, To use Windscreen, please build the short name of the keyword abbreviations of Wind and Screen., use-instead=[Wind1, Scrn]
      lc-object=Sts, lc-state=obsolete, period-begin=ar-release-version=4.2.1, use-instead=St
      lc-object=Sec, lc-state=obsolete, period-begin=ar-release-version=4.2.1, use-instead=Idx2nd
