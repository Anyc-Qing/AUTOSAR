AUTOSAR XML (schema 4-2-2)
package /AUTOSAR/AISpecification/PhysicalDimensions
  21 x physical dimension:
    Amnt1: molar-amount-exp=1  # Quantity of substance 1
    I1: current-exp=1  # Electric current 1
    Illmn1: luminous-intensity-exp=1  # Luminous intensity 1
    Len1: length-exp=1  # Length 1
    Len1M1TiNeg2: length-exp=1, mass-exp=1, time-exp=-2  # Length 1 Mass 1 Time -2
    Len1TiNeg{1..3}: length-exp=1, time-exp=-{1..3}  # Length 1 Time -{1..3}
    Len2M1TiNeg2: length-exp=2, mass-exp=1, time-exp=-2  # Length 2 Mass 1 Time -2
    Len2M1TiNeg3: length-exp=2, mass-exp=1, time-exp=-3  # Length 2 Mass 1 Time -3
    Len2M1TiNeg3INeg1: length-exp=2, mass-exp=1, time-exp=-3, current-exp=-1  # Length 2 Mass 1 Time -3 Electric current -1
    LenNeg1: length-exp=-1  # Length -1
    LenNeg1M1TiNeg2: length-exp=-1, mass-exp=1, time-exp=-2  # Length -1 Mass 1 Time -2
    M1: mass-exp=1  # Mass 1
    M1TiNeg1: mass-exp=1, time-exp=-1  # Mass 1 Time -1
    M1TiNeg2: mass-exp=1, time-exp=-2  # Mass 1 Time -2
    NoDimension  # No Dimension
    T1: temperature-exp=1  # Temperature 1
    Ti1: time-exp=1  # Time 1
    TiNeg1: time-exp=-1  # Time -1
    TiNeg2: time-exp=-2  # Time -2
