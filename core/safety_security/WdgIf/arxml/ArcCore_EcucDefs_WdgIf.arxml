AUTOSAR XML (schema 4-2-2)
package /ArcCore/EcucDefs/Generic
  module definition WdgIf [0..1]: refined-module-def=WdgIf, variants pre-compile  # Configuration of the WdgIf (Watchdog Interface) module.
    container WdgIfDevice [1..*]  # It contains the information for the selection of a particular Watchdog device in case multiple Watchdog drivers are connected.
      integer WdgIfDeviceIndex: 0..255, set at pre-compile, symbolic-name-value=true  # Represents the watchdog interface ID so that it can be referenced by the watchdog manager.
      symbolic name reference WdgIfDriverRef: set at pre-compile, destination=WdgGeneral  # Reference to the watchdog drivers that are controlled by the watchdog interface.
    container WdgIfGeneral  # This container collects all generic watchdog interface parameters.
      boolean WdgIfDevErrorDetect: set at pre-compile, default-value=1  # Pre-processor switch for enabling the development error detection and reporting. | true: Development error detection enabled false: Development error detection disabled
      boolean WdgIfVersionInfoApi: set at pre-compile, default-value=0  # Pre-processor switch to enable / disable the service returning the version information. | true: Version information service enabled false: Version information service disabled
package /ArcCore/EcucDefs/Generic/Implementations
  bsw implementation WdgIf: programming-language=C, sw-version=2.0.0, used-code-generator=safety_security::WdgIf::gen::WdgIf::main, vendor-id=60, ar-release-version=4.3.0, vendor-specific-module-def=WdgIf
