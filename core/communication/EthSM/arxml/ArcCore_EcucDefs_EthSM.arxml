AUTOSAR XML (schema 4-2-2)
package /ArcCore/EcucDefs/Generic
  module definition EthSM [0..1]: refined-module-def=EthSM, variants pre-compile  # Configuration of the Ethernet State Manager
    container EthSMGeneral  # This container contains the global parameter of the Ethernet State Manager.
      boolean EthSMDevErrorDetect  # Switches the Default Error Tracer (Det) detection and notification ON or OFF. | * true: enabled (ON). * false: disabled (OFF).
      boolean EthSMDummyMode  # Disables the API to the EthIf. The API to the ComM is available but the functionality is deactivated. The function calls from the ComM will be answered with the return value E_OK.
      float EthSMMainFunctionPeriod: 0.005..1  # Specifies the period in seconds that the MainFunction has to be triggered with.
      boolean EthSMVersionInfoApi  # Enables and disables the version info API.
    container EthSMNetwork [1..*]  # This container contains the Ethernet network-specific parameters of each Ethernet network. It also contains the controller and transceiver IDs assigned to a Ethernet network.
      symbolic name reference EthSMComMNetworkHandleRef: destination=ComMChannel  # Unique handle to identify one certain Ethernet network. Reference to one of the network handles configured for the ComM.
      symbolic name reference EthSMEthIfControllerRef: destination=EthIfController  # Reference to EthIfCtrl container where a ETH controller and | transceiver (optional) combination is configured.
      container EthSMDemEventParameterRefs [0..1]  # Container for the references to DemEventParameter elements which shall be invoked using the API Dem_ReportErrorStatus API in case the corresponding error occurs. The EventId is taken from the referenced DemEventParameter's DemEventId value. The standardized errors are provided in the container and can be extended by vendor specific error references.
        symbolic name reference ETHSM_E_LINK_DOWN [0..1]: destination=DemEventParameter  # Reference to configured DEM event to report bus off errors for this Eth network.
package /ArcCore/EcucDefs/Generic/Implementations
  bsw implementation EthSM: programming-language=C, sw-version=2.0.0, used-code-generator=communication::EthSM::gen::EthSM::main, vendor-id=60, ar-release-version=4.2.2, vendor-specific-module-def=EthSM
