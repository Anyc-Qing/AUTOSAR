AUTOSAR XML (schema 4-2-2)
package /ArcCore/EcucDefs/Generic
  module definition ComM [0..1]: refined-module-def=ComM, variants pre-compile/post-build  # Configuration of the ComM (Communications Manager) module.
    container ComMConfigSet: multiple-configuration-container=true  # This container is the base for a multiple configuration set.
      boolean ComMPncEnabled [0..1]: set at post-build in variant post-build / pre-compile in variant pre-compile, default-value=0  # Defines whether in this configuration set the partial networking is enabled. | true: Enabled false: Disabled
      container ComMChannel [1..*]  # This container contains the configuration (parameters) of the bus channel(s). The channel parameters shall be harmonized within the whole communication stack.
        enumeration ComMBusType: {COMM_BUS_TYPE_CAN, COMM_BUS_TYPE_ETH, COMM_BUS_TYPE_FR, COMM_BUS_TYPE_INTERNAL, COMM_BUS_TYPE_LIN}, set at pre-compile  # Identifies the bus type of the channel.
        integer ComMChannelId: 0..255, set at pre-compile, symbolic-name-value=true  # Channel identification number of the corresponding channel.
        boolean ComMFullCommRequestNotificationEnabled: set at pre-compile, default-value=0  # Defines if the optional SenderReceiver Port of Interface ComM_CurrentChannelRequest will be provided for this channel. | True means enabled. False means disabled
        boolean ComMGlobalNvmBlockDescriptor: set at pre-compile, default-value=0  # If this parameter is set to "true", the NoWakeUp inhibition state of the channel shall be stored (in some implementation specific way) in the block pointed to by ComMGlobalNvmBlockDescriptor.
        float ComMMainFunctionPeriod: 0.001..0.1, set at pre-compile, default-value=0.02  # Specifies the period in seconds that the MainFunction has to be triggered with. | Comment: ComM scheduling shall be at least as fast as the communication stack and a schedule longer than 100ms makes no sense for communication.
        boolean ComMNoCom: set at pre-compile, default-value=0  # Not allowed to change state of ComM channel to COMM_SILENT_COMMUNICATION or COMM_FULL_COMMUNICATION. | true: Enabled - Not allowed to switch to Communication Modes above. false: Disabled - Allowed to switch Communication Modes above. Shall be possible to change parameter during runtime with ComM API's. ECU/All channels: ComM_LimitECUToNoComMode(). Separate channels: ComM_LimitChannelToNoComMode().
        boolean ComMNoWakeup: set at pre-compile, default-value=0  # Defines if an ECU is not allowed to wake-up the channel. | true: Enabled (not allowed to wake-up)) false: Disabled This is the default/init value of a runtime variable that can be changed during runtime using ComM_PreventWakeUp().
        enumeration ComMPncGatewayType [0..1]: {COMM_GATEWAY_TYPE_ACTIVE, COMM_GATEWAY_TYPE_PASSIVE}, set at pre-compile  # Identifies the Partial Network Gateway behaviour of a ComMChannel.
        container ComMNetworkManagement  # This container contains the configuration parameters of the networkmanagement.
          float ComMNmLightTimeout [0..1]: 0..255, set at pre-compile, default-value=10  # Defines the timeout (in seconds) after COMM_FULL_COMMUNICATION sub-state COMM_FULL_COM_READY_SLEEP is left. | The range shall be greater than 0.0 and less or equal to 255.0.
          enumeration ComMNmVariant: {FULL, LIGHT, NONE, PASSIVE}, set at pre-compile, default-value=FULL  # Defines the functionality of the networkmanagement. | Shall be harmonized with NM configuration.
          boolean ComMPncNmRequest: set at pre-compile, default-value=0  # If this parameter equals true then every time a FULL Communication is requested due to a change in the PNC state machine to PNC_REQUESTED Nm shall be called using the API Nm_NetworkRequest.
        container ComMUserPerChannel [0..*]  # This container contains a list of identifiers that are needed to refer to a user in the system which is linked to a channel.
          reference ComMUserChannel: set at pre-compile, destination=ComMUser  # Reference to the ComMUser that corresponds to this channel user. | ImplementationType: COMM_UserHandleType
      container ComMPnc [0..*]  # This container contains the configuration of the partial network cluster (PNC).
        integer ComMPncId: 0..63, set at pre-compile, symbolic-name-value=true  # Partial network cluster identification number.
        reference ComMChannelPerPnc [1..*]: set at post-build in variant post-build / pre-compile in variant pre-compile, destination=ComMChannel  # Reference to the ComMChannel that is required for this PNC. | ImplementationType: COMM_ChannelType
        reference ComMUserPerPnc [0..*]: set at post-build in variant post-build / pre-compile in variant pre-compile, destination=ComMUser  # Reference to the ComMUsers that correspond to this PNC. | ImplementationType: COMM_UserHandleType
        container ComMPncComSignal [0..*]  # Represents the PncComSignals which are used to communicate the EIRA and ERA status of this PNC.
          enumeration ComMPncComSignalDirection: {RX, TX}, set at pre-compile  # Indicates the communication direction of this PncComSignal.
          enumeration ComMPncComSignalKind: {EIRA, ERA}, set at pre-compile  # Indicates whether this PncComSignal represents EIRA or ERA PNC information.
          reference ComMPncComSignalChannelRef [0..1]: set at pre-compile, destination=ComMChannel  # Reference to the ComMChannel which is used to determine whether this PncComSignal shall participate in the active or passive role (via the parameter ComMPncGatewayType of the ComMChannel). | Not applicable if ComMPncComSignalKind is EIRA.
          symbolic name reference ComMPncComSignalRef: set at pre-compile, destination=ComSignal  # Reference to the ComSignal which is used to transport the partial network channel request information.
      container ComMUser [1..*]  # This container contains a list of identifiers that are needed to refer to a user in the system which is designated to request Communication modes.
        integer ComMUserIdentifier: 0..255, set at pre-compile, symbolic-name-value=true  # An identifier that is needed to refer to a user in the system which is designated to request Communication Modes. | ImplementationType: ComM_UserHandleType
        reference ComMUserEcucPartitionRef [0..1]: set at pre-compile, destination=EcucPartition  # Denotes in which "EcucPartition" the requester is executed. When the | partition is stopped, the communication request shall be cancelled in the ComM to avoid a stay-awake situation of the bus due to a stopped partition.
    container ComMGeneral  # General configuration parameters of the Communication Manager.
      boolean ComMNoCom: set at pre-compile, default-value=0  # Switches the Development Error Detection and Notification ON or OFF. | The ECU is not allowed to change state of the ECU to "Silent Communication" or "Full Communication".
      boolean ComMDirectUserMapping [0..1]: set at pre-compile, default-value=0  # If this parameter is set to true the configuration tool shall automatically create a ComMUser per ComMPnc and a ComMUser per ComMChannel. | The shortName of the generated ComMUsers shall follow the following naming convention: PNCUser_ComMPncId, e.g. PNCUser_13 ChannelUser_ComMChannelId, e.g. ChannelUser_25 Restriction: ComMUser, which are created due to this configuration parameter, shall not be used by SWCs (only available for BswM).
      integer ComMEcuGroupClassification: 0..255, set at pre-compile, default-value=3  # Defines whether a mode inhibition affects the ECU or not. | Examples: 000: No mode inhibition can be activated 001: Wake up inhibition can be enabled Forcing into COMM_NO_COMMUNICATION mode shall be switched on if ComMNmVariant=PASSIVE.
      boolean ComMModeLimitationEnabled: set at pre-compile, default-value=0  # true if mode limitation functionality shall be enabled. | true: Enabled false: Disabled
      boolean ComMPncGatewayEnabled [0..1]: set at pre-compile, default-value=0  # Enables or disables support of Partial Network Gateway. | False: Partial Networking Gateway is disabled True: Partial Networking Gateway is enabled
      float ComMPncPrepareSleepTimer [0..1]: 0..63, set at pre-compile, default-value=1  # Time in seconds the PNC state machine shall wait in PNC_PREPARE_SLEEP.
      boolean ComMPncSupport: set at pre-compile, default-value=0  # Enables or disables support of partial networking. | False: Partial Networking is disabled True: Partial Networking is enabled
      boolean ComMSynchronousWakeUp: set at pre-compile, default-value=1  # Wake up of one channel shall lead to a wake up of all channels if true. | true: Enabled false: Disabled
      float ComMTMinFullComModeDuration: 0.001..65, set at pre-compile, default-value=5.0  # Minimum time duration in seconds, spent in the COMM_FULL_COMMUNICATION sub-state COMM_FULL_COM_NETWORK_REQUESTED.
      boolean ComMVersionInfoApi: set at pre-compile, default-value=0  # Switches the possibility to read the published information with the service ComM_GetPublishedInformation(). | true: Enabled false: Disabled
      boolean ComMWakeupInhibitionEnabled: set at pre-compile, default-value=0  # true if wake up inhibition functionality enabled. | true: Enabled false: Disabled
      boolean ComMDevErrorDetect: set at pre-compile, default-value=1  # Switches the Development Error Detection and Notification ON or OFF.
      boolean ArcComMASRCompatibilityLessThan4_2: set at pre-compile, default-value=1  # Switch between ComM ASR compatibility less than v4.2.2 is supported or not. If TRUE, supports version less than 4.2.2 If FALSE, version 4.2.2 and above are supported. In version 4.0.3,PNC id range is 0-47 In version 4.2.2 PNC id range is 8 -63 | True: Enabled False: Disabled
      integer ArcComMPncVectorOffset [0..1]: 0..7, set at pre-compile, default-value=1  # The ArcComMPncVectoroffset value should match the value <module>NmPnInfoOffset value in <module>Nm module. Example : In CanNm module the CanNmPnInfoOffset value should match the ArcComMPncVectorOffset. | This should be configured if ArcComMASRCompatibilityLessThan4_2 is False
      symbolic name reference ComMGlobalNvMBlockDescriptor [0..1]: set at pre-compile, destination=NvMBlockDescriptor  # Reference to NVRAM block containing the none volatile data. If this parameter is not configured it means that no NVRam is used at all.
package /ArcCore/EcucDefs/Generic/Implementations
  bsw implementation ComM: programming-language=C, sw-version=3.0.1, used-code-generator=communication::ComM::gen::ComM::main, vendor-id=60, ar-release-version=4.0.3, vendor-specific-module-def=ComM
