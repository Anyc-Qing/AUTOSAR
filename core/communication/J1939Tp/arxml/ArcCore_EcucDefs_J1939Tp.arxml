AUTOSAR XML (schema 4-2-2)
package /ArcCore/EcucDefs/Generic
  module definition J1939Tp [0..1]: variants link-time/post-build/pre-compile  # Configuration of the J1939Tp (J1939 Transport Protocol) module.
    container J1939TpConfiguration: multiple-configuration-container=true  # This container contains the configuration parameters and sub containers of the J1939Tp module that define the communication paths. This container is a MultipleConfigurationContainer, i.e. this container and its sub-containers exist once per configuration set.
      container J1939TpDemEventParameterRefs [0..1]  # Container for the references to DemEventParameter elements which shall be passed to the API Dem_ReportErrorStatus. The EventId is taken from the referenced DemEventParameter's DemEventId value. | The standardized errors are provided in the container and can be extended by vendor specific error references.
        symbolic name reference J1939TP_E_COMMUNICATION [0..1]: set at post-build in variant link-time+post-build / pre-compile in variant pre-compile, destination=DemEventParameter  # Reference to the DemEventParameter which shall be issued after successful or unsuccessful communication.
      container J1939TpRxChannel [0..*]  # This container describes a reception channel of the J1939Tp module. One channel is used for all N-SDUs that share the same source address (SA) and the same destination address (BAM: DA = 0xFF, CMDT: DA != 0xFF).
        enumeration J1939TpRxProtocolType: {J1939TP_PROTOCOL_BAM, J1939TP_PROTOCOL_CMDT}, set at pre-compile  # Protocol type of the referencing connection, which is either BAM or CMDT. | Please note: The protocol type is determined at configuration time by the PDU format of the PGN of an N-SDU: If the first byte of the PGN is smaller than 0xF0, CMDT will be used, otherwise BAM.
        container J1939TpRxCmNPdu  # This N-PDU represents the TP.CM frame of a J1939 transport protocol session. TP.CM is used both by BAM and CMDT to initialize the connection. For CMDT, it is also used to abort the connection.
          integer J1939TpRxCmNPduId: 0..65535, set at link in variant link-time / post-build in variant post-build / pre-compile in variant pre-compile, symbolic-name-value=true  # The N-PDU identifier used for communication with CanIf.
          reference J1939TpRxCmNPduRef: set at post-build in variant link-time+post-build / pre-compile in variant pre-compile, destination=Pdu  # Reference to the Pdu object representing the N-PDU.
        container J1939TpRxDtNPdu  # This N-PDU represents the TP.DT frame of a J1939 transport protocol session. TP.DT is used both by BAM and CMDT to transfer the contents of an N-SDU.
          integer J1939TpRxDtNPduId: 0..65535, set at link in variant link-time / post-build in variant post-build / pre-compile in variant pre-compile, symbolic-name-value=true  # The N-PDU identifier used for communication with CanIf.
          reference J1939TpRxDtNPduRef: set at post-build in variant link-time+post-build / pre-compile in variant pre-compile, destination=Pdu  # Reference to the Pdu object representing the N-PDU.
        container J1939TpRxPg [1..*]
          boolean J1939TpRxPgDynLength: set at pre-compile  # This flag is set to TRUE when the N-SDU refers to a PGN with variable length. | Please note: When this attribute is TRUE, the sub container J1939TpRxDirectNPdu is required.
          integer J1939TpRxPgPGN: 0..262143, set at pre-compile  # Defines the PGN which is represented by the N-SDU.
          container J1939TpRxDirectNPdu [0..1]  # This N-PDU represents the short frame that is used for a dynamic length PGN when it has a length of less that 8 bytes. | Please note: This sub container is only necessary when J1939TpRxPgDynLength is TRUE.
            integer J1939TpRxDirectNPduId: 0..65535, set at link in variant link-time / post-build in variant post-build / pre-compile in variant pre-compile, symbolic-name-value=true  # The N-PDU identifier used for communication with CanIf.
            reference J1939TpRxDirectNPduRef: set at post-build in variant link-time+post-build / pre-compile in variant pre-compile, destination=Pdu  # Reference to the Pdu object representing the N-PDU.
          container J1939TpRxNSdu  # This container describes the parameters that are relevant for the reception of a specific N-SDU.
            reference J1939TpRxNSduRef: set at post-build in variant link-time+post-build / pre-compile in variant pre-compile, destination=Pdu  # Reference to the Pdu object representing the N-SDU.
        container J1939TpTxFcNPdu [0..1]  # This N-PDU represents the TP.CM frame that is used in reverse direction for a J1939 transport protocol session using the CMDT protocol type. TP.CM in reverse direction is used for intermediate and final acknowledgement of received data and to abort the connection. | Please note: This sub container is only required when J1939TpRxProtocolType is J1939TP_PROTOCOL_CMDT.
          integer J1939TpTxFcNPduTxConfId: 0..65535, set at link in variant link-time / post-build in variant post-build / pre-compile in variant pre-compile, symbolic-name-value=true  # The N-PDU identifier used for Tx confirmation from CanIf.
          reference J1939TpTxFcNPduRef: set at post-build in variant link-time+post-build / pre-compile in variant pre-compile, destination=Pdu  # Reference to the Pdu object representing the N-PDU. | Please note: When two channels have identical but exchanged source and destination addresses, the Pdu referenced by this parameter is shared with J1939TpTxCmNPduRef of the corresponding J1939TpTxChannel.
      container J1939TpTxChannel [0..*]  # This container describes a transmission channel of the J1939Tp module. One channel is used for all N-SDUs that share the same source address (SA) and the same destination address (BAM: DA = 0xFF, CMDT: DA != 0xFF).
        enumeration J1939TpTxProtocolType: {J1939TP_PROTOCOL_BAM, J1939TP_PROTOCOL_CMDT}, set at pre-compile  # Protocol type of the referencing connection, which is either BAM or CMDT. | Please note: The protocol type is determined at configuration time by the PDU format of the PGN of an N-SDU: If the first byte of the PGN is smaller than 0xF0, CMDT will be used, otherwise BAM.
        container J1939TpRxFcNPdu [0..1]  # This N-PDU represents the TP.CM frame that is used in reverse direction for a J1939 transport protocol session using the CMDT protocol type. TP.CM in reverse direction is used for intermediate and final acknowledgement of received data and to abort the connection. | Please note: This sub container is only required when J1939TpRxProtocolType is J1939TP_PROTOCOL_CMDT.
          integer J1939TpRxFcNPduId: 0..65535, set at link in variant link-time / post-build in variant post-build / pre-compile in variant pre-compile, symbolic-name-value=true  # The N-PDU identifier used for communication with CanIf.
          reference J1939TpRxFcNPduRef: set at post-build in variant link-time+post-build / pre-compile in variant pre-compile, destination=Pdu  # Reference to the Pdu object representing the N-PDU. | Please note: When two channels have identical but exchanged source and destination addresses, the Pdu referenced by this parameter is shared with J1939TpRxCmNPduRef of the corresponding J1939TpRxChannel.
        container J1939TpTxCmNPdu  # This N-PDU represents the TP.CM frame of a J1939 transport protocol session. TP.CM is used both by BAM and CMDT to initialize the connection. For CMDT, it is also used to abort the connection.
          integer J1939TpTxCmNPduTxConfId: 0..65535, set at link in variant link-time / post-build in variant post-build / pre-compile in variant pre-compile, symbolic-name-value=true  # The N-PDU identifier used for Tx confirmation from CanIf.
          reference J1939TpTxCmNPduRef: set at post-build in variant link-time+post-build / pre-compile in variant pre-compile, destination=Pdu  # Reference to the Pdu object representing the N-PDU.
        container J1939TpTxDtNPdu  # This N-PDU represents the TP.DT frame of a J1939 transport protocol session. TP.DT is used both by BAM and CMDT to transfer the contents of an N-SDU.
          integer J1939TpTxDtNPduTxConfId: 0..65535, set at link in variant link-time / post-build in variant post-build / pre-compile in variant pre-compile, symbolic-name-value=true  # The N-PDU identifier used for Tx confirmation from CanIf.
          reference J1939TpTxDtNPduRef: set at post-build in variant link-time+post-build / pre-compile in variant pre-compile, destination=Pdu  # Reference to the Pdu object representing the N-PDU.
        container J1939TpTxPg [1..*]
          boolean J1939TpTxPgDynLength: set at pre-compile  # This flag is set to TRUE when the N-SDU refers to a PGN with variable length. | Please note: When this attribute is TRUE, the sub container J1939TpTxDirectNPdu is required.
          integer J1939TpTxPgPGN: 0..262143, set at pre-compile  # Defines the PGN which is represented by the N-SDU.
          container J1939TpTxDirectNPdu [0..1]  # This N-PDU represents the short frame that is used for a dynamic length PGN when it has a length of less that 8 bytes. | Please note: This sub container is only necessary when J1939TpTxPgDynLength is TRUE.
            integer J1939TpTxDirectNPduTxConfId: 0..65535, set at link in variant link-time / post-build in variant post-build / pre-compile in variant pre-compile, symbolic-name-value=true  # The N-PDU identifier used for Tx confirmation from CanIf.
            reference J1939TpTxDirectNPduRef: set at post-build in variant link-time+post-build / pre-compile in variant pre-compile, destination=Pdu  # Reference to the Pdu object representing the N-PDU.
          container J1939TpTxNSdu  # This container describes the parameters that are relevant for the transmission of a specific N-SDU.
            integer J1939TpTxNSduId: 0..65535, set at link in variant link-time / post-build in variant post-build / pre-compile in variant pre-compile, symbolic-name-value=true  # The N-SDU identifier used for communication with PduR.
            reference J1939TpTxNSduRef: set at post-build in variant link-time+post-build / pre-compile in variant pre-compile, destination=Pdu  # Reference to the Pdu object representing the N-SDU.
    container J1939TpGeneral  # This container describes the general configuration parameters of the J1939Tp module.
      boolean J1939TpCancellationSupport: set at pre-compile, default-value=False  # Enable transmit and receive cancellation. The APIs J1939Tp_CancelTransmit() and J1939Tp_CancelReceive() will only be available when this parameter is enabled.
      boolean J1939TpDevErrorDetect: set at pre-compile, default-value=1  # Switches the Development Error Detection and Notification.
      boolean J1939TpDynamicBlockCalculation: set at pre-compile, default-value=False  # Enable dynamic calculation of packets per block values in TP.CM_RTS and TP.CM_CTS, based on the size of buffers in upper layers reported via StartOfReception, CopyRxData, and CopyTxData.
      float J1939TpMainFunctionPeriod: 0..0.255, set at pre-compile  # Allow to configure the time for the MainFunction (in seconds). | Please note: This configuration value shall be equal to the value in the ScheduleManager module.
      integer J1939TpMaxPacketsPerBlock: 2..255, set at pre-compile, default-value=255  # Maximum number of N-PDUs the J1939Tp shall send before waiting for an authorization to continue transmission of the following TP.DT frames. This parameter is only relevant the transmission of messages via CMDT. For further details on this parameter value see SAE J1939/21.
      integer J1939TpPacketsPerBlock: 2..255, set at pre-compile, default-value=16  # Number of N-PDUs the J1939Tp module allows the sender to send before waiting for an authorization to continue transmission of the following TP.DT frames. This parameter is only relevant for reception of messages via CMDT. For further details on this parameter value see SAE J1939/21.
      float J1939TpTxConfTimeout: 0..65.535, set at pre-compile  # Timeout in seconds for the CanIf Tx confirmation. After this time the J1939Tp assumes that an N-PDU could not be transmitted. | Please note: The Tx confirmation timeout should be set to a value that enabled detection of a lost Tx confirmation in time, and that ensures that normal transmission delay caused by lower message priority does not lead to an error.
      boolean J1939TpVersionInfoApi: set at pre-compile, default-value=False  # The function J1939Tp_GetVersionInfo is configurable (On/Off) by this configuration parameter.
package /ArcCore/EcucDefs/Generic/Implementations
  bsw implementation J1939Tp: programming-language=C, sw-version=1.0.0, used-code-generator=communication::J1939Tp::gen::J1939Tp::main, vendor-id=60, ar-release-version=4.1.2, vendor-specific-module-def=J1939Tp
