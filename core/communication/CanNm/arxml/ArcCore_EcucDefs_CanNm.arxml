AUTOSAR XML (schema 4-2-2)
package /ArcCore/EcucDefs/Generic
  module definition CanNm [0..1]: refined-module-def=CanNm, variants post-build  # Configuration Parameters for the Can Nm module.
    container CanNmGlobalConfig: multiple-configuration-container=true  # This container contains the global configuration parameter of the CanNm. The parameters and the parameters of the sub containers shall be mapped to the C data type CanNm_ConfigType (for parameters where it is possible) which is passed to the CanNm_Init function. | This container is a MultipleConfigurationContainer (only for variant 3), i.e. this container and its sub-containers exit once per configuration set.
      boolean CanNmBusLoadReductionEnabled: set at pre-compile, default-value=0  # Pre-processor switch for enabling busload reduction support.
      boolean CanNmBusSynchronizationEnabled: set at pre-compile, default-value=0  # Pre-processor switch for enabling bus synchronization support. This feature is required for gateway nodes only. | calculationFormula = If (CanNmPassiveModeEnabled == False) then Equal(NmBusSynchronizationEnabled) else Equal(False)
      boolean CanNmComControlEnabled: set at pre-compile, default-value=0  # Pre-processor switch for enabling the Communication Control support. | calculationformula = Equal(NmComControlEnabled)
      boolean CanNmComUserDataSupport: set at pre-compile, default-value=0  # Enable/disable the user data support.
      boolean CanNmCoordinatorSyncSupport: set at pre-compile, default-value=0  # Enables/disables the coordinator synchronisation support.
      boolean CanNmDevErrorDetect: set at pre-compile, default-value=1  # Pre-processor switch for enabling development error detection support.
      boolean CanNmImmediateRestartEnabled: set at pre-compile  # Pre-processor switch for enabling the asynchronous transmission of a NM PDU upon bus-communication request in Prepare-Bus-Sleep mode.
      boolean CanNmImmediateTxconfEnabled: set at pre-compile, default-value=0  # Enable/disable the immediate tx confirmation.
      float CanNmMainFunctionPeriod: 0.001..0.255, set at link in variant link-time+post-build / pre-compile in variant pre-compile+post-build  # Call cycle in seconds of CanNm_MainFunction.
      boolean CanNmNodeDetectionEnabled: set at pre-compile, default-value=0  # Precompile time switch to enable the node detection feature.
      integer CanNmNumberOfChannels: 1..255, set at pre-compile, default-value=1  # Number of Can NM channels allowed within one ECU.
      boolean CanNmPassiveModeEnabled: set at pre-compile, default-value=0  # Pre-processor switch for enabling support of the Passive Mode. | calculationFormula = Equal(NmPassiveModeEnabled)
      boolean CanNmPduRxIndicationEnabled: set at pre-compile, default-value=0  # Pre-processor switch for enabling the PDU Rx Indication. | calculationFormula = Equal(NmPduRxIndicationEnabled)
      boolean CanNmPnEiraCalcEnabled [0..1]: set at pre-compile, default-value=0  # Specifies if CanNm calculates the PN request information for internal an external requests. (EIRA) | true: PN request are calculated false: PN request are not calculated
      float CanNmPnResetTime [0..1]: 0.001..65.535, set at link in variant link-time+post-build / pre-compile in variant pre-compile  # Specifies the runtime of the reset timer in seconds. This reset time is valid for the reset of PN requests in the EIRA and in the ERA. The value shall be the same for every channel. Thus it is a global config parameter.
      boolean CanNmRemoteSleepIndEnabled: set at pre-compile, default-value=0  # Pre-processor switch for enabling remote sleep indication support. This feature is required for gateway nodes only. | calculationFormula = If (CanNmPassiveModeEnabled == False) then Equal(NmRemoteSleepIndEnabled) else Equal(False)
      boolean CanNmRepeatMsgIndEnabled: set at pre-compile, default-value=0  # Enable/disable the notification that a RepeatMessageRequest bit has been received. | calculationformula = Equal(NmRepeatMsgIndEnabled)
      boolean CanNmStateChangeIndEnabled: set at pre-compile, default-value=0  # Pre-processor switch for enabling the CAN NM state change notification. | calculationFormula = Equal(NmStateChangeIdEnabled)
      boolean CanNmUserDataEnabled: set at pre-compile, default-value=0  # Pre-processor switch for enabling user data support. | calculationFormula = Equal(NmUserDataEnabled)
      boolean CanNmVersionInfoApi: set at pre-compile, default-value=0  # Pre-processor switch for enabling version info API support.
      reference CanNmPnEiraRxNSduRef [0..1]: set at link in variant link-time+post-build / pre-compile in variant pre-compile, destination=Pdu  # Reference to a Pdu in the COM-Stack. | Only one SduRef is required for CanNm because the EIRA is the aggregation over all Can Channels.
      container CanNmChannelConfig [1..*]  # This container contains the channel specific configuration parameter of the CanNm.
        boolean CanNmAllNmMessagesKeepAwake [0..1]: set at link in variant link-time+post-build / pre-compile in variant pre-compile, default-value=0  # Specifies if CanNm drops irrelevant NM messages. | false: Only NM messages with an with CRI bit = true and containing an PN request for this ECU triggers the standard RX indication handling true: Every NM message triggers the standard RX indication handling
        boolean CanNmBusLoadReductionActive: set at link in variant link-time+post-build / pre-compile in variant pre-compile, default-value=0  # This parameter defines if bus load reduction for the respective NM channel is active or not.
        integer CanNmCarWakeUpBitPosition [0..1]: 0..7, set at link in variant link-time+post-build / pre-compile in variant pre-compile  # Specifies the Bit position of the CWU within the NM-Message.
        integer CanNmCarWakeUpBytePosition [0..1]: 2..7, set at link in variant link-time+post-build / pre-compile in variant pre-compile  # Specifies the Byte position of the CWU within the NM-Message.
        boolean CanNmCarWakeUpFilterEnabled [0..1]: set at link in variant link-time+post-build / pre-compile in variant pre-compile, default-value=0  # If CWU filtering is supported, only the CWU bit within the NM message with source node identifier CanNmCarWakeUpFilterNodeId is considered as CWU request. | FALSE - CWU filtering is not supported TRUE - CWU filtering is supported
        integer CanNmCarWakeUpFilterNodeId [0..1]: 0..255, set at link in variant link-time+post-build / pre-compile in variant pre-compile  # Source node identifier for CWU filtering. If CWU filtering is supported, only the CWU bit within the NM message with source node identifier CanNmCarWakeUpFilterNodeId is considered as CWU request.
        boolean CanNmCarWakeUpRxEnabled: set at link in variant link-time+post-build / pre-compile in variant pre-compile, default-value=0  # Enables or disables support of CarWakeUp bit evaluation in received NM messages. | FALSE - CarWakeUp not supported TRUE - CarWakeUp supported
        float CanNmImmediateNmCycleTime [0..1]: 0.001..65.535, set at link in variant link-time / post-build in variant post-build / pre-compile in variant pre-compile  # Defines the immediate NM PDU cycle time in seconds which is used for CanNmImmediateNmTransmissions NM PDU transmissions. This parameter is only valid if CanNmImmediateNmTransmissions is greater one.
        integer CanNmImmediateNmTransmissions: 0..255, set at link in variant link-time / post-build in variant post-build / pre-compile in variant pre-compile  # Defines the number of immediate NM PDUs which shall be transmitted. If the value is zero no immediate NM PDUs are transmitted. The cycle time of immeditate NM PDUs is defined by CanNmImmediateNmCycleTime.
        float CanNmMsgCycleOffset: 0..65.535, set at link in variant link-time / post-build in variant post-build / pre-compile in variant pre-compile, default-value=0  # Time offset in the periodic transmission node. It determines the start delay of the transmission. Specified in seconds. | This parameter is only valid if CanNmPassiveModeEnabled is False.
        float CanNmMsgCycleTime: 0.001..65.535, set at link in variant link-time / post-build in variant post-build / pre-compile in variant pre-compile  # Period of a NM-message in seconds. It determines the periodic rate in the "periodic transmission mode with bus load reduction" and is the basis for transmit scheduling in the "periodic transmission mode without bus load reduction". | This parameter is only valid if CanNmPassiveModeEnabled is False.
        float CanNmMsgReducedTime: 0.001..65.535, set at link in variant link-time / pre-compile in variant pre-compile  # Node specific bus cycle time in the periodic transmission mode with bus load reduction. Specified in seconds. | This parameter is only valid if CanNmBusLoadReductionEnabled == True and CanNmBusLoadReductionActive == True and CanNmPassiveModeEnabled == False Otherwise this parameter is not used.
        float CanNmMsgTimeoutTime: 0.001..65.535, set at link in variant link-time / post-build in variant post-build / pre-compile in variant pre-compile  # Transmission Timeout of NM-message. If there is no transmission confirmation by the CAN Interface within this timeout, the CANNM module shall give an error notification. | This parameter is only valid if CANNM_PASSIVE_MODE_ENABLED is disabled.
        integer CanNmNodeId: 0..255, set at link in variant link-time / post-build in variant post-build / pre-compile in variant pre-compile  # Node identifier of local node. | This parameter is only valid if CanNmPassiveModeEnabled = False and CanNmNodeDetectionEnabled = True
        enumeration CanNmPduCbvPosition: {CANNM_PDU_BYTE_0, CANNM_PDU_BYTE_1, CANNM_PDU_OFF}, set at link in variant link-time / post-build in variant post-build / pre-compile in variant pre-compile  # Defines the position of the control bit vector within the NM PDU. | The value of the parameter represents the location of the control bit vector in the NM PDU (CanNmPduByte0 means byte 0, CanNmPduByte1 means byte 1, CanNmPduOff means source node identifier is not part of the NM PDU) if(CANNM_PDU_CBV_POSITION != CANNM_PDU_OFF && CANNM_PDU_NID_POSITION != CANNM_PDU_OFF) then CANNM_PDU_CBV_POSITION != CANNM_PDU_NID_POSITION if(CANNM_PDU_CBV_POSITION != CANNM_PDU_OFF && CANNM_PDU_NID_POSITION == CANNM_PDU_OFF) then CANNM_PDU_CBV_POSITION = CANNM_PDU_BYTE0 ImplementationType: CanNm_PduPositionType
        enumeration CanNmPduNidPosition: {CANNM_PDU_BYTE_0, CANNM_PDU_BYTE_1, CANNM_PDU_OFF}, set at link in variant link-time / post-build in variant post-build / pre-compile in variant pre-compile  # Defines the position of the source node identifier within the NM PDU. | The value of the parameter represents the location of the source node identifier in the NM PDU (CanNMPduByte0 means byte 0, CanNmPduByte1 means byte 1, CanNmPduOff means source node identifier is not part of the NM PDU) if(CANNM_PDU_NID_POSITION != CANNM_PDU_OFF && CANNM_PDU_CBV_POSITION != CANNM_PDU_OFF) then CANNM_PDU_NID_POSITION != CANNM_PDU_CBV_POSITION if(CANNM_PDU_NID_POSITION != CANNM_PDU_OFF && CANNM_PDU_CBV_POSITION == CANNM_PDU_OFF) then CANNM_PDU_NID_POSITION = CANNM_PDU_BYTE0 ImplementationType: CanNm_PduPositionType
        boolean CanNmPnEnabled [0..1]: set at link in variant link-time / post-build in variant post-build / pre-compile in variant pre-compile, default-value=0  # Enables or disables support of partial networking. | false: Partial networking Range not supported true: Partial networking supported
        boolean CanNmPnEraCalcEnabled [0..1]: set at link in variant link-time+post-build / pre-compile in variant pre-compile, default-value=0  # Specifies if CanNm calculates the PN request information for external requests. (ERA) | false: PN request are not calculated true: PN request are calculated
        boolean CanNmPnHandleMultipleNetworkRequests [0..1]: set at link in variant link-time+post-build / pre-compile in variant pre-compile, default-value=0  # false: CanNm_NetworkRequest is ignored in NO. | true: CanNm_NetworkRequest triggers a change from NO to RM.
        float CanNmRemoteSleepIndTime: 0..65.535, set at link in variant link-time+post-build / pre-compile in variant pre-compile, default-value=0  # Timeout for Remote Sleep Indication. | It defines the time in seconds how long it shall take to recognize that all other nodes are ready to sleep. Typically it should be equal to: n * CanNmMsgCycleTime, where n denotes the number of NM-Messages that are normally sent before Remote Sleep Indication is detected. The value of n decremented by one determines the amount of lost NM-Messages that can be tolerated by the Remote Sleep Indication procedure. The value 0 denotes that no Remote Sleep Indication functionality is configured.
        float CanNmRepeatMessageTime: 0..65.535, set at link in variant link-time / post-build in variant post-build / pre-compile in variant pre-compile  # Timeout for Repeat Message State. | It defines the time in seconds how long the NM shall stay in the Repeat Message State. Typically it should be equal to: n * CanNmMsgCycleTime, where n denotes the number of NM-Messages that are normally sent in the Repeat Message State. The value of n decremented by one determines the amount of lost NM-Messages that can be tolerated by the node detection procedure. The value 0 denotes that no Repeat Message State is configured. It means that Repeat Message State is transient what implicates that it is left immediately after entrance and in result no start-up stability is guaranteed and no node detection procedure is possible.
        float CanNmTimeoutTime: 0.002..65.535, set at link in variant link-time / post-build in variant post-build / pre-compile in variant pre-compile  # Network Timeout for NM-Messages. | It denotes the time in seconds how long the NM shall stay in the Network Mode before transition into Prepare Bus-Sleep Mode shall take place. It shall be equal for all nodes in the cluster. It shall be greater than CanNmMsgCycleTime. Typically it should be equal to: n * CanNmMsgCycleTime, where n denotes the number of NM-Message cycle times in the Ready Sleep State before transition into the Bus-Sleep Mode is initiated. The value of n decremented by one determines the amount of lost NM-Messages that can be tolerated by the coordination algorithm.
        integer CanNmUserDataLength: 0..8, set at link in variant link-time / post-build in variant post-build / pre-compile in variant pre-compile  # Defines the length of the user data contained in the NM PDU
        float CanNmWaitBusSleepTime: 0.001..65.535, set at link in variant link-time / post-build in variant post-build / pre-compile in variant pre-compile  # Timeout for bus calm down phase. | It denotes the time in seconds how long the NM shall stay in the Prepare Bus-Sleep Mode before transition into Bus-Sleep Mode shall take place. It shall be equal for all nodes in the cluster. It shall be long enough to make all Tx-buffer empty.
        reference CanNmPnEraRxNSduRef [0..1]: set at link in variant link-time+post-build / pre-compile in variant pre-compile, destination=Pdu  # Reference to a Pdu in the COM-Stack. The SduRef is required for every CanNm Channel, because ERA is reported per channel.
        symbolic name reference CanNmComMNetworkHandleRef: set at link in variant link-time+post-build / pre-compile in variant pre-compile, destination=ComMChannel  # This reference points to the unique channel defined by the ComMChannel and provides access to the unique channel index value in ComMChannelId.
        container CanNmRxPdu  # This container is used to configure the Rx PDU properties that are used for the CanNm Channel.
          integer CanNmRxPduId: 0..65535, set at link in variant link-time+post-build / pre-compile in variant pre-compile, symbolic-name-value=true  # This parameter defines the Rx PDU ID of the CanIf L-PDU range that is associated with this CanNmChannel instance.
          reference CanNmRxPduRef: set at link in variant link-time / post-build in variant post-build / pre-compile in variant pre-compile, destination=Pdu  # Reference to the global PDU that is used by this CanNmChannel instance.
        container CanNmTxPdu [0..1]  # This container contains the CanNmTxConfirmationPduId and the CanNmTxPduRef.
          integer CanNmTxConfirmationPduId: 0..65535, set at link in variant link-time+post-build / pre-compile in variant pre-compile, symbolic-name-value=true  # Handle Id to be used by the Lower Layer to confirm the transmission of the CanNmTxPdu to the LowerLayer.
          reference CanNmTxPduRef: set at link in variant link-time / post-build in variant post-build / pre-compile in variant pre-compile, destination=Pdu  # The reference to the common PDU structure.
        container CanNmUserDataTxPdu [0..1]  # This optional container is used to configure the UserNm PDU. This container is only available if CanNmComUserDataSupport is enabled.
          integer CanNmTxUserDataPduId: 0..65535, set at link in variant link-time+post-build / pre-compile in variant pre-compile, symbolic-name-value=true  # This parameter defines the Handle ID of the NM User Data I-PDU.
          reference CanNmTxUserDataPduRef: set at link in variant link-time / post-build in variant post-build / pre-compile in variant pre-compile, destination=Pdu  # Reference to the NM User Data I-PDU in the global PDU collection.
      container CanNmPnInfo [0..1]  # PN information configuration
        integer CanNmPnInfoLength: 0..7, set at link in variant link-time+post-build / pre-compile in variant pre-compile, default-value=0  # Specifies the length of the PN request information in the NM message.
        integer CanNmPnInfoOffset: 0..7, set at link in variant link-time+post-build / pre-compile in variant pre-compile, default-value=0  # Specifies the offset of the PN request information in the NM message.
        container CanNmPnFilterMaskByte [0..7]  # PN information configuration
          integer CanNmPnFilterMaskByteIndex: 0..6, set at link in variant link-time+post-build / pre-compile in variant pre-compile  # Specifies the offset of the PN request information in the NM message.
          integer CanNmPnFilterMaskByteValue: 0..255, set at link in variant link-time / post-build in variant post-build / pre-compile in variant pre-compile, default-value=0  # Parameter to configure the filter mask byte.
package /ArcCore/EcucDefs/Generic/Implementations
  bsw implementation CanNm: programming-language=C, sw-version=2.1.0, used-code-generator=communication::CanNm::gen::CanNm::main, vendor-id=60, ar-release-version=4.0.3, vendor-specific-module-def=CanNm
