AUTOSAR XML (schema 4-2-2)
package /ArcCore/EcucDefs/Generic
  module definition IoHwAb [0..1]: variants pre-compile
    container ArcIoHwAbGeneral  # Container for general settings.
      boolean ArcIoHwAbDevErrorDetect: default-value=1  # Enable and disable DET errors.
      float ArcIoHwAbAnalogMaxVoltage: default-value=5.0  # The max voltage of the ADC channels in Volt.
      boolean ArcIoHwAbUsePort: default-value=0  # Set to true when using IoHwAb with RTE, set to false when no RTE is used.
      boolean ArcIoHwCalibrationEnabled: default-value=0  # Set to true to enable calibration of some values within IoHwAb.
      string ArcIoHwAbHeaderFile [0..*]: set at pre-compile, max-length=32, min-length=1  # Defines a headerfile to be included by IoHwAb to integrate with the drivers
    container ArcIoHwAbDigitalSignal [0..*]  # Container for digital signals.
      enumeration ArcIoHwAbDigitalDefaultValue: {IOHWAB_HIGH, IOHWAB_LOW}, default-value=IOHWAB_LOW  # Default value of the DIO signal.
      boolean ArcIoHwAbDigitalInverted: default-value=0  # Set to true to invert the read DIO value.
      enumeration ArcIoHwAbDigitalMethod: {IOHWAB_DIGITAL_READ, IOHWAB_DIGITAL_WRITE, IOHWAB_DIGITAL_WRITE_READBACK}, default-value=IOHWAB_DIGITAL_READ  # Method/type of DIO signal.
      enumeration ArcIoHwAbDigitalType: {IOHWAB_DIO, IOHWAB_EXTERNAL_DEVICE}, default-value=IOHWAB_DIO  # Type of underlying DIO driver.
      reference ArcIoHwAbDioChannelRef [0..1]: destination=DioChannel  # Reference to DIO channel when ArcIoHwAbDigitalType is IOHWAB_DIO
      reference ArcIoHwAbExternalDeviceDriverRef [0..1]: destination=ArcIoHwAbExternalDeviceDriver  # Reference to external device, when ArcIoHwAbDigitalType is set IOHWAB_EXTERNAL_DEVICE
      container ArcIoHwAbDigitalDiagnostic [0..*]  # Container for DIO signal diagnostics.
        enumeration ArcIoHwAbDigitalDiagnosticType: {IOHWAB_DIGITAL_GROUND, IOHWAB_DIGITAL_SUPPLY}, default-value=IOHWAB_DIGITAL_GROUND  # Type of diagnostic trigger.
        reference ArcIoHwAbDigitalDemEventParameterRef: destination=DemEventParameter  # Reference to Dem Event.
    container ArcIoHwAbExternalDeviceDriver [0..*]  # Container for Dio external devices.
      boolean ArcIoHwAbDigitalSupport: origin=ARCCORE_ECUC, default-value=0  # Enables/Disables support for digital interface.
      boolean ArcIoHwAbAnalogSupport: origin=ARCCORE_ECUC, default-value=0  # Enables/Disables support for analog interface.
      float ArcIoHwAbExternalDeviceAnalogMaxValue [0..1]: origin=ARCCORE_ECUC  # The max voltage of the external device ADC channels in Volt.
      boolean ArcIoHwAbPwmSupport: origin=ARCCORE_ECUC, default-value=0  # Enables/Disables support for Pwm interface.
    container ArcIoHwAbAnalogSignal [0..*]  # Container for analog signals.
      float ArcIoHwAbAnalogDefaultValue: default-value=0.0  # Default value in Volt for the ADC signal.
      enumeration ArcIoHwAbAnalogSignalResolution: {8_BIT_RESOLUTION, 10_BIT_RESOLUTION, 12_BIT_RESOLUTION, 14_BIT_RESOLUTION}  # The resolution of the underlying ADC channel (since not suported in ADC). This will be used when converting ADC value to volt.
      enumeration ArcIoHwAbAnalogType: {IOHWAB_ADC, IOHWAB_EXTERNAL_DEVICE}, default-value=IOHWAB_ADC  # Type of underlying ADC driver.
      reference ArcIoHwAbScalingRef: destination=ArcIoHwAbScaling  # Reference to the scaling used for the ADC signal.
      reference ArcIoHwAbAdcChannel [0..1]: destination=AdcChannel  # Reference the the ADC channel that will be used in the IoHwAb_Adc_ReadSignal() funcation call-
      reference ArcIoHwAbAdcGroup [0..1]: destination=AdcGroup  # Reference the the ADC group that will be used in the IoHwAb_Adc_ReadSignal() funcation call-
      reference ArcIoHwAbExternalDeviceDriverRef [0..1]: origin=ARCCORE_ECUC, destination=ArcIoHwAbExternalDeviceDriver  # Reference to external device, when ArcIoHwAbAnalogType is set IOHWAB_EXTERNAL_DEVICE
      container ArcIoHwAbAnalogDiagnostic [0..3]  # Container for ADC signal diagnostics.
        enumeration ArcIoHwAbAnalogDiagnosticType: {IOHWAB_ANALOG_LOW, IOHWAB_ANALOG_HIGH, IOHWAB_ANALOG_RANGE}, default-value=IOHWAB_ANALOG_RANGE  # Type of diagnostic trigger.
        float ArcIoHwAnalogDiagnosticLowerLimit [0..1]: default-value=0.5  # Lower limit used for type: IOHWAB_ANALOG_LOW, IOHWAB_RANGE
        float ArcIoHwAnalogDiagnosticUpperLimit [0..1]: default-value=4.5  # Lower limit used for type: IOHWAB_ANALOG_HIGH, IOHWAB_RANGE
        reference ArcIoHwAbAnalogDemEventParameterRef: destination=DemEventParameter  # Reference to Dem Event.
    container ArcIoHwAbScaling [0..*]  # Container for ADC scalings
      float ArcIoHwAbScalingOffset: default-value=0.0  # Scaling offset.
      float ArcIoHwAbScalingScale: default-value=1.0  # Scaling factor.
      enumeration ArcIoHwAbScalingType: {Volt, Ampere, Ohm}  # Scaling type that will be used by upper layers.
    container ArcIoHwAbPwmSignal [0..*]  # Container for PWM signals
      enumeration ArcIoHwAbPwmType: {IOHWAB_PWM_DUTY, IOHWAB_PWM_FREQUENCY_AND_DUTY, IOHWAB_EXTERNAL_DEVICE_PWM_DUTY, IOHWAB_EXTERNAL_DEVICE_PWM_FREQUENCY_AND_DUTY}  # Type of PWM abstraction
      integer ArcIoHwAbPwmDutyDefaultValue: 0..100  # Default value of PWM in percent
      reference ArcIoHwAbPwmChannel [0..1]: destination=PwmChannel  # Reference the PWM channel.
      reference ArcIoHwAbExternalDeviceDriverRef [0..1]: origin=ARCCORE_ECUC, destination=ArcIoHwAbExternalDeviceDriver  # Reference to external device, when ArcIoHwAbPwmType is set IOHWAB_EXTERNAL_DEVICE_PWM_FREQUENCY_AND_DUTY or IOHWAB_EXTERNAL_DEVICE_PWM_DUTY
package /ArcCore/EcucDefs/Generic/Implementations
  bsw implementation IoHwAb: programming-language=C, sw-version=1.1.0, used-code-generator=Peripherals::IoHwAb::gen::IoHwAb::main, vendor-id=60, ar-release-version=4.0.3, vendor-specific-module-def=IoHwAb
