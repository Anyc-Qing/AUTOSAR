AUTOSAR XML (schema 4-2-2)
package /ArcCore/Implementations/tms570ls12x
  bsw implementation Port: sw-version=6.0.0, used-code-generator=mcal::Port::gen::Port_tms570::main, vendor-id=60, ar-release-version=4.3.0, vendor-specific-module-def=Port
