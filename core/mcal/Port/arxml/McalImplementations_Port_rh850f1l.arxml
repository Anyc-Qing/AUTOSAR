AUTOSAR XML (schema 4-2-2)
package /ArcCore/Implementations/rh850f1l
  bsw implementation Port: programming-language=C, sw-version=5.0.1, used-code-generator=mcal::Port::gen::Port_f1x::main, vendor-id=60, ar-release-version=4.1.2, vendor-specific-module-def=Port
