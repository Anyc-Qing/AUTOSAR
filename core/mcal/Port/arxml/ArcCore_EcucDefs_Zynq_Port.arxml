AUTOSAR XML (schema 4-2-2)
package /ArcCore/EcucDefs/zynq
  module definition Port [0..1]: refined-module-def=Port, variants post-build/pre-compile  # Configuration of the Port module.
    container PortConfigSet: multiple-configuration-container=true  # This container is the base of a multiple configuration set
      container PortContainer [1..*]  # Container collecting the PortPins.
        integer PortNumberOfPortPins: 1..65535, set at pre-compile  # The number of specified PortPins in this PortContainer.
        container PortPin [1..*]  # Configuration of the individual port pins.
          enumeration PortPinDirection: {PORT_PIN_IN, PORT_PIN_OUT}, set at post-build in variant post-build / pre-compile in variant pre-compile  # The initial direction of the pin (IN or OUT). If the direction is not changeable, the value configured here is fixed. | The direction must match the pin mode. E.g. a pin used for an ADC must be configured to be an in port. Implementation Type: Port_PinDirectionType
          boolean PortPinDirectionChangeable: set at post-build in variant post-build / pre-compile in variant pre-compile  # Parameter to indicate if the direction is changeable on a port pin during runtime. | true: Port Pin direction changeable enabled. false: Port Pin direction changeable disabled.
          integer PortPinId: 1..65535, set at pre-compile, symbolic-name-value=true  # Pin Id of the port pin. This value will be assigned to the symbolic name derived from the port pin container short name.
          enumeration PortPinLevelValue: {PORT_PIN_LEVEL_HIGH, PORT_PIN_LEVEL_LOW}, set at post-build in variant post-build / pre-compile in variant pre-compile  # Port Pin Level value from Port pin list.
          boolean PortPinModeChangeable: set at post-build in variant post-build / pre-compile in variant pre-compile  # Parameter to indicate if the mode is changeable on a port pin during runtime. True: Port Pin mode changeable allowed. False: Port Pin mode changeable not permitted.
          enumeration ArcPortPinDisableHstlInputBuffer: {DISABLE_INPUT_BUFFER, ENABLE_INPUT_BUFFER}, set at post-build in variant post-build / pre-compile in variant pre-compile, origin=ARCCORE_ECUC, default-value=ENABLE_INPUT_BUFFER  # Disable HSTL Input Buffer to save power when it is an output only
          enumeration ArcPortPinIOBufferType: {LVCMOS18, LVCMOS25, LVCMOS33, HSTL}, set at post-build in variant post-build / pre-compile in variant pre-compile, origin=ARCCORE_ECUC, default-value=LVCMOS33  # Selects the IO buffer type.
          enumeration ArcPortPinPull: {ENABLE_PULLUP, DISABLE_PULLUP}, set at post-build in variant post-build / pre-compile in variant pre-compile, origin=ARCCORE_ECUC, default-value=DISABLE_PULLUP  # Enables or disables Pullup on IO Buffer pin.
          enumeration ArcPortPinSlewRate: {SLOW_CMOS_EDGE, FAST_CMOS_EDGE}, set at post-build in variant post-build / pre-compile in variant pre-compile, origin=ARCCORE_ECUC, default-value=FAST_CMOS_EDGE  # Select IO Buffer Edge Rate, applicable when IO_Type is LVCMOS18, LVCMOS25 or LVCMOS33
          enumeration PortPinInitialMode: {PORT_PIN_MODE_ADC, PORT_PIN_MODE_CAN, PORT_PIN_MODE_DIO, PORT_PIN_MODE_DIO_GPT, PORT_PIN_MODE_DIO_WDG, PORT_PIN_MODE_FLEXRAY, PORT_PIN_MODE_ICU, PORT_PIN_MODE_LIN, PORT_PIN_MODE_MEM, PORT_PIN_MODE_PWM, PORT_PIN_MODE_SPI, PORT_PIN_MODE_ETHERNET, PORT_PIN_MODE_I2C, PORT_PIN_MODE_NAND, PORT_PIN_MODE_PJTAG, PORT_PIN_MODE_QSPI, PORT_PIN_MODE_SDIO, PORT_PIN_MODE_SDIOP, PORT_PIN_MODE_SRAM_NOR, PORT_PIN_MODE_SWDT, PORT_PIN_MODE_TRACE, PORT_PIN_MODE_TTC, PORT_PIN_MODE_UART, PORT_PIN_MODE_USB}, set at post-build in variant post-build / pre-compile in variant pre-compile  # Port pin mode from mode list for use with Port_Init() function.
          enumeration PortPinMode [1..*]: {PORT_PIN_MODE_ADC, PORT_PIN_MODE_CAN, PORT_PIN_MODE_DIO, PORT_PIN_MODE_DIO_GPT, PORT_PIN_MODE_DIO_WDG, PORT_PIN_MODE_FLEXRAY, PORT_PIN_MODE_ICU, PORT_PIN_MODE_LIN, PORT_PIN_MODE_MEM, PORT_PIN_MODE_PWM, PORT_PIN_MODE_SPI, PORT_PIN_MODE_UART, PORT_PIN_MODE_TTC, PORT_PIN_MODE_SWDT, PORT_PIN_MODE_QSPI, PORT_PIN_MODE_SDIOP, PORT_PIN_MODE_SDIO, PORT_PIN_MODE_I2C, PORT_PIN_MODE_SRAM_NOR, PORT_PIN_MODE_NAND, PORT_PIN_MODE_PJTAG, PORT_PIN_MODE_TRACE, PORT_PIN_MODE_USB, PORT_PIN_MODE_ETHERNET}, set at post-build in variant post-build / pre-compile in variant pre-compile  # Port pin mode from mode list. | Note that more than one mode is allowed by default. That way it is e.g. possible to combine DIO with another mode such as ICU.
    container PortGeneral  # Module wide configuration parameters of the PORT driver.
      boolean PortDevErrorDetect: set at pre-compile, default-value=1  # Switches the Development Error Detection and Notification on or off. | true: Enabled. false: Disabled.
      boolean PortSetPinDirectionApi: set at pre-compile, default-value=0  # Pre-processor switch to enable / disable the use of the function Port_SetPinDirection(). | TRUE: Enabled - Function Port_SetPinDirection() is available. FALSE: Disabled - Function Port_SetPinDirection() is not available.
      boolean PortSetPinModeApi: set at pre-compile, default-value=0  # Pre-processor switch to enable / disable the use of the function Port_SetPinMode(). | true: Enabled - Function Port_SetPinMode() is available. false: Disabled - Function Port_SetPinMode() is not available.
      boolean PortVersionInfoApi: set at pre-compile, default-value=0  # Pre-processor switch to enable / disable the API to read out the modules version information. | true: Version info API enabled. false: Version info API disabled.
