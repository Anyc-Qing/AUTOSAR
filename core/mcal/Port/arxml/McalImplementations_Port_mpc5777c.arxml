AUTOSAR XML (schema 4-2-2)
package /ArcCore/Implementations/mpc5777c
  bsw implementation Port: programming-language=C, sw-version=7.0.0, used-code-generator=mcal::Port::gen::Port::main, vendor-id=60, ar-release-version=4.3.0, vendor-specific-module-def=Port
