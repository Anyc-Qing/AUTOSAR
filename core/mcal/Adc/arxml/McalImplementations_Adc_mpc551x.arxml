AUTOSAR XML (schema 4-2-2)
package /ArcCore/EcucDefs/mpc551x/Implementations
  bsw implementation Adc: programming-language=C, sw-version=2.0.0, used-code-generator=mcal::Adc::gen::Adc_mpc551x::main, ar-release-version=4.1.2, vendor-specific-module-def=Adc
