AUTOSAR XML (schema 4-2-2)
package /ArcCore/EcucDefs/mpc560x/Implementations
  bsw implementation Adc: programming-language=C, sw-version=3.0.0, used-code-generator=mcal::Adc::gen::Adc_mpc560x::main, vendor-id=60, ar-release-version=4.3.0, vendor-specific-module-def=Adc
