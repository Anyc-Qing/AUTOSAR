AUTOSAR XML (schema 4-2-2)
package /ArcCore/Implementations/mpc5777c
  bsw implementation Adc: programming-language=C, sw-version=3.0.0, used-code-generator=mcal::Adc::gen::Adc_mpc5567::main, vendor-id=60, ar-release-version=4.3.0, vendor-specific-module-def=Adc
