AUTOSAR XML (schema 4-2-2)
package /ArcCore/Implementations/jacinto5
  bsw implementation Adc: programming-language=C, sw-version=2.0.0, used-code-generator=mcal::Adc::gen::Adc_jacinto::main, vendor-id=60, ar-release-version=4.1.2, vendor-specific-module-def=Adc
