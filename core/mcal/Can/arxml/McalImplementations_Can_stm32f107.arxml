AUTOSAR XML (schema 4-2-2)
package /ArcCore/Implementations/stm32f107
  bsw implementation Can: sw-version=5.0.0, used-code-generator=mcal::Can::gen::Can_stm32f10x::main, vendor-id=60, ar-release-version=4.1.2, vendor-specific-module-def=Can
