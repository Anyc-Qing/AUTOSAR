AUTOSAR XML (schema 4-2-2)
package /ArcCore/Implementations/mpc5747c
  bsw implementation Can: programming-language=C, sw-version=5.0.0, used-code-generator=mcal::Can::gen::Can_mpc560x::main, vendor-id=60, ar-release-version=4.1.2, vendor-specific-module-def=Can
