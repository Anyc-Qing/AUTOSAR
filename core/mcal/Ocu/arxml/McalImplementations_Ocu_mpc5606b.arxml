AUTOSAR XML (schema 4-2-2)
package /ArcCore/EcucDefs/Implementations/mpc5606b
  bsw implementation Ocu: programming-language=C, sw-version=1.0.0, used-code-generator=mcal::Ocu::gen::Ocu_mpc560x::main, vendor-id=60, ar-release-version=4.1.2, vendor-specific-module-def=Ocu
