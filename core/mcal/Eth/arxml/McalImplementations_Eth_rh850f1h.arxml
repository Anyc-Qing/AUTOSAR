AUTOSAR XML (schema 4-2-2)
package /ArcCore/Implementations/rh850f1h
  bsw implementation Eth: programming-language=C, sw-version=1.0.0, used-code-generator=mcal::Eth::gen::Eth::main, vendor-id=60, ar-release-version=4.0.3, vendor-specific-module-def=Eth
