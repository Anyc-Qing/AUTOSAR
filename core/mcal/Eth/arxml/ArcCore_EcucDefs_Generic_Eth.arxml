AUTOSAR XML (schema 4-2-2)
package /ArcCore/EcucDefs/Generic
  module definition Eth [0..*]: refined-module-def=Eth, variants link-time/post-build/pre-compile  # Configuration of the Eth (Ethernet Driver) module.
    container EthConfigSet  # This container contains the configuration parameters and sub containers of the AUTOSAR Eth module.
      container EthCtrlConfig [1..*]  # Configuration of the individual controller
        boolean EthCtrlEnableMii  # Enables / Disables Media Independent Interface (MII) for transceiver access
        boolean EthCtrlEnableRxInterrupt  # Enables / Disables receive interrupt
        boolean EthCtrlEnableTxInterrupt  # Enables / Disables transmit interrupt
        integer EthCtrlIdx: 0..255, scope=ECU, symbolic-name-value=true  # Specifies the instance ID of the configured controller.
        string EthCtrlPhyAddress [0..1]: max-length=17, min-length=17  # Specifies the unique 48-bit physical address (MAC address) of the controller in network byte order. | Regular Expression: [0-9a-fA-F]{2}[[:-][0-9a-fA-F]{2}]{5}
        integer EthCtrlRxBufLenByte: 0..1522  # Limits the maximum receive buffer length (frame length) in bytes. Set recommended max 1518 if no VLAN or 1522 bytes if VLAN
        integer EthCtrlTxBufLenByte: 0..1522  # Limits the maximum transmit buffer length (frame length) in bytes.
        integer EthRxBufTotal: 0..65535  # Configures the number of receive buffers.
        integer EthTxBufTotal: 0..255  # Configures the number of transmit buffers.
        enumeration ArcEthControllerHwMIIMode: {RMII, MII, RGMII}, set at pre-compile, origin=ARCCORE_ECUC  # Selection of MII mode of the controller
        enumeration ArcEthControllerHwSpeed: {MBPS_100, MBPS_10}, set at pre-compile, origin=ARCCORE_ECUC  # Determines the HW communication speed
        enumeration ArcEthControllerHwUnit: {HWUNIT_0, HWUNIT_1}, set at pre-compile, origin=ARCCORE_ECUC  # Determines the hardware unit.
        boolean ArcEthCtrlDiscardRxFCS: set at pre-compile, default-value=1  # Enables/disables Rx FCS, FCS is discarded when copied for the received buffers if this is enabled
        boolean ArcEthCtrlEnableRxChecksumOffload: set at pre-compile, default-value=1  # Enables / Disables Hardware checksum offload mechanism, if disabled controller will not verify checksum
        boolean ArcEthCtrlEnableTxChecksumOffload: set at pre-compile, default-value=1  # Enables / Disables Hardware checksum offload mechanism, When disabled controller will not generate checksum
        integer ArcEthCtrlRxDMAChannel: 0..7, set at pre-compile  # Specifies the DMA channel for the reception packets
        integer ArcEthCtrlRxQueueValue: 0..3, set at pre-compile  # Specifies the Switch Priority Queue number for the reception
        integer ArcEthCtrlTxDMAChannel: 0..7, set at pre-compile  # Specifies the Specifies the DMA channel for the reception packets
        integer ArcEthCtrlTxQueueValue: 0..3, set at pre-compile  # Specifies the Switch Priority Queue number for the transmission
        enumeration ArcEthFifoPrio: {DUAL_MAC, NORMAL_PRIO}, set at pre-compile, origin=ARCCORE_ECUC  # Determines the HW Fifo priority type set
        boolean ArcEthCtrlEnableCircDesc  # Enables / Disables Circular type of the descriptors
        container EthDemEventParameterRefs [0..1]  # Container for the references to DemEventParameter elements which shall be invoked using the API Dem_ReportErrorStatus in case the corresponding error occurs. The EventId is taken from the referenced DemEventParameter's DemEventId value. The standardized errors are provided in the container and can be extended by vendor specific error references.
          symbolic name reference ETH_E_ACCESS [0..1]: destination=DemEventParameter  # Reference to the DemEventParameter which shall be issued when the error "Controller access failed" has occured.
          symbolic name reference ETH_E_ALIGNMENT [0..1]: destination=DemEventParameter  # Reference to the DemEventParameter which shall be issued when the error "Alignment Error" has occured.
          symbolic name reference ETH_E_CRC [0..1]: destination=DemEventParameter  # Reference to the DemEventParameter which shall be issued when the error "CRC Failure" has occured.
          symbolic name reference ETH_E_LATECOLLISION [0..1]: destination=DemEventParameter  # Reference to the DemEventParameter which shall be issued when the error "Late Collisions" has occured.
          symbolic name reference ETH_E_MULTIPLECOLLISION [0..1]: destination=DemEventParameter  # Reference to the DemEventParameter which shall be issued when the error "Multiple Collisions" has occured.
          symbolic name reference ETH_E_OVERSIZEFRAME [0..1]: destination=DemEventParameter  # Reference to the DemEventParameter which shall be issued when the error "Oversized Frame" has occured.
          symbolic name reference ETH_E_RX_FRAMES_LOST [0..1]: destination=DemEventParameter  # Reference to the DemEventParameter which shall be issued when the error "receive frames lost" has occured.
          symbolic name reference ETH_E_SINGLECOLLISION [0..1]: destination=DemEventParameter  # Reference to the DemEventParameter which shall be issued when the error "Single Collisions" has occured.
          symbolic name reference ETH_E_UNDERSIZEFRAME [0..1]: destination=DemEventParameter  # Reference to the DemEventParameter which shall be issued when the error "Undersized Frame" has occured.
    container EthGeneral  # General configuration of Ethernet Driver module
      boolean EthDevErrorDetect  # Switches the Default Error Tracer (Det) detection and notification ON or OFF. | * true: enabled (ON). * false: disabled (OFF).
      boolean EthGetDropCountApi  # Enables / Disables Eth_GetDropCount API.
      boolean EthGetEtherStatsApi  # Enables / Disables Eth_GetEtherStats API.
      boolean EthGlobalTimeSupport  # Enables/Disables the GlobalTime APIs used amongst others by Global Time Synchronization over Ethernet.
      integer EthIndex: 0..255  # Specifies the InstanceId of this module instance. If only one instance is present it shall have the Id 0.
      float EthMainFunctionPeriod: 0..Inf  # Specifies the period of main function Eth_MainFunction in seconds. Ethernet driver does not require this information but the BSW scheduler.
      integer EthMaxCtrlsSupported: 1..255  # Limits the total number of supported controllers.
      boolean EthUpdatePhysAddrFilter: default-value=false  # Enables/Disables optional API Eth_UpdatePhysAddrFilter.
      boolean EthVersionInfoApi  # Enables / Disables version info API
      integer ArcEthCpu1xclkValue: 0..540, set at link in variant link-time / post-build in variant post-build / pre-compile in variant pre-compile  # cpu_1xclk speed in MHz, MDC clock division is set according to this value, please round this to nearest decimal value
      boolean ArcEthSoftReset: set at pre-compile, origin=ARCCORE_ECUC, default-value=0  # Enables/disables soft reset of Ethernet Module | true: Enabled. false: Disabled.
      container EthCtrlOffloading  # Configuration of hardware offloading features.
        boolean EthCtrlEnableOffloadChecksumICMP  # Enables / Disables hardware offloading for ICMP checksums.
        boolean EthCtrlEnableOffloadChecksumIPv4  # Enables / Disables hardware offloading for IPv4 checksums.
        boolean EthCtrlEnableOffloadChecksumTCP  # Enables / Disables hardware offloading for TCP checksums.
        boolean EthCtrlEnableOffloadChecksumUDP  # Enables / Disables hardware offloading for UDP checksums.
