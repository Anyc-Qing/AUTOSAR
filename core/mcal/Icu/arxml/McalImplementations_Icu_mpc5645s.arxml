AUTOSAR XML (schema 4-2-2)
package /ArcCore/Implementations/mpc5645s
  bsw implementation Icu: sw-version=3.0.0, used-code-generator=mcal::Icu::gen::Icu_mpc560x::main, vendor-id=60, ar-release-version=4.1.2, vendor-specific-module-def=Icu
