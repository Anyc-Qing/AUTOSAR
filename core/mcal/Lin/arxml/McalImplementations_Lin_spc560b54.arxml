AUTOSAR XML (schema 4-2-2)
package /ArcCore/EcucDefs/Implementations/spc560b54
  bsw implementation Lin: programming-language=C, sw-version=2.1.1, used-code-generator=mcal::Lin::gen::Lin_mpc560x::main, vendor-id=60, ar-release-version=4.1.2, vendor-specific-module-def=Lin
