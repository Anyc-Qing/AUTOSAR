AUTOSAR XML (schema 4-2-2)
package /ArcCore/EcucDefs/jacinto
  module definition Lin [0..*]: refined-module-def=Lin, variants post-build/pre-compile  # Configuration of the Lin (LIN driver) module.
    container LinDemEventParameterRefs [0..1]  # Container for the references to DemEventParameter elements which shall be invoked using the API Dem_ReportErrorStatus API in case the corresponding error occurs. The EventId is taken from the referenced DemEventParameter's DemEventId value. The standardized errors are provided in the container and can be extended by vendor specific error references.
      symbolic name reference LIN_E_TIMEOUT [0..1]: set at pre-compile, destination=DemEventParameter  # Reference to the DemEventParameter which shall be issued when the error "Timeout caused by hardware error" has occurred. If the reference is not configured the error shall be reported as DET error.
    container LinGeneral  # This container contains the parameters related to each LIN Driver Unit.
      boolean LinDevErrorDetect: set at pre-compile  # Switches the Development Error Detection and Notification ON or OFF.
      integer LinIndex: 0..255, set at pre-compile  # Specifies the InstanceId of this module instance. If only one instance is present it shall have the Id 0.
      integer LinTimeoutDuration: 0..65535, set at pre-compile  # Specifies the maximum number of loops for blocking function until a timeout is raised in short term wait loops
      boolean LinVersionInfoApi: set at pre-compile  # Switches the Lin_GetVersionInfo function ON or OFF.
    container LinGlobalConfig: multiple-configuration-container=true  # This container contains the global configuration parameter of the Lin driver. This container is a MultipleConfigurationContainer, i.e. this container and its sub-containers exit once per configuration set.
      container LinChannel [1..*]: scope=ECU  # This container contains the configuration (parameters) of the LIN Controller(s).
        integer LinChannelId: 0..65535, set at pre-compile, symbolic-name-value=true  # Identifies the LIN channel. Replaces LIN_CHANNEL_INDEX_NAME from the LIN SWS.
        boolean LinChannelWakeupSupport: set at pre-compile  # Specifies if the LIN hardware channel supports wake up functionality
        integer ArcUartChannel: 1..10, set at pre-compile, symbolic-name-value=true, default-value=1  # Specifys wich physical UART chanel the lin comunication will use - Only UART1 is working ATM
        enumeration LinChannelBaudRate: {19200, 14400, 9600, 4800, 2400, 1200}, set at pre-compile  # Select Lin channel baudrate
        integer ArcLinHwChannel: 0..16, set at pre-compile, origin=ARCCORE_ECUC, symbolic-name-value=true  # This is physical Lin hardware ID
        reference LinClockRef: set at post-build in variant post-build / pre-compile in variant pre-compile, destination=McuClockReferencePoint  # Reference to the LIN clock source configuration, which is set in the MCU driver configuration.
        symbolic name reference LinChannelEcuMWakeupSource [0..1]: set at pre-compile, destination=EcuMWakeupSource  # This parameter contains a reference to the Wakeup Source for this controller as defined in the ECU State Manager.
