AUTOSAR XML (schema 4-2-2)
package /ArcCore/Implementations/tms570ls12x
  bsw implementation Gpt: programming-language=C, sw-version=4.0.0, used-code-generator=mcal::Gpt::gen::Gpt_tms570::main, ar-release-version=4.3.0, vendor-specific-module-def=Gpt
