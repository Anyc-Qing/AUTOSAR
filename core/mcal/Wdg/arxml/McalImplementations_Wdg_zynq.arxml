AUTOSAR XML (schema 4-2-2)
package /ArcCore/Implementations/zynq
  bsw implementation Wdg: programming-language=C, sw-version=2.0.0, used-code-generator=mcal::Wdg::gen::Wdg_zynq::main, vendor-id=60, ar-release-version=4.1.2, vendor-specific-module-def=Wdg
