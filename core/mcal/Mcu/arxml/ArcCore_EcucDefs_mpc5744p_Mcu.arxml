AUTOSAR XML (schema 4-2-2)
package /ArcCore/EcucDefs/mpc5744p
  module definition Mcu [0..1]: refined-module-def=Mcu, variants post-build/pre-compile  # Configuration of the Mcu (Microcontroller Unit) module.
    container McuGeneralConfiguration  # This container contains the configuration (parameters) of the MCU driver.
      boolean McuDevErrorDetect: set at pre-compile, default-value=1  # Pre-processor switch for enabling the development error detection and reporting.
      boolean McuGetRamStateApi: set at pre-compile, default-value=0  # Pre-processor switch to enable/disable the API Mcu_GetRamState. | (e.g. If the H/W does not support the functionality, this parameter can be used to disable the Api).
      boolean McuInitClock: set at pre-compile, default-value=1  # If this parameter is set to FALSE, the clock initialization has to be disabled from the MCU driver. This concept applies when there are some write once clock registers and a bootloader is present. If this parameter is set to TRUE, the MCU driver is responsible of the clock initialization.
      boolean McuNoPll: set at pre-compile, default-value=0  # This parameter shall be set True, if the H/W does not have a PLL or the PLL circuitry is enabled after the power on without S/W intervention. In this case MCU_DistributePllClock has to be disabled and MCU_GetPllStatus has to return MCU_PLL_STATUS_UNDEFINED. Otherwise this parameters has to be set False
      boolean McuPerformResetApi: set at pre-compile, default-value=0  # Pre-processor switch to enable / disable the use of the function Mcu_PerformReset()
      boolean McuVersionInfoApi: set at pre-compile, default-value=0  # Pre-processor switch to enable / disable the API to read out the modules version information.
    container McuModuleConfiguration: multiple-configuration-container=true  # This container contains the configuration (parameters) of the MCU driver
      enumeration McuClockSrcFailureNotification: {DISABLED, ENABLED}, set at post-build in variant post-build / pre-compile in variant pre-compile, default-value=DISABLED  # Enables/Disables clock failure notification. In case this feature is not supported by HW the setting should be disabled.
      integer McuNumberOfMcuModes: 1..255, set at post-build in variant post-build / pre-compile in variant pre-compile  # This parameter shall represent the number of Modes available for the MCU. | calculationFormula = Number of configured McuModeSettingConf
      integer McuRamSectors: 0..4294967295, set at post-build in variant post-build / pre-compile in variant pre-compile  # This parameter shall represent the number of RAM sectors available for the MCU. | calculationFormula = Number of configured McuRamSectorSettingConf
      integer McuResetSetting [0..1]: 1..255, set at pre-compile  # This parameter relates to the MCU specific reset configuration. This applies to the function Mcu_PerformReset, which performs a microcontroller reset using the hardware feature of the microcontroller.
      reference ArcDefaultClockRef: set at pre-compile, destination=McuClockSettingConfig  # This parameter contains a reference to the default clock that will be used at initialization
      container McuClockSettingConfig [1..*]  # This container contains the configuration (parameters) for the Clock settings of the MCU. Please see MCU031 for more information on the MCU clock settings.
        integer McuClockSettingId: 0..255, set at post-build in variant post-build / pre-compile in variant pre-compile, symbolic-name-value=true  # The Id of this McuClockSettingConfig to be used as argument for the API call "Mcu_InitClock".
        container McuClockReferencePoint [1..*]  # This container defines a reference point in the Mcu Clock tree. It defines the frequency which then can be used by other modules as an input value. Lower multiplicity is 1, as even in the simplest case (only one frequency is used), there is one frequency to be defined.
          float Frequency: 0..Inf, set at post-build in variant post-build / pre-compile in variant pre-compile  # This is the frequency for the specific instance of the McuClockReferencePoint container. It shall be given in Hz.
          float McuClockReferencePointFrequency: 0..Inf, scope=ECU, set at post-build in variant post-build / pre-compile in variant pre-compile, default-value=8000000.0  # This is the frequency for the specific instance of the McuClockReferencePoint container. It shall be given in Hz.
        container ArcPLLSettings  # PLL Settings
          integer PLL0_PREDIV: 0.., set at pre-compile, origin=ARCCORE_ECUC  # Input clock predivider. 0b000-Clock Disabled,0b001-Divide by 1, etc
          integer PLL0_MFD: 0.., set at pre-compile, origin=ARCCORE_ECUC  # Loop multiplication factor divider. Range 8 to 127
          integer PLL0_RFDPHI: 0.., set at pre-compile, origin=ARCCORE_ECUC  # PHI reduced frequency divider. Range 1..63
          integer PLL1_MFD: 0.., set at pre-compile, origin=ARCCORE_ECUC  # Loop multiplication factor divider. Range 16...34
          integer PLL1_RFDPHI: 0.., set at pre-compile, origin=ARCCORE_ECUC  # PHI reduced frequency divider. range of 1..63
          integer PLL1FM_MODPRD: 0.., set at pre-compile, origin=ARCCORE_ECUC  # Modulation period.
          integer PLL1FM_INCSTP: 0.., set at pre-compile, origin=ARCCORE_ECUC  # Increment step.
          boolean PLL1FM_MODEN: set at pre-compile, default-value=0  # Enable modulation
      container McuDemEventParameterRefs [0..1]  # Container for the references to DemEventParameter elements which shall be invoked using the API Dem_ReportErrorStatus API in case the corresponding error occurs. The EventId is taken from the referenced DemEventParameter's DemEventId symbolic name. The standardized errors are provided in the container and can be extended by vendor specific error references.
        symbolic name reference MCU_E_CLOCK_FAILURE [0..1]: set at pre-compile, destination=DemEventParameter  # Reference to configured DEM event to report "Clock source failure".
      container McuModeSettingConf [1..*]  # This container contains the configuration (parameters) for the Mode setting of the MCU. Please see MCU035 for more information on the MCU mode settings.
        integer McuMode: 0..255, set at post-build in variant post-build / pre-compile in variant pre-compile, symbolic-name-value=true  # The parameter represents the MCU Mode settings.
      container McuRamSectorSettingConf [0..*]  # This container contains the configuration (parameters) for the RAM Sector setting. Please see MCU030 for more information on RAM sec-tor settings.
        integer McuRamDefaultValue: 0..255, set at post-build in variant post-build / pre-compile in variant pre-compile  # This parameter shall represent the Data pre-setting to be initialized
        integer McuRamSectionBaseAddress: 0..4294967295, set at post-build in variant post-build / pre-compile in variant pre-compile  # This parameter shall represent the MCU RAM section base address
        integer McuRamSectionSize: 0..4294967295, set at post-build in variant post-build / pre-compile in variant pre-compile  # This parameter represents the MCU RAM Section size in bytes.
    container McuPublishedInformation  # Container holding all MCU specific published information parameters
      container McuResetReasonConf [1..*]  # This container contains the configuration for the different type of reset reason that can be retrieved from Mcu_GetResetReason Api.
        integer McuResetReason: 0..255, scope=ECU, set at published-information, symbolic-name-value=true  # The parameter represents the different type of reset that a Micro supports. This parameter is referenced by the parameter EcuMResetReason in the ECU State manager module.
