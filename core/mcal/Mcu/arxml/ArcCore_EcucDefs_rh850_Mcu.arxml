AUTOSAR XML (schema 4-2-2)
package /ArcCore/EcucDefs/rh850
  module definition Mcu [0..1]: refined-module-def=Mcu, variants post-build/pre-compile  # Configuration of the Mcu (Microcontroller Unit) module.
    container McuGeneralConfiguration  # This container contains the configuration (parameters) of the MCU driver.
      boolean McuDevErrorDetect: set at pre-compile, default-value=1  # Pre-processor switch for enabling the development error detection and reporting.
      boolean McuGetRamStateApi: set at pre-compile, default-value=0  # Pre-processor switch to enable/disable the API Mcu_GetRamState. | (e.g. If the H/W does not support the functionality, this parameter can be used to disable the Api).
      boolean McuInitClock: set at pre-compile, default-value=1  # If this parameter is set to FALSE, the clock initialization has to be disabled from the MCU driver. This concept applies when there are some write once clock registers and a bootloader is present. If this parameter is set to TRUE, the MCU driver is responsible of the clock initialization.
      boolean McuNoPll: set at pre-compile, default-value=0  # This parameter shall be set True, if the H/W does not have a PLL or the PLL circuitry is enabled after the power on without S/W intervention. In this case MCU_DistributePllClock has to be disabled and MCU_GetPllStatus has to return MCU_PLL_STATUS_UNDEFINED. Otherwise this parameters has to be set False
      boolean McuPerformResetApi: set at pre-compile, default-value=0  # Pre-processor switch to enable / disable the use of the function Mcu_PerformReset()
      boolean McuVersionInfoApi: set at pre-compile, default-value=0  # Pre-processor switch to enable / disable the API to read out the modules version information.
    container McuModuleConfiguration: multiple-configuration-container=true  # This container contains the configuration (parameters) of the MCU driver
      enumeration McuClockSrcFailureNotification: {DISABLED, ENABLED}, set at post-build in variant post-build / pre-compile in variant pre-compile, default-value=DISABLED  # Enables/Disables clock failure notification. In case this feature is not supported by HW the setting should be disabled.
      integer McuNumberOfMcuModes: 1..255, set at post-build in variant post-build / pre-compile in variant pre-compile  # This parameter shall represent the number of Modes available for the MCU. | calculationFormula = Number of configured McuModeSettingConf
      integer McuRamSectors: 0..4294967295, set at post-build in variant post-build / pre-compile in variant pre-compile  # This parameter shall represent the number of RAM sectors available for the MCU. | calculationFormula = Number of configured McuRamSectorSettingConf
      integer McuResetSetting [0..1]: 1..255, set at pre-compile  # This parameter relates to the MCU specific reset configuration. This applies to the function Mcu_PerformReset, which performs a microcontroller reset using the hardware feature of the microcontroller.
      reference ArcDefaultClockRef: set at pre-compile, destination=McuClockSettingConfig  # This parameter contains a reference to the default clock that will be used at initialization
      container McuClockSettingConfig [1..*]  # This container contains the configuration (parameters) for the Clock settings of the MCU. Please see MCU031 for more information on the MCU clock settings.
        integer McuClockSettingId: 0..255, set at post-build in variant post-build / pre-compile in variant pre-compile, symbolic-name-value=true  # The Id of this McuClockSettingConfig to be used as argument for the API call "Mcu_InitClock".
        container McuClockReferencePoint [1..*]  # This container defines a reference point in the Mcu Clock tree. It defines the frequency which then can be used by other modules as an input value. Lower multiplicity is 1, as even in the simplest case (only one frequency is used), there is one frequency to be defined.
          float McuClockReferencePointFrequency: 0..Inf, scope=ECU, set at post-build in variant post-build / pre-compile in variant pre-compile, default-value=8000000.0  # This is the frequency for the specific instance of the McuClockReferencePoint container. It shall be given in Hz.
        container ArcPLLSettings  # PLL Settings
          integer PLL1N: set at pre-compile, origin=ARCCORE_ECUC  # Drive the PLL_RES[3:0] input of the PLL to set the PLL loop filter resistor control
          integer PLL0ADJ: set at pre-compile, origin=ARCCORE_ECUC  # 1:1%, 3: 2%, 5:3%, 6:4%, 7:5%. Rest of the values are prohibited.
          integer PLL0MD: set at pre-compile, origin=ARCCORE_ECUC, default-value=0  # 0: No Modulation is used. 1: Modulation is used.
          integer PLL0N: set at pre-compile, origin=ARCCORE_ECUC, symbolic-name-value=true  # Nr-Value Setting, Nr-value = PLL0N[6:0] + 1
          integer PLL0P: set at pre-compile, origin=ARCCORE_ECUC  # Pr-Value Setting, 2:Pr-Value=4, 3:Pr-Value=8, 4:Pr-Value=16
          integer PLL0MF: set at pre-compile, origin=ARCCORE_ECUC  # Frequency Modulation Cycle Setting
          integer PLL1P: set at pre-compile, origin=ARCCORE_ECUC  # Pr-Value Setting, 2:Pr-Value=4, 3:Pr-Value=6, 4:Pr-Value=8, 5:Pr-Value=16
          integer PLL0M: set at pre-compile, origin=ARCCORE_ECUC  # Mr-Value Setting
          integer PLL1M: set at pre-compile, origin=ARCCORE_ECUC  # Mr-Value Setting
      container McuDemEventParameterRefs [0..1]  # Container for the references to DemEventParameter elements which shall be invoked using the API Dem_ReportErrorStatus API in case the corresponding error occurs. The EventId is taken from the referenced DemEventParameter's DemEventId symbolic name. The standardized errors are provided in the container and can be extended by vendor specific error references.
        symbolic name reference MCU_E_CLOCK_FAILURE [0..1]: set at pre-compile, destination=DemEventParameter  # Reference to configured DEM event to report "Clock source failure".
      container McuModeSettingConf [1..*]  # This container contains the configuration (parameters) for the Mode setting of the MCU. Please see MCU035 for more information on the MCU mode settings.
        integer McuMode: 0..255, set at post-build in variant post-build / pre-compile in variant pre-compile, symbolic-name-value=true  # The parameter represents the MCU Mode settings.
      container McuRamSectorSettingConf [0..*]  # This container contains the configuration (parameters) for the RAM Sector setting. Please see MCU030 for more information on RAM sec-tor settings.
        integer McuRamDefaultValue: 0..255, set at post-build in variant post-build / pre-compile in variant pre-compile  # This parameter shall represent the Data pre-setting to be initialized
        integer McuRamSectionBaseAddress: 0..4294967295, set at post-build in variant post-build / pre-compile in variant pre-compile  # This parameter shall represent the MCU RAM section base address
        integer McuRamSectionSize: 0..4294967295, set at post-build in variant post-build / pre-compile in variant pre-compile  # This parameter represents the MCU RAM Section size in bytes.
    container McuPublishedInformation  # Container holding all MCU specific published information parameters
      container McuResetReasonConf [1..*]  # This container contains the configuration for the different type of reset reason that can be retrieved from Mcu_GetResetReason Api.
        integer McuResetReason: 0..255, scope=ECU, set at published-information, symbolic-name-value=true  # The parameter represents the different type of reset that a Micro supports. This parameter is referenced by the parameter EcuMResetReason in the ECU State manager module.
