AUTOSAR XML (schema 4-2-2)
package /ArcCore/Implementations/mpc5748g
  bsw implementation Mcu: programming-language=C, sw-version=3.0.0, used-code-generator=mcal::Mcu::gen::Mcu_mpc5748g::main, vendor-id=60, ar-release-version=4.3.0, vendor-specific-module-def=Mcu
