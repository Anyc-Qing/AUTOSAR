AUTOSAR XML (schema 4-2-2)
package /ArcCore/Implementations/tms570lc43x
  bsw implementation Dio: programming-language=C, sw-version=5.0.0, used-code-generator=mcal::Dio::gen::Dio_tms570::main, ar-release-version=4.1.2, vendor-specific-module-def=Dio
