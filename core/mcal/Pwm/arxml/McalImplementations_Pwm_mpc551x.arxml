AUTOSAR XML (schema 4-2-2)
package /ArcCore/EcucDefs/mpc551x/Implementations
  bsw implementation Pwm: programming-language=C, sw-version=2.1.0, used-code-generator=mcal::Pwm::gen::Pwm_mpc551x::main, ar-release-version=4.1.2, vendor-specific-module-def=Pwm
