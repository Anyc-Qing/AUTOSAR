AUTOSAR XML (schema 4-2-2)
package /ArcCore/Implementations/rh850f1l
  bsw implementation Pwm: programming-language=C, sw-version=2.1.0, used-code-generator=mcal::Pwm::gen::Pwm_rh850::main, vendor-id=60, ar-release-version=4.1.3, vendor-specific-module-def=Pwm
