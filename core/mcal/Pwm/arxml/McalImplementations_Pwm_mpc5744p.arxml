AUTOSAR XML (schema 4-2-2)
package /ArcCore/Implementations/mpc5744p
  bsw implementation Pwm: programming-language=C, sw-version=3.1.0, used-code-generator=mcal::Pwm::gen::Pwm_flexpwm::main, vendor-id=60, ar-release-version=4.3.0, vendor-specific-module-def=Pwm
