AUTOSAR XML (schema 4-2-2)
package /ArcCore/EcucDefs/mpc560x
  module definition Pwm [0..*]: refined-module-def=Pwm, variants post-build/pre-compile  # Configuration of Pwm (Pulse Width Modulation) module.
    container PwmChannelConfigSet: multiple-configuration-container=true  # Multiple Configuration Set Container
      container PwmChannel [1..*]  # Configuration of an individual PWM channel.
        enumeration PwmChannelClass [0..1]: {PWM_FIXED_PERIOD, PWM_FIXED_PERIOD_SHIFTED, PWM_VARIABLE_PERIOD}, set at post-build in variant post-build / pre-compile in variant pre-compile  # Class of PWM Channel. | ImplementationType: Pwm_ChannelClassType
        integer PwmChannelId: 0..4294967295, set at pre-compile, symbolic-name-value=true  # Channel Id of the PWM channel. This value will be assigned to the symbolic name derived of the PwmChannel container short name.
        integer PwmDutycycleDefault: 0..32768, set at post-build in variant post-build / pre-compile in variant pre-compile, default-value=0  # Value of duty cycle used for Initialization | 0, represents 0% 0x8000 represents 100%
        enumeration PwmIdleState: {PWM_HIGH, PWM_LOW}, set at post-build in variant post-build / pre-compile in variant pre-compile, default-value=PWM_LOW  # The parameter PWM_IDLE_STATE represents the output state of the PWM after the signal is stopped (e.g. call of Pwm_SetOutputToIdle).
        function name PwmNotification [0..1]: set at post-build in variant post-build / pre-compile in variant pre-compile, default-value=NULL  # Definition of the Callback function.
        float PwmPeriodDefault: 0..Inf, set at post-build in variant post-build / pre-compile in variant pre-compile  # Value of period used for Initialization.(in seconds).
        enumeration PwmPolarity: {PWM_HIGH, PWM_LOW}, set at post-build in variant post-build / pre-compile in variant pre-compile, default-value=PWM_HIGH  # Defines the starting polarity of each PWM channel.
        enumeration ArcPwmMode: {PWM_MODE_BASIC, PWM_MODE_TRIGGERED, PWM_MODE_FREQ_MOD, PWM_MODE_CENTER_ALGN_TRAIL_DT, PWM_MODE_CENTER_ALGN_LEAD_DT, PWM_MODE_COUNTER_BUS_PROVIDER_MCB_UP}, set at post-build in variant post-build / pre-compile in variant pre-compile, default-value=PWM_MODE_BASIC  # The parameter PWM_IDLE_STATE represents the output state of the PWM after the signal is stopped (e.g. call of Pwm_SetOutputToIdle).
        enumeration ArcPwmClkSrc: {PWM_CLKSRC_INTERNAL_COUNTER, PWM_CLKSRC_COUNTER_BUS_B_TO_E, PWM_CLKSRC_COUNTER_BUS_A}, set at post-build in variant post-build / pre-compile in variant pre-compile  # Defines the clock source of each PWM channel. I.e. INTERNAL_COUNTER to select the internal counter bus.
        enumeration ArcPwmChannelPrescaler: {AUTO, 1, 2, 3, 4}, set at post-build in variant post-build / pre-compile in variant pre-compile, origin=ARCCORE_ECUC, default-value=AUTO  # Prescaler divisor for this channel. Choose AUTO to let the implementation choose a suitable prescaler.
    container PwmConfigurationOfOptApiServices  # Configuration of optional interfaces.
      boolean PwmDeInitApi: set at pre-compile, default-value=0  # Adds / removes the service Pwm_DeInit() from the code.
      boolean PwmGetOutputState: set at pre-compile, default-value=0  # Adds / removes the service PwmGetOutputState() from the code.
      boolean PwmSetDutyCycle: set at pre-compile, default-value=1  # Adds / removes the service PwmSetDutyCycle() from the code.
      boolean PwmSetOutputToIdle: set at pre-compile, default-value=0  # Adds / removes the service PwmSetOutputToIdle() from the code.
      boolean PwmSetPeriodAndDuty: set at pre-compile, default-value=0  # Adds / removes the service PwmSetPeriodAndDuty() from the code.
      boolean PwmVersionInfoApi: set at pre-compile, default-value=0  # Switch to indicate that the Pwm_ GetVersionInfo is supported
    container PwmGeneral  # General properties of the Pwm module
      boolean PwmDevErorDetect: set at pre-compile  # Switch for enabling the development error detection.
      boolean PwmDutycycleUpdatedEndperiod: set at pre-compile  # Switch for enabling the update of the duty cycle parameter at the end of the current period. | TRUE: update of duty cycle is done at the end of period of currently generated waveform (current waveform is finished). FALSE: update of duty cycle is done immediately (just after service call, current waveform is cut).
      integer ArcPwmGlobalPrescalerDivisorEMIOS0: 1..256, set at pre-compile, origin=ARC_ECUC, default-value=1  # Module wide prescaler divisor value
      boolean PwmNotificationSupported: set at pre-compile, default-value=0  # Switch to indicate that the notifications are supported
      boolean PwmPeriodUpdatedEndperiod: set at pre-compile  # Switch for enabling the update of the period parameter at the end of the current period. | TRUE: update of period/duty cycle is done at the end of period of currently generated waveform (current waveform is finished). FALSE: update of period/duty cycle is done immediately (just after service call, current waveform is cut).
      integer ArcPwmGlobalPrescalerDivisorEMIOS1: 1..256, set at pre-compile, origin=ARC_ECUC, default-value=1  # Module wide prescaler divisor value
      integer PwmIndex: 0..4294967295, set at pre-compile  # Specifies the InstanceId of this module instance. If only one instance is present it shall have the Id 0.
      boolean PwmLowPowerStatesSupport [0..1]: set at pre-compile, default-value=false  # Adds / removes all power state management related APIs (PWM_SetPowerState, PWM_GetCurrentPowerState, PWM_GetTargetPowerState, PWM_PreparePowerState, PWM_Main_PowerTransitionManager), indicating if the HW offers low power state management.
      boolean PwmPowerStateAsynchTransitionMode [0..1]: set at pre-compile, default-value=false  # Enables / disables support of the PWM Driver to the asynchronous power state transition.
      boolean PwmDevErrorDetect: set at pre-compile, default-value=1  # Switch for enabling the development error detection.
      integer ArcPwmGlobalPrescalerDivisorEMIOS2: 1..256, set at pre-compile, origin=ARC_ECUC, default-value=1  # Module wide prescaler divisor value
      container PwmPowerStateConfig [0..*]  # Each instance of this parameter defines a power state and the callback to be called when this power state is reached.
        integer PwmPowerState: 0..18446744073709551615, set at pre-compile, symbolic-name-value=true  # Each instance of this parameter describes a different power state supported by the PWM HW. It should be defined by the HW supplier and used by the PWMDriver to reference specific HW configurations which set the PWM HW module in the referenced power state. | At least the power mode corresponding to full power state shall be always configured.
        function name PwmPowerStateReadyCbkRef: set at pre-compile  # Each instance of this parameter contains a reference to a power mode callback defined in a CDD or IoHwAbs component.
