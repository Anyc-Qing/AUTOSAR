AUTOSAR XML (schema 4-2-2)
package /OsPerf_mpc5744p_mmb
  ecuc value collection OsPerf: ecuc-values=[Os, Dio, EcuM, Mcu, Port]
