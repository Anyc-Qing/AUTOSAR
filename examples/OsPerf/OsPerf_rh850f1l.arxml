AUTOSAR XML (schema 4-2-2)
package /OsPerf_rh850f1l
  ecuc value collection OsPerf: ecuc-values=[Mcu, EcuM, Port, Dio, Os, Gpt]
  module config Port: implementation-config-variant=VARIANT-PRE-COMPILE, module-description=Port
    PortConfigSet
      PortContainer: PortNumberOfPortPins=
        P8_0 (PortPin):
          PortPinDirection = PORT_PIN_IN
          PortPinDirectionChangeable = 0
          PortPinId = 98
          PortPinInitialMode = PORT_PIN_MODE_DIO
          PortPinLevelValue = PORT_PIN_LEVEL_LOW
          PortPinMode = PORT_PIN_MODE_DIO
          PortPinModeChangeable = 0
          ArcPortPinPull = PORT_PIN_PULL_NONE
          ArcPortPinSlewRate = PORT_PIN_SLEW_RATE_MIN
          ArcPortPinOpenDrainEnable = 0
          ArcPortPadId = P8_0
    PortGeneral: PortDevErrorDetect=true, PortSetPinDirectionApi=false, PortSetPinModeApi=false, PortVersionInfoApi=false
  module config Dio: implementation-config-variant=VARIANT-PRE-COMPILE, module-description=Dio
    DioConfig
      P8 (DioPort): DioPortId=0
        LED7 (DioChannel): DioChannelId=29
      AP0 (DioPort): DioPortId=1
        LED10_AP0 (DioChannel): DioChannelId=44
    DioGeneral: DioDevErrorDetect=1, DioFlipChannelApi=, DioVersionInfoApi=1
  module config Gpt: implementation-config-variant=VARIANT-PRE-COMPILE, module-description=Gpt
    GptChannelConfigSet
      GptCh0 (GptChannelConfiguration):
        GptChannelId = 
        GptChannelMode = GPT_CH_MODE_CONTINUOUS
        GptChannelTickFrequency = 
        GptChannelTickValueMax = 
        GptEnableWakeup = 0
        ArcGptChannelPrescaler = GPT_CH_PRESALER_CK0
        ArcGptChannelPhysical = 0
        GptNotification = Gpt_NotifCh0
        GptChannelClkSrcRef = (unset)
      GptCh1 (GptChannelConfiguration):
        GptChannelId = 
        GptChannelMode = GPT_CH_MODE_CONTINUOUS
        GptChannelTickFrequency = 
        GptChannelTickValueMax = 
        GptEnableWakeup = 0
        ArcGptChannelPrescaler = GPT_CH_PRESALER_CK0
        ArcGptChannelPhysical = 1
        GptNotification = Gpt_NotifCh1
        GptChannelClkSrcRef = (unset)
    GptConfigurationOfOptApiServices: GptDeinitApi=0, GptEnableDisableNotificationApi=1, GptTimeElapsedApi=0, GptTimeRemainingApi=0, GptVersionInfoApi=0, GptWakeupFunctionalityApi=0
    GptDriverConfiguration: GptDevErrorDetect=1, GptReportWakeupSource=0, GptPredefTimer100us32bitEnable=, GptPredefTimer1usEnablingGrade=
      GptClockReferencePoint: GptClockReference=(unset)
