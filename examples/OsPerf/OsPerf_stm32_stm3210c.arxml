AUTOSAR XML (schema 4-2-2)
package /OsPerf_stm32_stm3210c
  ecuc value collection OsPerf: ecuc-values=[Mcu, EcuM, Os, Dio, Port]
