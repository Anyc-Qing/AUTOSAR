AUTOSAR XML (schema 4-2-2)
package /OsPerf_jacinto6
  ecuc value collection OsPerf: ecuc-values=[Dio, Mcu, Port, Os, EcuM]
  module config EcuM: implementation-config-variant=VARIANT-PRE-COMPILE, module-description=EcuM
    EcuMConfiguration
      EcuMCommonConfiguration: EcuMConfigConsistencyHash=(unset), EcuMDefaultAppMode=(unset), EcuMOSResource=(unset)
        EcuMDefaultShutdownTarget: EcuMDefaultState=EcuMStateOff
        EcuMSleepMode: EcuMSleepModeId=(unset), EcuMSleepModeSuspend=(unset), EcuMSleepModeMcuModeRef=RUN, EcuMWakeupSourceMask=EcuMWakeupSource
        EcuMWakeupSource: EcuMWakeupSourceId=(unset), EcuMWakeupSourcePolling=0, EcuMResetReasonRef=(unset)
      EcuMFixedConfiguration: EcuMNvramReadallTimeout=10.0, EcuMNvramWriteallTimeout=10.0, EcuMRunMinimumDuration=10.0, EcuMNormalMcuModeRef=NORMAL
        User_1 (EcuMFixedUserConfig): EcuMFixedUser=(unset)
    EcuMGeneral: EcuMDevErrorDetect=0, EcuMIncludeDem=0, EcuMIncludeDet=0, EcuMMainFunctionPeriod=0.2, EcuMVersionInfoApi=0
    EcuMFixedGeneral: EcuMIncludeComM=(unset), EcuMIncludeNvM=(unset), EcuMIncludeNvramMgr=(unset), EcuMTTIIEnabled=(unset), EcuMTTIIWakeupSourceRef=(unset)
