AUTOSAR XML (schema 4-1-1)
package /OsPerf_mpc5567qrtech
  ecuc value collection OsPerf: ecuc-values=[Dio, EcuM, Mcu, Port, Os]
