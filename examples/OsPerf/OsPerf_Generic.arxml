AUTOSAR XML (schema 4-2-2)
package /OsPerf
  ecuc value collection OsPerf: ecuc-values=Os
  module config Os: implementation-config-variant=VARIANT-PRE-COMPILE, module-description=Os
    OsAppMode
    OsOS:
      OsScalabilityClass = SC1
      OsStackMonitoring = 1
      OsStatus = STANDARD
      OsUseGetServiceId = 1
      OsUseParameterAccess = 1
      OsUseResScheduler = 1
      ArcOsTickFrequency = 100
      ArcOsInterruptStackSize = 2048
      ArcOsIdleStackSize = 2048
      ArcOsMaxIsr = 10
      ArcSafetyPlatform = false
      OsHooks: OsErrorHook=1, OsPostTaskHook=1, OsPreTaskHook=1, OsShutdownHook=1, OsStartupHook=1
      ArcOsDebug: OsTaskDebug=0, OsAlarmDebug=0, OsResourceDebug=0, OsScheduleTableDebug=0, OsEventDebug=0, OsDebugActivated=0
    OsApplication:
      OsTrusted = 1
      OsAppAlarmRef = OsAlarm_10ms
      OsAppCounterRef = OsCounter
      OsAppTaskRef = SchM_BswService
      OsAppTaskRef = SchM_Startup
      OsAppTaskRef = TaskLoad
      OsAppAlarmRef = Alarm_BswService
      OsApplicationHooks: OsAppErrorHook=0, OsAppShutdownHook=0, OsAppStartupHook=0
    OsCounter:
      OsCounterMaxAllowedValue = 65535
      OsCounterMinCycle = 1
      OsCounterTicksPerBase = (unset)
      OsCounterType = OS_TICK
      OsCounterAccessingApplication = OsApplication
    3 x OsTask, all with OsTaskActivation=1, OsTaskSchedule=FULL, ArcOsTaskStackSize=2048, OsTaskAccessingApplication=OsApplication:
      SchM_Startup: OsTaskPriority=1
        OsTaskAutostart: OsTaskAppModeRef=(unset)
      SchM_BswService: OsTaskPriority=2
      TaskLoad: OsTaskPriority=1, OsTaskEventRef=OsEvent_10ms
    OsEvent_10ms (OsEvent)
    OsResource: OsResourceProperty=STANDARD, OsResourceAccessingApplication=OsApplication
    OsAlarm_10ms (OsAlarm): OsAlarmCounterRef=OsCounter, OsAlarmAccessingApplication=OsApplication
      OsAlarmAction
        OsAlarmSetEvent: OsAlarmSetEventRef=OsEvent_10ms, OsAlarmSetEventTaskRef=TaskLoad
    Alarm_BswService (OsAlarm): OsAlarmCounterRef=OsCounter, OsAlarmAccessingApplication=OsApplication
      OsAlarmAction
        OsAlarmActivateTask: OsAlarmActivateTaskRef=SchM_BswService
