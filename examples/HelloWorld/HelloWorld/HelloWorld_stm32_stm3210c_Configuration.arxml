AUTOSAR XML (schema 4-3-0)
package /HelloWorld_stm32_stm3210c
  ecuc value collection HelloWorld: ecu-extract=HelloWorld
    ecuc-values:
      CanIf
      CanSM
      Com
      ComM
      Det
      EcuC
      EcuM
      Os
      PduR
      Rte
      BswM
      CanTp
      Dcm
      Dem
      Xcp
      Mcu
      Can
      Dio
      Port
      Adc
      Pwm
      Dlt
      Crc
      Fee
      MemIf
      NvM
      WdgIf
      WdgM
      IoHwAb
      FiM
  module config Crc: implementation-config-variant=VARIANT-PRE-COMPILE, module-description=Crc
    CrcGeneral: Crc32Mode=CRC_32_TABLE, Crc16Mode=CRC_16_TABLE, Crc8H2FMode=CRC_8H2F_TABLE, Crc8Mode=CRC_8_TABLE, Crc32P4Mode=CRC_32P4_TABLE
  module config Fee: implementation-config-variant=VARIANT-PRE-COMPILE, module-description=Fee
    SwcMem_Block1 (FeeBlockConfiguration): FeeBlockNumber=1, FeeBlockSize=8, FeeImmediateData=(unset), FeeNumberOfWriteCycles=1, FeeDeviceIndex=(unset)
    FeeGeneral:
      FeeDevErrorDetect = 1
      FeeIndex = 0
      FeePollingMode = 1
      FeeSetModeSupported = (unset)
      FeeVersionInfoApi = 0
      FeeVirtualPageSize = 8
      ArcUseJobNotifications = 1
      ArcFeeBank1Size = 2048
      ArcFeeBank2Size = 2048
      ArcFeeBank1Offset = 134447104
      ArcFeeBank2Offset = 134449152
    FeePublishedInformation: FeeBlockOverhead=(unset), FeeMaximumBlockingTime=(unset), FeePageOverhead=(unset)
    SwcMem_Block2 (FeeBlockConfiguration): FeeBlockNumber=2, FeeBlockSize=8, FeeImmediateData=, FeeNumberOfWriteCycles=1, FeeDeviceIndex=(unset)
  module config MemIf: implementation-config-variant=VARIANT-PRE-COMPILE, module-description=MemIf
    MemIfGeneral: MemIfDevErrorDetect=0, MemIfNumberOfDevices=1, MemIfVersionInfoApi=0
  module config NvM: implementation-config-variant=VARIANT-PRE-COMPILE, module-description=NvM
    SwcMem_Block1 (NvMBlockDescriptor):
      NvMBlockJobPriority = (unset)
      NvMBlockManagementType = NVM_BLOCK_NATIVE
      NvMBlockUseCrc = 1
      NvMBlockUseSyncMechanism = 0
      NvMBlockWriteProt = 0
      NvMBswMBlockStatusInformation = 0
      NvMMaxNumOfReadRetries = 0
      NvMMaxNumOfWriteRetries = (unset)
      NvMNvBlockBaseNumber = 1
      NvMNvBlockLength = 4
      NvMNvBlockNum = 1
      NvMNvramBlockIdentifier = 
      NvMNvramDeviceId = 1
      NvMResistantToChangedSw = (unset)
      NvMRomBlockNum = 0
      NvMStaticBlockIDCheck = 0
      NvMWriteBlockOnce = (unset)
      NvMWriteVerification = 0
      NvMWriteVerificationDataSize = 1
      NvMBlockCrcType = NVM_CRC32
      NvMSelectBlockForReadAll = 1
      NvMRamBlockDataAddress = Rte_Pim_SwcMemType_SwcMem_PIM1
      NvMCalcRamBlockCrc = 0
      NvMTargetBlockReference
        NvMFeeRef: NvMNameOfFeeBlock=Fee/SwcMem_Block1
    NvMCommon:
      NvMApiConfigClass = NVM_API_CONFIG_CLASS_3
      NvMBswMMultiBlockJobStatusInformation = 1
      NvMCompiledConfigId = (unset)
      NvMCrcNumOfBytes = (unset)
      NvMDatasetSelectionBits = 0
      NvMDevErrorDetect = 1
      NvMDrvModeSwitch = (unset)
      NvMDynamicConfiguration = (unset)
      NvMJobPrioritization = 0
      NvMPollingMode = 0
      NvMRepeatMirrorOperations = 0
      NvMSetRamBlockStatusApi = 1
      NvMSizeStandardJobQueue = 5
      NvMVersionInfoApi = 0
    SwcMem_Block2 (NvMBlockDescriptor):
      NvMBlockJobPriority = (unset)
      NvMBlockManagementType = NVM_BLOCK_NATIVE
      NvMBlockUseCrc = 1
      NvMBlockUseSyncMechanism = 0
      NvMBlockWriteProt = 0
      NvMBswMBlockStatusInformation = 0
      NvMMaxNumOfReadRetries = 0
      NvMMaxNumOfWriteRetries = (unset)
      NvMNvBlockBaseNumber = 2
      NvMNvBlockLength = 4
      NvMNvBlockNum = 1
      NvMNvramBlockIdentifier = 
      NvMNvramDeviceId = 1
      NvMResistantToChangedSw = (unset)
      NvMRomBlockNum = 0
      NvMStaticBlockIDCheck = 0
      NvMWriteBlockOnce = (unset)
      NvMWriteVerification = 0
      NvMWriteVerificationDataSize = 1
      NvMBlockCrcType = NVM_CRC32
      NvMTargetBlockReference
        NvMFeeRef: NvMNameOfFeeBlock=Fee/SwcMem_Block2
  module config IoHwAb: implementation-config-variant=VARIANT-PRE-COMPILE, module-description=IoHwAb
    ArcIoHwAbGeneral: ArcIoHwAbDevErrorDetect=1, ArcIoHwAbAnalogMaxVoltage=5.0, ArcIoHwAbUsePort=1, ArcIoHwCalibrationEnabled=0
    DigitalSignal_LED1 (ArcIoHwAbDigitalSignal):
      ArcIoHwAbDigitalDefaultValue = IOHWAB_HIGH
      ArcIoHwAbDigitalInverted = 0
      ArcIoHwAbDigitalMethod = IOHWAB_DIGITAL_WRITE
      ArcIoHwAbDigitalType = IOHWAB_DIO
      ArcIoHwAbDioChannelRef = LED1
    DigitalSignal_LED2 (ArcIoHwAbDigitalSignal):
      ArcIoHwAbDigitalDefaultValue = IOHWAB_HIGH
      ArcIoHwAbDigitalInverted = 0
      ArcIoHwAbDigitalMethod = IOHWAB_DIGITAL_WRITE
      ArcIoHwAbDigitalType = IOHWAB_DIO
      ArcIoHwAbDioChannelRef = LED2
    VoltScaling (ArcIoHwAbScaling): ArcIoHwAbScalingOffset=0.0, ArcIoHwAbScalingScale=1.0, ArcIoHwAbScalingType=Volt
    AnalogSignal (ArcIoHwAbAnalogSignal):
      ArcIoHwAbAnalogDefaultValue = 0.0
      ArcIoHwAbAnalogSignalResolution = 12_BIT_RESOLUTION
      ArcIoHwAbAnalogType = IOHWAB_ADC
      ArcIoHwAbScalingRef = VoltScaling
      ArcIoHwAbAdcChannel = AdcChannel1
      ArcIoHwAbAdcGroup = AdcGroup1
    PwmSignal_LED3 (ArcIoHwAbPwmSignal): ArcIoHwAbPwmType=IOHWAB_PWM_DUTY, ArcIoHwAbPwmDutyDefaultValue=0, ArcIoHwAbPwmChannel=Channel_LED_3
