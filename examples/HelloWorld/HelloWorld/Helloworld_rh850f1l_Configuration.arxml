AUTOSAR XML (schema 4-3-0)
package /Helloworld_rh850f1l_Configuration
  ecuc value collection HelloWorld: ecu-extract=HelloWorld
    ecuc-values:
      Mcu
      CanIf
      CanSM
      Com
      ComM
      Det
      EcuC
      Os
      PduR
      Rte
      IoHwAb
      BswM
      CanTp
      Dcm
      Dem
      Xcp
      Can
      Adc
      Dio
      EcuM
      Port
      Pwm
      WdgIf
      WdgM
      Dlt
      Wdg
      Crc
      Ea
      MemIf
      NvM
      Spi
      FiM
  module config Can: implementation-config-variant=VARIANT-PRE-COMPILE, module-description=Can
    CanConfigSet
      CanController0 (CanController):
        CanBusoffProcessing = INTERRUPT
        CanControllerActivation = true
        CanControllerBaseAddress = 
        CanControllerId = 
        CanRxProcessing = INTERRUPT
        CanTxProcessing = INTERRUPT
        CanWakeupFunctionalityAPI = false
        CanWakeupProcessing = INTERRUPT
        CanWakeupSupport = false
        ArcCanControllerLoopback = false
        ArcCanControllerHwUnit = RSCAN_CH0
        ArcCanRxFifoDepth = RXFIFO_SZ_32
        CanControllerDefaultBaudrate = CanControllerBaudrateConfig
        CanCpuClockRef = (unset)
        CanControllerBaudrateConfig:
          CanControllerBaudRate = 500
          CanControllerBaudRateConfigID = 0
          CanControllerSeg1 = 11
          CanControllerSeg2 = 2
          CanControllerSyncJumpWidth = 1
          CanControllerPropSeg = 2
      Ctrl_0_Rx_0 (CanHardwareObject): CanHandleType=BASIC, CanIdType=STANDARD, CanObjectId=, CanObjectType=RECEIVE, CanControllerRef=CanController0
        CanHwFilter: CanHwFilterCode=2, CanHwFilterMask=0
      Ctrl_0_Tx_0 (CanHardwareObject): CanHandleType=BASIC, CanIdType=STANDARD, CanObjectId=, CanObjectType=TRANSMIT, CanControllerRef=CanController0
    CanGeneral:
      CanDevErrorDetection = true
      CanHardwareCancellation = false
      CanIdenticalIdCancellation = false
      CanIndex = 
      CanMainFunctionModePeriod = 
      CanMultiplexedTransmission = false
      CanTimeoutDuration = 
      CanVersionInfoApi = false
      CanCounterRef = (unset)
      CanSupportTTCANRef = (unset)
      CanMainFunctionRWPeriods
  module config Adc: implementation-config-variant=VARIANT-PRE-COMPILE, module-description=Adc
    AdcConfigSet
      AdcHwUnit: AdcHwUnitId=HWUNIT_ADCA0, ArcAdcResolution=ADC_RESOLUTION_12_BITS
        AdcChannel1 (AdcChannel): AdcChannelId=, ArcAdcChannelId=ADCAnI6
        AdcGroup1 (AdcGroup):
          AdcGroupAccessMode = ADC_ACCESS_MODE_SINGLE
          AdcGroupConversionMode = ADC_CONV_MODE_ONESHOT
          AdcGroupId = 
          AdcGroupTriggSrc = 
          AdcStreamingBufferMode = ADC_STREAM_BUFFER_LINEAR
          AdcStreamingNumSamples = 1
          AdcNotification = IoHwAb_AdcConversionComplete
          AdcGroupDefinition = AdcChannel1
    AdcGeneral:
      AdcDeInitApi = true
      AdcDevErrorDetect = true
      AdcEnableLimitCheck = false
      AdcEnableQueuing = false
      AdcEnableStartStopGroupApi = true
      AdcGrpNotifCapability = true
      AdcHwTriggerApi = false
      AdcPriorityImplementation = 
      AdcReadGroupApi = true
      AdcResultAlignment = 
      AdcVersionInfoApi = true
    AdcPublishedInformation: AdcChannelValueSigned=, AdcGroupFirstChannelFixed=, AdcMaxChannelResolution=
  module config Dio: implementation-config-variant=VARIANT-PRE-COMPILE, module-description=Dio
    DioConfig
      LED_PORT (DioPort): DioPortId=0
        LED1 (DioChannel): DioChannelId=98
        LED2 (DioChannel): DioChannelId=99
    DioGeneral: DioDevErrorDetect=1, DioFlipChannelApi=, DioVersionInfoApi=0
  module config Port: implementation-config-variant=VARIANT-PRE-COMPILE, module-description=Port
    PortConfigSet
      4 x PortContainer, all with PortNumberOfPortPins=:
        SPI
          4 x PortPin, all with PortPinDirectionChangeable=0, PortPinInitialMode=PORT_PIN_MODE_CSIH0, PortPinLevelValue=PORT_PIN_LEVEL_LOW, PortPinMode=PORT_PIN_MODE_CSIH0, PortPinModeChangeable=0, ArcPortPinPull=PORT_PIN_PULL_NONE, ArcPortPinSlewRate=PORT_PIN_SLEW_RATE_MIN, ArcPortPinOpenDrainEnable=0:
            CSIH0CSS2: PortPinDirection=PORT_PIN_OUT, PortPinId=102, ArcPortPadId=CSIH0CSS2
            CSIH0SI: PortPinDirection=PORT_PIN_IN, PortPinId=41, ArcPortPadId=CSIH0SI
            CSIH0SC: PortPinDirection=PORT_PIN_OUT, PortPinId=42, ArcPortPadId=CSIH0SC
            CSIH0SO: PortPinDirection=PORT_PIN_OUT, PortPinId=43, ArcPortPadId=CSIH0SO
        LEDS
          4 x PortPin, all with PortPinDirectionChangeable=0, PortPinInitialMode=PORT_PIN_MODE_DIO, PortPinLevelValue=PORT_PIN_LEVEL_LOW, PortPinMode=PORT_PIN_MODE_DIO, PortPinModeChangeable=0, ArcPortPinPull=PORT_PIN_PULL_NONE, ArcPortPinSlewRate=PORT_PIN_SLEW_RATE_MIN, ArcPortPinOpenDrainEnable=0, ArcPortPadId=:
            P8_2: PortPinDirection=PORT_PIN_IN, PortPinId=100
            P8_0: PortPinDirection=PORT_PIN_OUT, PortPinId=98
            P8_1: PortPinDirection=PORT_PIN_OUT, PortPinId=99
            P8_3: PortPinDirection=PORT_PIN_OUT, PortPinId=101
        CAN
          CAN0RX_INTP0 (PortPin):
            PortPinDirection = PORT_PIN_IN
            PortPinDirectionChangeable = 0
            PortPinId = 118
            PortPinInitialMode = PORT_PIN_MODE_CAN0
            PortPinLevelValue = PORT_PIN_LEVEL_LOW
            PortPinMode = PORT_PIN_MODE_CAN0
            PortPinModeChangeable = 0
            ArcPortPinPull = PORT_PIN_PULL_NONE
            ArcPortPinSlewRate = PORT_PIN_SLEW_RATE_MIN
            ArcPortPinOpenDrainEnable = 0
            ArcPortPadId = CAN0RX_INTP0
          CAN0TX (PortPin):
            PortPinDirection = PORT_PIN_OUT
            PortPinDirectionChangeable = 0
            PortPinId = 119
            PortPinInitialMode = PORT_PIN_MODE_CAN0
            PortPinLevelValue = PORT_PIN_LEVEL_LOW
            PortPinMode = PORT_PIN_MODE_CAN0
            PortPinModeChangeable = 0
            ArcPortPinPull = PORT_PIN_PULL_NONE
            ArcPortPinSlewRate = PORT_PIN_SLEW_RATE_MIN
            ArcPortPinOpenDrainEnable = 0
            ArcPortPadId = CAN0TX
        PWM
          TAUD0O5 (PortPin):
            PortPinDirection = PORT_PIN_OUT
            PortPinDirectionChangeable = 0
            PortPinId = 120
            PortPinInitialMode = PORT_PIN_MODE_TAUD0
            PortPinLevelValue = PORT_PIN_LEVEL_LOW
            PortPinMode = PORT_PIN_MODE_TAUD0
            PortPinModeChangeable = 0
            ArcPortPinPull = PORT_PIN_PULL_NONE
            ArcPortPinSlewRate = PORT_PIN_SLEW_RATE_MIN
            ArcPortPinOpenDrainEnable = 0
            ArcPortPadId = TAUD0O5
    PortGeneral: PortDevErrorDetect=true, PortSetPinDirectionApi=true, PortSetPinModeApi=true, PortVersionInfoApi=true
  module config Pwm: implementation-config-variant=VARIANT-PRE-COMPILE, module-description=Pwm
    PwmChannelConfigSet
      Channel_LED_3 (PwmChannel):
        PwmChannelId = 4
        PwmDutycycleDefault = 16384
        PwmIdleState = PWM_LOW
        PwmPeriodDefault = 0.001
        PwmPolarity = PWM_HIGH
        ArcPwmChannelPrescaler = PWM_CH_PRESALER_CK3
        PwmChannelClass = PWM_FIXED_PERIOD
    PwmConfigurationOfOptApiServices: PwmDeInitApi=0, PwmGetOutputState=0, PwmSetDutyCycle=1, PwmSetOutputToIdle=0, PwmSetPeriodAndDuty=0, PwmVersionInfoApi=0
    PwmGeneral: PwmDevErrorDetect=1, PwmDutycycleUpdatedEndperiod=, PwmIndex=, PwmNotificationSupported=1, PwmPeriodUpdatedEndperiod=
  module config WdgIf: implementation-config-variant=VARIANT-PRE-COMPILE, module-description=WdgIf
    Wdg (WdgIfDevice): WdgIfDeviceIndex=0, WdgIfDriverRef=(unset)
    WdgIfGeneral: WdgIfDevErrorDetect=1, WdgIfVersionInfoApi=1
  module config WdgM: implementation-config-variant=VARIANT-PRE-COMPILE, module-description=WdgM
    WdgMConfigSet: WdgMInitialMode=WatchdogOn
      WatchdogOn (WdgMMode): WdgMExpiredSupervisionCycleTol=1, WdgMModeId=1, WdgMSupervisionCycle=0.01
        WdgMAliveSupervision1 (WdgMAliveSupervision):
          WdgMExpectedAliveIndications = 4
          WdgMMaxMargin = 1
          WdgMMinMargin = 1
          WdgMSupervisionReferenceCycle = 40
          WdgMAliveSupervisionCheckpointRef = Supervised100msCheckpoint
        WdgMTrigger: WdgMTriggerConditionValue=1, WdgMWatchdogMode=WDGIF_SLOW_MODE, WdgMTriggerWatchdogRef=WdgMWatchdog
      WatchdogOff (WdgMMode): WdgMExpiredSupervisionCycleTol=0, WdgMModeId=(unset), WdgMSupervisionCycle=0.01
        WdgMTrigger: WdgMTriggerConditionValue=1, WdgMWatchdogMode=WDGIF_OFF_MODE, WdgMTriggerWatchdogRef=WdgMWatchdog
    WdgMGeneral: WdgMDefensiveBehavior=0, WdgMDemStoppedSupervisionReport=0, WdgMDevErrorDetect=1, WdgMImmediateReset=0, WdgMOffModeEnabled=0, WdgMVersionInfoApi=1
      Supervised100msTask (WdgMSupervisedEntity): WdgMSupervisedEntityId=(unset), WdgMInternalCheckpointInitialRef=Supervised100msCheckpoint, WdgMInternallCheckpointFinalRef=(unset)
        Supervised100msCheckpoint (WdgMCheckpoint): WdgMCheckpointId=1
      WdgMWatchdog: WdgMWatchdogName=TheDog, WdgMWatchdogDeviceRef=Wdg
      WdgMCallerIds: WdgMCallerId=1
  module config Dlt: implementation-config-variant=VARIANT-PRE-COMPILE, module-description=Dlt
    DltGeneral:
      DltDevErrorDetect = 1
      DltImplementAppIdContextIdQuery = 1
      DltImplementExtendedHeader = 
      DltImplementFilterMessages = 1
      DltImplementNVRamStorage = 
      DltImplementSWCInjection = 
      DltImplementTimestamp = 0
      DltImplementVerboseMode = 1
      DltImplementVfbTrace = 
      DltVfbTraceLogLevel = 
      DltGptChannel = (unset)
    DltMemory: DltInitBufferSize=, DltMaxCountAppIds=, DltMaxCountContextIds=, DltMaxCountContextIdsPerAppId=, DltMessageBufferSize=5200
    DltMultipleConfigurationContainer: DltNvRamBlockRef=(unset)
      DltBandwidth: DltBandwidthForComModule=, DltBandwidthForDiagChannel=, DltTimePeriodTrafficShaping=
      DltMessageFiltering: DltDefaultMaxLogLevel=6, DltDefaultTraceStatus=, DltFactoryDefaultMaxLogLevel=, DltFilterMessages=1
      DltProtocol:
        DltEcuId = DLTT
        DltHeaderPayloadEndianes = BigEndian
        DltHeaderUseEcuId = 1
        DltHeaderUseExtendedHeader = 1
        DltHeaderUseSessionID = 1
        DltHeaderUseTimestamp = 0
        DltMaxMessageLength = 520
        DltUseVerboseMode = 1
  module config Wdg: implementation-config-variant=VARIANT-PRE-COMPILE, module-description=Wdg
    WdgGeneral: WdgDevErrorDetect=1, WdgDisableAllowed=, WdgIndex=, WdgInitialTimeout=1, WdgMaxTimeout=2, WdgRunArea=, WdgTriggerLocation=, WdgVersionInfoApi=1
    WdgPublishedInformation: WdgTriggerMode=
    WdgSettingsConfig: WdgDefaultMode=WDGIF_OFF_MODE
      WdgSettingsFast: ArcWdgFastTimeout=9
      WdgSettingsOff
      WdgSettingsSlow: ArcWdgSlowTimeout=17476
  module config Crc: implementation-config-variant=VARIANT-PRE-COMPILE, module-description=Crc
    CrcGeneral: Crc32Mode=CRC_32_TABLE, Crc16Mode=CRC_16_TABLE, Crc8H2FMode=CRC_8H2F_TABLE, Crc8Mode=CRC_8_TABLE
  module config Ea: implementation-config-variant=VARIANT-PRE-COMPILE, module-description=Ea
    SwcMem_Block2 (EaBlockConfiguration): EaBlockNumber=2, EaBlockSize=8, EaImmediateData=0, EaNumberOfWriteCycles=(unset), EaDeviceIndex=(unset)
    EaGeneral: EaDevErrorDetect=1, EaIndex=0, EaPollingMode=(unset), EaSetModeSupported=true, EaVersionInfoApi=0, EaVirtualPageSize=8
    EaPublishedInformation: EaBlockOverhead=(unset), EaMaximumBlockingTime=(unset), EaPageOverhead=(unset)
    SwcMem_Block1 (EaBlockConfiguration): EaBlockNumber=1, EaBlockSize=8, EaImmediateData=false, EaNumberOfWriteCycles=, EaDeviceIndex=(unset)
  module config MemIf: implementation-config-variant=VARIANT-PRE-COMPILE, module-description=MemIf
    MemIfGeneral: MemIfDevErrorDetect=0, MemIfNumberOfDevices=1, MemIfVersionInfoApi=0
  module config NvM: implementation-config-variant=VARIANT-PRE-COMPILE, module-description=NvM
    SwcMem_Block1 (NvMBlockDescriptor):
      NvMBlockJobPriority = (unset)
      NvMBlockManagementType = NVM_BLOCK_NATIVE
      NvMBlockUseCrc = 1
      NvMBlockUseSyncMechanism = 0
      NvMBlockWriteProt = 0
      NvMBswMBlockStatusInformation = 0
      NvMMaxNumOfReadRetries = 0
      NvMMaxNumOfWriteRetries = (unset)
      NvMNvBlockBaseNumber = 1
      NvMNvBlockLength = 4
      NvMNvBlockNum = 1
      NvMNvramBlockIdentifier = 
      NvMNvramDeviceId = 1
      NvMResistantToChangedSw = (unset)
      NvMRomBlockNum = 0
      NvMStaticBlockIDCheck = 0
      NvMWriteBlockOnce = (unset)
      NvMWriteVerification = 0
      NvMWriteVerificationDataSize = 1
      NvMBlockCrcType = NVM_CRC32
      NvMRamBlockDataAddress = Rte_Pim_SwcMemType_SwcMem_PIM1
      NvMSelectBlockForReadAll = 1
      NvMCalcRamBlockCrc = 1
      NvMTargetBlockReference
        NvMEaRef: NvMNameOfEaBlock=Ea/SwcMem_Block1
    NvMCommon:
      NvMApiConfigClass = NVM_API_CONFIG_CLASS_3
      NvMBswMMultiBlockJobStatusInformation = 1
      NvMCompiledConfigId = (unset)
      NvMCrcNumOfBytes = (unset)
      NvMDatasetSelectionBits = 0
      NvMDevErrorDetect = 1
      NvMDrvModeSwitch = (unset)
      NvMDynamicConfiguration = (unset)
      NvMJobPrioritization = 0
      NvMPollingMode = 0
      NvMRepeatMirrorOperations = 0
      NvMSetRamBlockStatusApi = 1
      NvMSizeStandardJobQueue = 5
      NvMVersionInfoApi = 0
    SwcMem_Block2 (NvMBlockDescriptor):
      NvMBlockJobPriority = (unset)
      NvMBlockManagementType = NVM_BLOCK_NATIVE
      NvMBlockUseCrc = 1
      NvMBlockUseSyncMechanism = 0
      NvMBlockWriteProt = 0
      NvMBswMBlockStatusInformation = 0
      NvMMaxNumOfReadRetries = 0
      NvMMaxNumOfWriteRetries = (unset)
      NvMNvBlockBaseNumber = 2
      NvMNvBlockLength = 4
      NvMNvBlockNum = 1
      NvMNvramBlockIdentifier = 
      NvMNvramDeviceId = 1
      NvMResistantToChangedSw = (unset)
      NvMRomBlockNum = 0
      NvMStaticBlockIDCheck = 0
      NvMWriteBlockOnce = (unset)
      NvMWriteVerification = 0
      NvMWriteVerificationDataSize = 1
      NvMBlockCrcType = NVM_CRC32
      NvMTargetBlockReference
        NvMEaRef: NvMNameOfEaBlock=Ea/SwcMem_Block2
  module config Spi: implementation-config-variant=VARIANT-PRE-COMPILE, module-description=Spi
    SpiDriver
      CH_ADDR (SpiChannel): SpiChannelId=(unset), SpiChannelType=EB, SpiDataWidth=16, SpiEbMaxLength=64, SpiIbNBuffers=0, SpiTransferStart=MSB, SpiDefaultData=0
      device_1 (SpiExternalDevice):
        SpiPrescaler = 199
        SpiCsIdentifier = 2
        SpiCsPolarity = LOW
        SpiDataShiftEdge = LEADING
        SpiEnableCs = (unset)
        SpiHwUnit = CSIB0
        SpiShiftClockIdleLevel = LOW
        SpiCyclesClk2Cs = 0
        SpiCyclesCs2Clk = 0
        SpiBaudrate = 2000000
        SpiTimeClk2Cs = 0
      JOB_CMD (SpiJob): SpiJobId=(unset), SpiJobPriority=0, SpiDeviceAssignment=device_1
        cmd (SpiChannelList): SpiChannelIndex=0, SpiChannelAssignment=CH_CMD
      SEQ_CMD (SpiSequence): SpiInterruptibleSequence=(unset), SpiSequenceId=(unset), SpiJobAssignment=JOB_CMD
      3 x SpiChannel, all with SpiChannelId=(unset), SpiChannelType=EB, SpiDataWidth=8, SpiIbNBuffers=0, SpiTransferStart=MSB:
        CH_CMD: SpiEbMaxLength=64
        CH_DATA: SpiEbMaxLength=64
        CH_WREN: SpiEbMaxLength=1, SpiDefaultData=6
      3 x SpiJob, all with SpiJobId=(unset), SpiDeviceAssignment=device_1:
        JOB_CMD2: SpiJobPriority=0
          cmd (SpiChannelList): SpiChannelIndex=0, SpiChannelAssignment=CH_CMD
          data (SpiChannelList): SpiChannelIndex=1, SpiChannelAssignment=CH_DATA
        JOB_DATA: SpiJobPriority=2
          3 x SpiChannelList:
            addr: SpiChannelIndex=1, SpiChannelAssignment=CH_ADDR
            cmd: SpiChannelIndex=0, SpiChannelAssignment=CH_CMD
            data: SpiChannelIndex=2, SpiChannelAssignment=CH_DATA
        JOB_WREN: SpiJobPriority=3
          wren (SpiChannelList): SpiChannelIndex=0, SpiChannelAssignment=CH_WREN
      3 x SpiSequence, all with SpiInterruptibleSequence=(unset), SpiSequenceId=(unset):
        SEQ_CMD2: SpiJobAssignment=JOB_CMD2
        SEQ_READ: SpiJobAssignment=JOB_DATA
        SEQ_WRITE: SpiJobAssignment=JOB_WREN, SpiJobAssignment=JOB_DATA
    SpiPublishedInformation: SpiMaxHwUnit=(unset)
    SpiGeneral:
      SpiCancelApi = 0
      SpiChannelBuffersAllowed = (unset)
      SpiDevErrorDetect = 1
      SpiHwStatusApi = 1
      SpiInterruptibleSeqAllowed = (unset)
      SpiLevelDelivered = 2
      SpiSupportConcurrentSyncTransmit = (unset)
      SpiVersionInfoApi = 1
