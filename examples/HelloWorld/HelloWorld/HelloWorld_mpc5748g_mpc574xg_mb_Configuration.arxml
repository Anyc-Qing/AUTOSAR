AUTOSAR XML (schema 4-3-0)
package /HelloWorld_mpc5748g_mpc574xg_mb
  ecuc value collection HelloWorld: ecu-extract=HelloWorld
    ecuc-values:
      Mcu
      Can
      Dio
      Port
      Adc
      Pwm
      Spi
      CanIf
      CanSM
      Com
      ComM
      Det
      EcuC
      EcuM
      Os
      PduR
      Rte
      IoHwAb
      BswM
      CanTp
      Dcm
      Dem
      Xcp
      Dlt
      WdgIf
      WdgM
      Crc
      Fee
      NvM
      MemIf
      Ea
      Wdg
      FiM
  module config Crc: implementation-config-variant=VARIANT-PRE-COMPILE, module-description=Crc
    CrcGeneral: Crc32Mode=CRC_32_TABLE, Crc16Mode=CRC_16_TABLE, Crc8H2FMode=CRC_8H2F_TABLE, Crc8Mode=CRC_8_TABLE, Crc32P4Mode=CRC_32P4_TABLE
  module config Fee: implementation-config-variant=VARIANT-PRE-COMPILE, module-description=Fee
    SwcMem_Block1 (FeeBlockConfiguration): FeeBlockNumber=1, FeeBlockSize=8, FeeImmediateData=(unset), FeeNumberOfWriteCycles=1, FeeDeviceIndex=(unset)
    FeeGeneral:
      FeeDevErrorDetect = 1
      FeeIndex = 0
      FeePollingMode = 1
      FeeSetModeSupported = (unset)
      FeeVersionInfoApi = 0
      FeeVirtualPageSize = 8
      ArcUseJobNotifications = 1
      ArcFeeBank1Size = 16384
      ArcFeeBank2Size = 16384
      ArcFeeBank1Offset = 16384000
      ArcFeeBank2Offset = 16400384
    FeePublishedInformation: FeeBlockOverhead=(unset), FeeMaximumBlockingTime=(unset), FeePageOverhead=(unset)
    SwcMem_Block2 (FeeBlockConfiguration): FeeBlockNumber=2, FeeBlockSize=8, FeeImmediateData=, FeeNumberOfWriteCycles=1, FeeDeviceIndex=(unset)
  module config NvM: implementation-config-variant=VARIANT-PRE-COMPILE, module-description=NvM
    SwcMem_Block1 (NvMBlockDescriptor):
      NvMBlockJobPriority = (unset)
      NvMBlockManagementType = NVM_BLOCK_NATIVE
      NvMBlockUseCrc = 1
      NvMBlockUseSyncMechanism = 0
      NvMBlockWriteProt = 0
      NvMBswMBlockStatusInformation = 0
      NvMMaxNumOfReadRetries = 0
      NvMMaxNumOfWriteRetries = (unset)
      NvMNvBlockBaseNumber = 1
      NvMNvBlockLength = 4
      NvMNvBlockNum = 1
      NvMNvramBlockIdentifier = 
      NvMNvramDeviceId = 1
      NvMResistantToChangedSw = (unset)
      NvMRomBlockNum = 0
      NvMStaticBlockIDCheck = 0
      NvMWriteBlockOnce = (unset)
      NvMWriteVerification = 0
      NvMWriteVerificationDataSize = 1
      NvMBlockCrcType = NVM_CRC32
      NvMRamBlockDataAddress = Rte_Pim_SwcMemType_SwcMem_PIM1
      NvMSelectBlockForReadAll = 1
      NvMCalcRamBlockCrc = 1
      NvMTargetBlockReference
        NvMFeeRef: NvMNameOfFeeBlock=SwcMem_Block1
    NvMCommon:
      NvMApiConfigClass = NVM_API_CONFIG_CLASS_3
      NvMBswMMultiBlockJobStatusInformation = 1
      NvMCompiledConfigId = (unset)
      NvMCrcNumOfBytes = (unset)
      NvMDatasetSelectionBits = 0
      NvMDevErrorDetect = 1
      NvMDrvModeSwitch = (unset)
      NvMDynamicConfiguration = (unset)
      NvMJobPrioritization = 0
      NvMPollingMode = 0
      NvMRepeatMirrorOperations = 0
      NvMSetRamBlockStatusApi = 1
      NvMSizeStandardJobQueue = 5
      NvMVersionInfoApi = 0
    SwcMem_Block2 (NvMBlockDescriptor):
      NvMBlockJobPriority = (unset)
      NvMBlockManagementType = NVM_BLOCK_NATIVE
      NvMBlockUseCrc = 1
      NvMBlockUseSyncMechanism = 0
      NvMBlockWriteProt = 0
      NvMBswMBlockStatusInformation = 0
      NvMMaxNumOfReadRetries = 0
      NvMMaxNumOfWriteRetries = (unset)
      NvMNvBlockBaseNumber = 2
      NvMNvBlockLength = 4
      NvMNvBlockNum = 1
      NvMNvramBlockIdentifier = 
      NvMNvramDeviceId = 1
      NvMResistantToChangedSw = (unset)
      NvMRomBlockNum = 0
      NvMStaticBlockIDCheck = 0
      NvMWriteBlockOnce = (unset)
      NvMWriteVerification = 0
      NvMWriteVerificationDataSize = 1
      NvMBlockCrcType = NVM_CRC32
      NvMTargetBlockReference
        NvMFeeRef: NvMNameOfFeeBlock=Fee/SwcMem_Block2
  module config MemIf: implementation-config-variant=VARIANT-PRE-COMPILE, module-description=MemIf
    MemIfGeneral: MemIfDevErrorDetect=1, MemIfNumberOfDevices=2, MemIfVersionInfoApi=0
  module config Ea: implementation-config-variant=VARIANT-PRE-COMPILE, module-description=Ea
    SwcMem_Block2 (EaBlockConfiguration): EaBlockNumber=1, EaBlockSize=8, EaImmediateData=0, EaNumberOfWriteCycles=(unset), EaDeviceIndex=(unset)
    EaGeneral: EaDevErrorDetect=1, EaIndex=0, EaPollingMode=(unset), EaSetModeSupported=true, EaVersionInfoApi=0, EaVirtualPageSize=8
    EaPublishedInformation: EaBlockOverhead=(unset), EaMaximumBlockingTime=(unset), EaPageOverhead=(unset)
  module config Wdg: implementation-config-variant=VARIANT-PRE-COMPILE, module-description=Wdg
    WdgGeneral: WdgDevErrorDetect=1, WdgDisableAllowed=, WdgRunArea=, WdgTriggerLocation=, WdgVersionInfoApi=1
    WdgPublishedInformation: WdgTriggerMode=
    WdgSettingsConfig: WdgDefaultMode=WDGIF_FAST_MODE
      WdgSettingsFast: ActivationBit=1, ReloadValue=512, ArcWdgTimeoutValue=100
      WdgSettingsOff: ActivationBit=1, ReloadValue=32000
      WdgSettingsSlow: ActivationBit=1, ReloadValue=32000, ArcWdgTimeoutValue=2000
