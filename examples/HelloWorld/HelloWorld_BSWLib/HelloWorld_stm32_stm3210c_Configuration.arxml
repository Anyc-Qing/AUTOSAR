AUTOSAR XML (schema 4-2-1)
package /HelloWorld_stm32_stm3210c
  ecuc value collection HelloWorld: ecu-extract=HelloWorld, ecuc-values=[CanIf, CanSM, Com, ComM, Det, EcuC, EcuM, Os, PduR, Rte, IoHwAb, BswM, CanTp, Dcm, Dem, Xcp, Mcu, Can, Dio, Port, Adc, Pwm, Dlt, WdgIf, WdgM]
