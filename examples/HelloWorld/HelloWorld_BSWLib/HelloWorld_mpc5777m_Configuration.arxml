AUTOSAR XML (schema 4-0-3)
package /HelloWorld_mpc5777m_mmb
  ecuc value collection HelloWorld: ecu-extract=HelloWorld, ecuc-values=[CanIf, CanSM, Com, ComM, Det, EcuC, EcuM, Rte, Os, PduR, IoHwAb, CanTp, Dcm, Dem, BswM, Xcp, Adc, Mcu, Dio, Port, Can, Dlt, WdgIf, WdgM]
