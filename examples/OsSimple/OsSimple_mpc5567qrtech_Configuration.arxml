AUTOSAR XML (schema 4-0-3)
package /os_simple_mpc5567qrtech
  ecuc value collection MyEcu: ecuc-values=[Mcu, EcuM, Os, Det]
