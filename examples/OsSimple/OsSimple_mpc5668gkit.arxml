AUTOSAR XML (schema 4-0-3)
package /OsSimple_mpc5668g
  ecuc value collection OsSimple_mpc5668g: ecuc-values=[EcuM, Os, Mcu, Det]
