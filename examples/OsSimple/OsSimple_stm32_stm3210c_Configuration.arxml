AUTOSAR XML (schema 4-0-3)
package /OsSimple_stm32_stm3210c
  ecuc value collection MyEcu: ecuc-values=[EcuM, Os, Det, Mcu, Dio, Adc, LinuxOs, Com, Port, OsSimple_stm32_stm3210c/Can, OsSimple_stm32_stm3210c/Can, Gpt, Pwm, IoHwAb]
  module config Dio: implementation-config-variant=VARIANT-PRE-COMPILE, module-description=Dio
    DioConfig
      DioPort: DioPortId=32
    DioGeneral: DioDevErrorDetect=true, DioFlipChannelApi=, DioVersionInfoApi=false
  module config Adc: implementation-config-variant=VARIANT-PRE-COMPILE, module-description=Adc
    AdcConfigSet
      AdcHwUnit: AdcHwUnitId=ADC_1, AdcPrescale=
        AdcChannel: AdcChannelId=1, ArcAdcChannelConversionTime=239_5_CYCLES
        AdcGroup:
          AdcGroupAccessMode = 
          AdcGroupConversionMode = ADC_CONV_MODE_CONTINUOUS
          AdcGroupId = 
          AdcGroupTriggSrc = ADC_TRIGG_SRC_SW
          AdcStreamingBufferMode = 
          AdcStreamingNumSamples = 1
          AdcGroupDefinition = (unset)
          AdcGroupDefinition = (unset)
          AdcGroupDefinition = (unset)
    AdcGeneral:
      AdcDeInitApi = true
      AdcDevErrorDetect = true
      AdcEnableLimitCheck = 
      AdcEnableQueuing = 
      AdcEnableStartStopGroupApi = true
      AdcGrpNotifCapability = true
      AdcHwTriggerApi = 
      AdcPriorityImplementation = 
      AdcReadGroupApi = true
      AdcResultAlignment = 
      AdcVersionInfoApi = false
    AdcPublishedInformation: AdcChannelValueSigned=, AdcGroupFirstChannelFixed=, AdcMaxChannelResolution=
  module config LinuxOs: implementation-config-variant=VARIANT-PRE-COMPILE, module-description=LinuxOs
    OsAppMode
    OsOS:
      OsScalabilityClass = SC1
      OsStackMonitoring = true
      OsStatus = EXTENDED
      OsUseGetServiceId = true
      OsUseParameterAccess = true
      OsUseResScheduler = true
      ArcOsTickFrequency = 100
      ArcOsInterruptStackSize = 2048
      ArcOsIdleStackSize = 512
      ArcOsMaxIsr = 10
      ArcSafetyPlatform = false
      OsHooks: OsErrorHook=true, OsPostTaskHook=false, OsPreTaskHook=false, OsShutdownHook=true, OsStartupHook=true
      ArcOsDebug: OsTaskDebug=false, OsAlarmDebug=false, OsResourceDebug=false, OsScheduleTableDebug=false, OsEventDebug=false, OsDebugActivated=false
  module config Com: implementation-config-variant=VARIANT-PRE-COMPILE, module-description=Com
    ComConfig: ComConfigurationId=
      ComTimeBase
    ComGeneral:
      ComSupportedIPduGroups = 4
      ComVersionInfoApi = false
      ComSupportedIPdus = 20
      ComSupportedSignals = 40
      ComSupportedGroupSignals = 40
      ComRamBufferSize = 150
      ArcMaxNumberOfSupportedIPduCounters = 10
      ArcComSupportedGatewaySourceDescriptions = 1
      ArcComOsekNmSupport = false
  module config Port: implementation-config-variant=VARIANT-PRE-COMPILE, module-description=Port
    PortConfigSet
      PortContainer: PortNumberOfPortPins=
        PortPin:
          PortPinDirection = 
          PortPinDirectionChangeable = 
          PortPinId = 
          PortPinInitialMode = 
          PortPinLevelValue = 
          PortPinMode = 
          PortPinModeChangeable = 
          ArcPortPinGpioMode = 
          ArcPortPinSlewRate = 
    PortGeneral: PortDevErrorDetect=true, PortSetPinDirectionApi=false, PortSetPinModeApi=false, PortVersionInfoApi=false
  module config Can: implementation-config-variant=VARIANT-PRE-COMPILE, module-description=Can
    CanConfigSet
      CanController:
        CanBusoffProcessing = 
        CanControllerActivation = true
        CanControllerBaseAddress = 
        CanControllerId = 0
        CanRxProcessing = 
        CanTxProcessing = 
        CanWakeupFunctionalityAPI = false
        CanWakeupProcessing = 
        CanWakeupSupport = false
        ArcCanControllerLoopback = false
        CanControllerDefaultBaudrate = (unset)
        CanCpuClockRef = (unset)
        CanControllerBaudrateConfig:
          CanControllerBaudRate = 500
          CanControllerBaudRateConfigID = 0
          CanControllerPropSeg = 7
          CanControllerSeg1 = 4
          CanControllerSeg2 = 4
          CanControllerSyncJumpWidth = 2
      CanHardwareObject: CanHandleType=, CanIdType=, CanObjectId=, CanObjectType=, CanControllerRef=(unset)
    CanGeneral:
      CanDevErrorDetection = true
      CanHardwareCancellation = false
      CanIdenticalIdCancellation = false
      CanIndex = 
      CanMainFunctionModePeriod = 
      CanMultiplexedTransmission = 
      CanTimeoutDuration = 
      CanVersionInfoApi = false
      CanCounterRef = (unset)
      CanSupportTTCANRef = (unset)
      CanMainFunctionRWPeriods
  module config Can: implementation-config-variant=VARIANT-PRE-COMPILE, module-description=Can
    CanConfigSet
      CanController:
        CanBusoffProcessing = 
        CanControllerActivation = true
        CanControllerBaseAddress = 
        CanControllerId = 0
        CanRxProcessing = 
        CanTxProcessing = 
        CanWakeupFunctionalityAPI = false
        CanWakeupProcessing = 
        CanWakeupSupport = false
        ArcCanControllerLoopback = false
        CanControllerDefaultBaudrate = (unset)
        CanCpuClockRef = (unset)
        CanControllerBaudrateConfig:
          CanControllerBaudRate = 500
          CanControllerBaudRateConfigID = 0
          CanControllerPropSeg = 7
          CanControllerSeg1 = 4
          CanControllerSeg2 = 4
          CanControllerSyncJumpWidth = 2
      CanHardwareObject: CanHandleType=, CanIdType=, CanObjectId=, CanObjectType=, CanControllerRef=(unset)
    CanGeneral:
      CanDevErrorDetection = true
      CanHardwareCancellation = false
      CanIdenticalIdCancellation = false
      CanIndex = 
      CanMainFunctionModePeriod = 
      CanMultiplexedTransmission = 
      CanTimeoutDuration = 
      CanVersionInfoApi = false
      CanCounterRef = (unset)
      CanSupportTTCANRef = (unset)
      CanMainFunctionRWPeriods
  module config Gpt: implementation-config-variant=VARIANT-PRE-COMPILE, module-description=Gpt
    GptChannelConfigSet
      GptChannelConfiguration: GptChannelId=1, GptChannelTickFrequency=10000, GptChannelTickValueMax=, GptEnableWakeup=false, GptChannelMode=, GptChannelClkSrcRef=(unset)
    GptConfigurationOfOptApiServices:
      GptDeinitApi = false
      GptEnableDisableNotificationApi = false
      GptTimeElapsedApi = false
      GptTimeRemainingApi = false
      GptVersionInfoApi = false
      GptWakeupFunctionalityApi = false
    GptDriverConfiguration: GptDevErrorDetect=true, GptReportWakeupSource=false, GptPredefTimer100us32bitEnable=, GptPredefTimer1usEnablingGrade=
      GptClockReferencePoint: GptClockReference=(unset)
  module config Pwm: implementation-config-variant=VARIANT-PRE-COMPILE, module-description=Pwm
    PwmChannelConfigSet
      PwmChannel: PwmChannelId=, PwmDutycycleDefault=16384, PwmIdleState=PWM_LOW, PwmPeriodDefault=0.001, PwmPolarity=PWM_HIGH
    PwmConfigurationOfOptApiServices: PwmDeInitApi=false, PwmGetOutputState=false, PwmSetDutyCycle=false, PwmSetOutputToIdle=false, PwmSetPeriodAndDuty=false, PwmVersionInfoApi=false
    PwmGeneral:
      PwmDevErrorDetect = true
      PwmDutycycleUpdatedEndperiod = false
      PwmIndex = 
      PwmNotificationSupported = false
      PwmPeriodUpdatedEndperiod = false
      PwmDevErorDetect = 
  module config IoHwAb: implementation-config-variant=VARIANT-PRE-COMPILE, module-description=IoHwAb
    ArcIoHwAbGeneral: ArcIoHwAbDevErrorDetect=true, ArcIoHwAbAnalogMaxVoltage=5.0, ArcIoHwAbUsePort=false, ArcIoHwCalibrationEnabled=false
    ArcIoHwAbDigitalSignal:
      ArcIoHwAbDigitalDefaultValue = IOHWAB_LOW
      ArcIoHwAbDigitalInverted = false
      ArcIoHwAbDigitalMethod = IOHWAB_DIGITAL_READ
      ArcIoHwAbDigitalType = IOHWAB_DIO
