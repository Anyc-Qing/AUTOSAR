AUTOSAR XML (schema 4-0-3)
package /OsSimple
  ecuc value collection MyEcu
  module config Os: implementation-config-variant=VARIANT-PRE-COMPILE, module-description=Os
    OsAppMode
    OsOS:
      OsScalabilityClass = SC1
      OsStackMonitoring = 1
      OsStatus = EXTENDED
      OsUseGetServiceId = 1
      OsUseParameterAccess = 1
      OsUseResScheduler = 1
      ArcOsTickFrequency = 1000
      ArcOsInterruptStackSize = 2048
      ArcOsIdleStackSize = 512
      ArcOsMaxIsr = 10
      ArcSafetyPlatform = false
      OsHooks: OsErrorHook=1, OsPostTaskHook=1, OsPreTaskHook=1, OsShutdownHook=1, OsStartupHook=1
      ArcOsDebug: OsTaskDebug=0, OsAlarmDebug=0, OsResourceDebug=0, OsScheduleTableDebug=0, OsEventDebug=0, OsDebugActivated=0
    OsApplication1 (OsApplication): OsTrusted=1, OsAppCounterRef=Counter1, OsAppAlarmRef=Alarm1, OsAppTaskRef=eTask1, OsAppTaskRef=eTask2, OsAppTaskRef=bTask3
      OsApplicationHooks: OsAppErrorHook=0, OsAppShutdownHook=0, OsAppStartupHook=0
    Counter1 (OsCounter): OsCounterMaxAllowedValue=(unset), OsCounterMinCycle=1, OsCounterTicksPerBase=(unset), OsCounterType=OS_TICK
    Alarm1 (OsAlarm): OsAlarmCounterRef=Counter1
      OsAlarmAction
        OsAlarmSetEvent: OsAlarmSetEventRef=Event1, OsAlarmSetEventTaskRef=eTask1
      OsAlarmAutostart: OsAlarmAlarmTime=100, OsAlarmAutostartType=RELATIVE, OsAlarmCycleTime=100, OsAlarmAppModeRef=(unset)
    Event1 (OsEvent): OsEventMask=1
    Event2 (OsEvent): OsEventMask=1
    4 x OsTask, all with OsTaskActivation=1, OsTaskPriority=1, OsTaskSchedule=FULL, ArcOsTaskStackSize=2048:
      eTask1: OsTaskEventRef=Event1
        OsTaskAutostart: OsTaskAppModeRef=(unset)
      eTask2: OsTaskEventRef=Event2
        OsTaskAutostart: OsTaskAppModeRef=(unset)
      bTask3
      OsTask
    OsScheduleTable: OsScheduleTableDuration=, OsScheduleTableRepeating=false, OsScheduleTableCounterRef=(unset)
      OsScheduleTableExpiryPoint: OsScheduleTblExpPointOffset=14
      OsScheduleTableExpiryPoint: OsScheduleTblExpPointOffset=
      OsScheduleTableAutostart: OsScheduleTableAutostartType=, OsScheduleTableAppModeRef=(unset)
  module config Det: implementation-config-variant=VARIANT-PRE-COMPILE, module-description=Det
    DetGeneral:
      DetVersionInfoApi = 0
      DetUseRamlog = 1
      DetEnableCallbacks = 0
      DetWrapRamlog = 1
      DetUseStdErr = 0
      DetDeInitAPI = 0
      DetNumberOfCallbacks = 5
      DetRamlogSize = 16
      DetUseSafetyMonitor = false
