AUTOSAR XML (schema 4-0-3)
package /os_simple_jacinto6_vayu_evm
  ecuc value collection Jacinto6: ecuc-values=[Dio, Port, Os, Det, EcuM, Mcu]
  module config Dio: implementation-config-variant=VARIANT-PRE-COMPILE, module-description=Dio
    DioConfig
      DioPort: DioPortId=0
        DioChannel: DioChannelId=173
    DioGeneral: DioDevErrorDetect=1, DioFlipChannelApi=(unset), DioVersionInfoApi=0
  module config Port: implementation-config-variant=VARIANT-PRE-COMPILE, module-description=Port
    PortConfigSet
      PortContainer: PortNumberOfPortPins=(unset)
        gpio6_14 (PortPin):
          PortPinDirection = PORT_PIN_OUT
          PortPinDirectionChangeable = (unset)
          PortPinId = 132
          PortPinInitialMode = PORT_PIN_MODE_DIO
          PortPinLevelValue = PORT_PIN_LEVEL_LOW
          PortPinMode = 
          PortPinModeChangeable = (unset)
          ArcPortPinPull = PORT_PIN_PULL_NONE
          ArcPortPinSlewRate = PORT_PIN_SLEW_FAST
    PortGeneral: PortDevErrorDetect=1, PortSetPinDirectionApi=0, PortSetPinModeApi=0, PortVersionInfoApi=0, ArcPortGpioReset=true
  module config EcuM: implementation-config-variant=VARIANT-PRE-COMPILE, module-description=EcuM
    EcuMConfiguration
      EcuMCommonConfiguration: EcuMConfigConsistencyHash=(unset), EcuMDefaultAppMode=(unset), EcuMOSResource=(unset)
        EcuMDefaultShutdownTarget: EcuMDefaultState=EcuMStateOff
        EcuMSleepMode: EcuMSleepModeId=(unset), EcuMSleepModeSuspend=(unset), EcuMSleepModeMcuModeRef=SLEEP, EcuMWakeupSourceMask=EcuMWakeupSource
        EcuMWakeupSource: EcuMWakeupSourceId=(unset), EcuMWakeupSourcePolling=(unset), EcuMResetReasonRef=(unset)
      EcuMFixedConfiguration: EcuMNvramReadallTimeout=10.0, EcuMNvramWriteallTimeout=10.0, EcuMRunMinimumDuration=10.0, EcuMNormalMcuModeRef=NORMAL
        User_1 (EcuMFixedUserConfig): EcuMFixedUser=(unset)
    EcuMGeneral: EcuMDevErrorDetect=1, EcuMIncludeDem=(unset), EcuMIncludeDet=(unset), EcuMMainFunctionPeriod=0.2, EcuMVersionInfoApi=0
    EcuMFixedGeneral: EcuMIncludeComM=(unset), EcuMIncludeNvM=(unset), EcuMIncludeNvramMgr=(unset), EcuMTTIIEnabled=(unset), EcuMTTIIWakeupSourceRef=(unset)
  module config Mcu: implementation-config-variant=VARIANT-PRE-COMPILE, module-description=Mcu
    McuGeneralConfiguration: McuDevErrorDetect=1, McuGetRamStateApi=(unset), McuInitClock=(unset), McuNoPll=(unset), McuPerformResetApi=1, McuVersionInfoApi=1
    McuModuleConfiguration: McuClockSrcFailureNotification=, McuNumberOfMcuModes=(unset), McuRamSectors=(unset), ArcDefaultClockRef=McuClockSettingConfig
      McuClockSettingConfig: McuClockSettingId=(unset)
        McuClockReferencePoint: McuClockReferencePointFrequency=212800000
        ArcClockSettings:
          Enable_Timer_{1..16} = false
          Enable_CAN0 = false
          Enable_CAN1 = false
      3 x McuModeSettingConf, all with McuMode=(unset):
        NORMAL
        RUN
        SLEEP
    McuPublishedInformation
      McuResetReasonConf: McuResetReason=(unset)
