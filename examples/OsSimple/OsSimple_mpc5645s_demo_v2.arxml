AUTOSAR XML (schema 4-0-3)
package /OsSimple_mpc5645s_demo_v2
  ecuc value collection OsSimple_mpc5645s_demo_v2: ecuc-values=[EcuM, Os, Mcu, Det]
