AUTOSAR XML (schema 4-0-3)
package /os_simple_jacinto5
  ecuc value collection Jacinto5: ecuc-values=[Os, Det, Dio, Port, Mcu, EcuM]
  module config Dio: implementation-config-variant=VARIANT-PRE-COMPILE, module-description=Dio
    DioConfig
      DioPort: DioPortId=(unset)
        DioChannel: DioChannelId=32
    DioGeneral: DioDevErrorDetect=1, DioFlipChannelApi=(unset), DioVersionInfoApi=0
  module config Port: implementation-config-variant=VARIANT-PRE-COMPILE, module-description=Port
    PortConfigSet
      PortContainer: PortNumberOfPortPins=(unset)
        4 x PortPin, all with PortPinDirectionChangeable=(unset), PortPinInitialMode=PORT_PIN_MODE_CAN, PortPinLevelValue=PORT_PIN_LEVEL_LOW, PortPinMode=, PortPinModeChangeable=(unset), ArcPortPinPull=PORT_PIN_PULL_NONE, ArcPortPinSlewRate=PORT_PIN_SLEW_FAST:
          PortPin_ah6: PortPinDirection=PORT_PIN_OUT, PortPinId=761
          PortPin_ag6: PortPinDirection=PORT_PIN_IN, PortPinId=733
          PortPin_af5: PortPinDirection=PORT_PIN_OUT, PortPinId=704
          PortPin_ae6: PortPinDirection=PORT_PIN_IN, PortPinId=677
    PortGeneral: PortDevErrorDetect=1, PortSetPinDirectionApi=0, PortSetPinModeApi=0, PortVersionInfoApi=0, ArcPortGpioReset=true
  module config Mcu: implementation-config-variant=VARIANT-PRE-COMPILE, module-description=Mcu
    McuGeneralConfiguration: McuDevErrorDetect=1, McuGetRamStateApi=(unset), McuInitClock=true, McuNoPll=true, McuPerformResetApi=1, McuVersionInfoApi=1
    McuModuleConfiguration: McuClockSrcFailureNotification=, McuNumberOfMcuModes=(unset), McuRamSectors=(unset), ArcDefaultClockRef=McuClockSettingConfig
      McuClockSettingConfig: McuClockSettingId=(unset)
        McuClockReferencePoint: McuClockReferencePointFrequency=200000000
        ArcClockSettings:
          Enable_Timer_{1..16} = false
          Enable_CAN0 = true
          Enable_CAN1 = true
      3 x McuModeSettingConf, all with McuMode=(unset):
        NORMAL
        SLEEP
        RUN
    McuPublishedInformation
      McuResetReasonConf: McuResetReason=(unset)
  module config EcuM: implementation-config-variant=VARIANT-PRE-COMPILE, module-description=EcuM
    EcuMConfiguration
      EcuMCommonConfiguration: EcuMConfigConsistencyHash=(unset), EcuMDefaultAppMode=(unset), EcuMOSResource=(unset)
        EcuMDefaultShutdownTarget: EcuMDefaultState=EcuMStateReset
        EcuMSleepMode: EcuMSleepModeId=(unset), EcuMSleepModeSuspend=(unset), EcuMSleepModeMcuModeRef=SLEEP, EcuMWakeupSourceMask=EcuMWakeupSource
        EcuMWakeupSource: EcuMWakeupSourceId=(unset), EcuMWakeupSourcePolling=0, EcuMResetReasonRef=(unset)
      EcuMFixedConfiguration: EcuMNvramReadallTimeout=10.0, EcuMNvramWriteallTimeout=10.0, EcuMRunMinimumDuration=10.0, EcuMNormalMcuModeRef=NORMAL
        User_1 (EcuMFixedUserConfig): EcuMFixedUser=(unset)
    EcuMGeneral: EcuMDevErrorDetect=1, EcuMIncludeDem=0, EcuMIncludeDet=0, EcuMMainFunctionPeriod=0.2, EcuMVersionInfoApi=0
    EcuMFixedGeneral: EcuMIncludeComM=(unset), EcuMIncludeNvM=(unset), EcuMIncludeNvramMgr=(unset), EcuMTTIIEnabled=(unset), EcuMTTIIWakeupSourceRef=(unset)
