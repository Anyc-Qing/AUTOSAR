AUTOSAR XML (schema 4-0-3)
package /OsSimple_spc560b54
  ecuc value collection MyEcu: ecuc-values=[Os, EcuM, Det, Mcu]
