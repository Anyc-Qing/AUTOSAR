AUTOSAR XML (schema 4-0-3)
package /OsSimple_mpc574g_mpc574xg_mb
  ecuc value collection OsSimple_mpc574xg_mb_324ds: ecuc-values=[Os, Det, EcuM, Mcu]
