AUTOSAR XML (schema 4-0-3)
package /OsSimple_tmdx570ls12hdk
  ecuc value collection OsSimple_tmdx570ls12hdk: ecuc-values=[Os, Det, EcuM, Mcu]
