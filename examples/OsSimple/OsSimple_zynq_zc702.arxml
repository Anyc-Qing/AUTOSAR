AUTOSAR XML (schema 4-0-3)
package /OsSimple_zynq_zc702
  ecuc value collection OsSimple_zynq_zc702: ecuc-values=[Os, Det, Mcu, EcuM]
