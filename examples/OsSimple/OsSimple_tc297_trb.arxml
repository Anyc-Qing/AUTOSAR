AUTOSAR XML (schema 4-0-3)
package /OsSimple_tc297_trb
  ecuc value collection OsSimple_tc297_trb: ecuc-values=[Os, Det, Mcu, EcuM]
