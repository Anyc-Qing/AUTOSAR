AUTOSAR XML (schema 4-0-3)
package /OsSimple_rh850f1l
  ecuc value collection OsSimple_rh850f1l: ecuc-values=[Os, Det, Mcu, EcuM]
