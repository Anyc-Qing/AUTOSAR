AUTOSAR XML (schema 4-1-1)
package /ArcCore/Boards/mpc5634m_trk
  module config Mcu: implementation-config-variant=VARIANT-PRE-COMPILE, module-description=Mcu
    McuGeneralConfiguration: McuDevErrorDetect=1, McuGetRamStateApi=1, McuInitClock=1, McuNoPll=0, McuPerformResetApi=1, McuVersionInfoApi=0
    McuModuleConfiguration:
      McuClockSrcFailureNotification = DISABLED
      McuNumberOfMcuModes = (unset)
      McuRamSectors = (unset)
      ArcDefaultClockRef = McuModuleConfiguration/PLLSettings80MHzOn8MHzOsc
      PLLSettings80MHzOn8MHzOsc (McuClockSettingConfig): McuClockSettingId=(unset)
        McuClockReferencePoint: McuClockReferencePointFrequency=8000000.0, Frequency=(unset)
        PLLSettings80MHzOn8MHzOsc (PLLSettings): IDF=1, NDIV=16, ODF=0
      3 x McuModeSettingConf, all with McuMode=(unset):
        SLEEP
        RUN
        NORMAL
    McuPublishedInformation
      McuResetReasonConf: McuResetReason=(unset)
        McuResetReasonConf: McuResetReason=(unset)
  module config Port: implementation-config-variant=VARIANT-PRE-COMPILE, module-description=Port
    PortConfigSet
      5 x PortContainer, all with PortNumberOfPortPins=(unset):
        CAN
          CAN0TX (PortPin):
            PortPinDirection = PORT_PIN_OUT
            PortPinDirectionChangeable = 0
            PortPinId = 16
            PortPinInitialMode = PORT_PIN_MODE_CAN
            PortPinLevelValue = PORT_PIN_LEVEL_LOW
            PortPinMode = PORT_PIN_MODE_CAN
            PortPinModeChangeable = 0
            ArcPortPinPull = PORT_PIN_PULL_NONE
            ArcPortPinSlewRate = PORT_PIN_SLEW_RATE_MAX
            ArcPortPinOpenDrainEnable = (unset)
          CAN0RX (PortPin):
            PortPinDirection = PORT_PIN_IN
            PortPinDirectionChangeable = 0
            PortPinId = 17
            PortPinInitialMode = PORT_PIN_MODE_CAN
            PortPinLevelValue = PORT_PIN_LEVEL_LOW
            PortPinMode = PORT_PIN_MODE_CAN
            PortPinModeChangeable = 0
            ArcPortPinPull = PORT_PIN_PULL_NONE
            ArcPortPinSlewRate = PORT_PIN_SLEW_RATE_MAX
            ArcPortPinOpenDrainEnable = (unset)
        LEDS
          GPIO[0] (PortPin):
            PortPinDirection = PORT_PIN_OUT
            PortPinDirectionChangeable = 0
            PortPinId = 0
            PortPinInitialMode = PORT_PIN_MODE_DIO
            PortPinLevelValue = PORT_PIN_LEVEL_LOW
            PortPinMode = PORT_PIN_MODE_DIO
            PortPinModeChangeable = 0
            ArcPortPinPull = PORT_PIN_PULL_NONE
            ArcPortPinSlewRate = PORT_PIN_SLEW_RATE_MAX
            ArcPortPinOpenDrainEnable = 0
          GPIO[1] (PortPin):
            PortPinDirection = PORT_PIN_OUT
            PortPinDirectionChangeable = 0
            PortPinId = 1
            PortPinInitialMode = PORT_PIN_MODE_DIO
            PortPinLevelValue = PORT_PIN_LEVEL_LOW
            PortPinMode = PORT_PIN_MODE_DIO
            PortPinModeChangeable = 0
            ArcPortPinPull = PORT_PIN_PULL_NONE
            ArcPortPinSlewRate = PORT_PIN_SLEW_RATE_MAX
            ArcPortPinOpenDrainEnable = 0
        SPI
          4 x PortPin, all with PortPinDirectionChangeable=0, PortPinInitialMode=PORT_PIN_MODE_SPI, PortPinLevelValue=PORT_PIN_LEVEL_LOW, PortPinModeChangeable=0, ArcPortPinPull=PORT_PIN_PULL_NONE, ArcPortPinSlewRate=PORT_PIN_SLEW_RATE_MAX, ArcPortPinOpenDrainEnable=0:
            CS1_SPI1: PortPinDirection=PORT_PIN_OUT, PortPinId=98, PortPinMode=PORT_PIN_MODE_SPI
            SCK_SPI1: PortPinDirection=PORT_PIN_OUT, PortPinId=6, PortPinMode=PORT_PIN_MODE_OTHER
            SIN_SPI1: PortPinDirection=PORT_PIN_IN, PortPinId=8, PortPinMode=PORT_PIN_MODE_SPI
            SOUT_SPI1: PortPinDirection=PORT_PIN_OUT, PortPinId=7, PortPinMode=PORT_PIN_MODE_SPI
        PWM
          3 x PortPin, all with PortPinDirection=PORT_PIN_OUT, PortPinDirectionChangeable=0, PortPinInitialMode=PORT_PIN_MODE_PWM, PortPinLevelValue=PORT_PIN_LEVEL_LOW, PortPinMode=PORT_PIN_MODE_PWM, PortPinModeChangeable=0, ArcPortPinSlewRate=PORT_PIN_SLEW_RATE_MAX, ArcPortPinOpenDrainEnable=0:
            FlexPWM_0_A0: PortPinId=11, ArcPortPinPull=
            FlexPWM_1_B1: PortPinId=93, ArcPortPinPull=PORT_PIN_PULL_NONE
            FlexPWM_0_X0: PortPinId=57, ArcPortPinPull=PORT_PIN_PULL_NONE
        ANALOG
          3 x PortPin, all with PortPinDirection=PORT_PIN_IN, PortPinDirectionChangeable=0, PortPinInitialMode=PORT_PIN_MODE_ADC, PortPinLevelValue=PORT_PIN_LEVEL_LOW, PortPinMode=PORT_PIN_MODE_ADC, PortPinModeChangeable=0, ArcPortPinOpenDrainEnable=0:
            ADC0_ADC1_AN11: PortPinId=25, ArcPortPinPull=PORT_PIN_PULL_NONE, ArcPortPinSlewRate=
            ADC0_AN0: PortPinId=23, ArcPortPinPull=PORT_PIN_PULL_DOWN, ArcPortPinSlewRate=
            ADC3_AN5: PortPinId=76, ArcPortPinPull=PORT_PIN_PULL_DOWN, ArcPortPinSlewRate=PORT_PIN_SLEW_RATE_MIN
    PortGeneral: PortDevErrorDetect=1, PortSetPinDirectionApi=0, PortSetPinModeApi=0, PortVersionInfoApi=0
  module config Dio: implementation-config-variant=VARIANT-PRE-COMPILE, module-description=Dio
    DioConfig
      PE (DioPort): DioPortId=4
        LED1 (DioChannel): DioChannelId=0
        LED2 (DioChannel): DioChannelId=1
      PH (DioPort): DioPortId=7
        SpiCs (DioChannel): DioChannelId=115
    DioGeneral: DioDevErrorDetect=1, DioFlipChannelApi=(unset), DioVersionInfoApi=0
  module config Can: implementation-config-variant=VARIANT-PRE-COMPILE, module-description=Can
    CanConfigSet
      CanController:
        CanBusoffProcessing = INTERRUPT
        CanControllerActivation = 1
        CanControllerBaseAddress = (unset)
        CanControllerId = 0
        CanRxProcessing = INTERRUPT
        CanTxProcessing = INTERRUPT
        CanWakeupProcessing = POLLING
        CanWakeupSupport = (unset)
        ArcCanControllerLoopback = 0
        ArcCanNumMessageBox = 64
        ArcCanControllerHwUnit = FLEXCAN_A
        ArcCanClockSourceOscillator = 1
        CanWakeupFunctionalityAPI = (unset)
        CanControllerDefaultBaudrate = CanControllerBaudrateConfig
        CanCpuClockRef = (unset)
        CanControllerBaudrateConfig:
          CanControllerBaudRate = 500
          CanControllerPropSeg = 6
          CanControllerSeg1 = 6
          CanControllerSeg2 = 3
          CanControllerSyncJumpWidth = 2
          CanControllerBaudRateConfigID = 0
        CanFilterMask: CanFilterMaskValue=0
      CAN_A_RX_0 (CanHardwareObject):
        CanHandleType = FULL
        CanIdType = STANDARD
        CanIdValue = 2
        CanObjectId = (unset)
        CanObjectType = RECEIVE
        ArcCanFifoEnable = 0
        ArcCanMessageboxesPerHwObj = 1
        CanControllerRef = CanController
        CanFilterMaskRef = CanFilterMask
      CAN_A_TX_0 (CanHardwareObject):
        CanHandleType = FULL
        CanIdType = STANDARD
        CanIdValue = 1
        CanObjectId = (unset)
        CanObjectType = TRANSMIT
        ArcCanFifoEnable = (unset)
        ArcCanMessageboxesPerHwObj = (unset)
        CanControllerRef = CanController
    CanGeneral:
      CanChangeBaudrateApi = false
      CanDevErrorDetection = 1
      CanHardwareCancellation = 0
      CanIdenticalIdCancellation = (unset)
      CanIndex = (unset)
      CanMainFunctionModePeriod = (unset)
      CanMultiplexedTransmission = (unset)
      CanTimeoutDuration = (unset)
      CanVersionInfoApi = 0
      CanCounterRef = (unset)
      CanSupportTTCANRef = (unset)
      CanMainFunctionRWPeriods
  module config Spi: implementation-config-variant=VARIANT-PRE-COMPILE, module-description=Spi
    SpiDriver
      CH_ADDR (SpiChannel): SpiChannelId=(unset), SpiChannelType=EB, SpiDataWidth=16, SpiEbMaxLength=64, SpiIbNBuffers=(unset), SpiTransferStart=MSB, SpiDefaultData=0
      device_1 (SpiExternalDevice):
        SpiBaudrate = 4000000
        SpiCsIdentifier = 1
        SpiCsPolarity = LOW
        SpiDataShiftEdge = LEADING
        SpiEnableCs = (unset)
        SpiHwUnit = CSIB1
        SpiShiftClockIdleLevel = LOW
        SpiTimeClk2Cs = 0.000002
        ArcCsCallback = 
        ArcTimeCs2Clk = 0.000001
      JOB_CMD (SpiJob): SpiJobId=(unset), SpiJobPriority=0, SpiDeviceAssignment=device_1
        cmd (SpiChannelList): SpiChannelIndex=0, SpiChannelAssignment=CH_CMD
      SEQ_CMD (SpiSequence): SpiInterruptibleSequence=(unset), SpiSequenceId=(unset), SpiJobAssignment=JOB_CMD
      3 x SpiChannel, all with SpiChannelId=(unset), SpiChannelType=EB, SpiDataWidth=8, SpiIbNBuffers=(unset), SpiTransferStart=MSB:
        CH_CMD: SpiEbMaxLength=64
        CH_DATA: SpiEbMaxLength=64
        CH_WREN: SpiEbMaxLength=1, SpiDefaultData=6
      3 x SpiJob, all with SpiJobId=(unset), SpiDeviceAssignment=device_1:
        JOB_CMD2: SpiJobPriority=0
          cmd (SpiChannelList): SpiChannelIndex=0, SpiChannelAssignment=CH_CMD
          data (SpiChannelList): SpiChannelIndex=1, SpiChannelAssignment=CH_DATA
        JOB_DATA: SpiJobPriority=2
          3 x SpiChannelList:
            addr: SpiChannelIndex=1, SpiChannelAssignment=CH_ADDR
            cmd: SpiChannelIndex=0, SpiChannelAssignment=CH_CMD
            data: SpiChannelIndex=2, SpiChannelAssignment=CH_DATA
        JOB_WREN: SpiJobPriority=3
          wren (SpiChannelList): SpiChannelIndex=0, SpiChannelAssignment=CH_WREN
      3 x SpiSequence, all with SpiSequenceId=(unset):
        SEQ_CMD2: SpiInterruptibleSequence=(unset), SpiJobAssignment=JOB_CMD2
        SEQ_READ: SpiInterruptibleSequence=0, SpiJobAssignment=JOB_DATA
        SEQ_WRITE: SpiInterruptibleSequence=0, SpiJobAssignment=JOB_WREN, SpiJobAssignment=JOB_DATA
      CH_WATCHDOG (SpiChannel): SpiChannelId=(unset), SpiChannelType=IB, SpiDataWidth=16, SpiEbMaxLength=(unset), SpiIbNBuffers=1, SpiTransferStart=MSB, SpiDefaultData=0x5A00
    SpiGeneral:
      SpiCancelApi = 1
      SpiChannelBuffersAllowed = (unset)
      SpiDevErrorDetect = 1
      SpiHwStatusApi = 1
      SpiInterruptibleSeqAllowed = (unset)
      SpiLevelDelivered = (unset)
      SpiSupportConcurrentSyncTransmit = (unset)
      SpiVersionInfoApi = 1
      ArcImplementation = FIFO
    SpiPublishedInformation: SpiMaxHwUnit=(unset)
  module config Adc: implementation-config-variant=VARIANT-PRE-COMPILE, module-description=Adc
    AdcConfigSet
      ADC0 (AdcHwUnit): AdcHwUnitId=ADC_CTRL_0, ArcAdcPrescaleDivideFactor=ADC_SYSTEM_CLOCK_DIVIDE_FACTOR_2, AdcPrescale=1
        ADC0_AN11 (AdcChannel): ArcAdcChannelId=ADC_CH11, AdcChannelId=11, ArcAdcChannelCalibrationEnable=1, ArcAdcChannelConvTime=ADC_CONVERSION_TIME_128_CLOCKS
        GROUP0 (AdcGroup):
          AdcGroupAccessMode = ADC_ACCESS_MODE_STREAMING
          AdcGroupConversionMode = ADC_CONV_MODE_CONTINUOUS
          AdcGroupId = (unset)
          AdcGroupTriggSrc = ADC_TRIGG_SRC_SW
          AdcStreamingBufferMode = ADC_STREAM_BUFFER_LINEAR
          AdcStreamingNumSamples = 1
          AdcGroupDefinition = ADC0_AN11
          AdcGroupDefinition = ADC0/ADC0_AN0
          AdcGroupDefinition = ADC0_AN10
          AdcGroupDefinition = ADC0_AN15
        3 x AdcChannel, all with ArcAdcChannelCalibrationEnable=1, ArcAdcChannelConvTime=ADC_CONVERSION_TIME_128_CLOCKS:
          ADC0_AN0: ArcAdcChannelId=ADC_CH0, AdcChannelId=0
          ADC0_AN10: ArcAdcChannelId=ADC_CH10, AdcChannelId=10
          ADC0_AN15: ArcAdcChannelId=ADC_CH15, AdcChannelId=15
    AdcGeneral:
      AdcDeInitApi = 1
      AdcDevErrorDetect = 1
      AdcEnableLimitCheck = (unset)
      AdcEnableQueuing = (unset)
      AdcEnableStartStopGroupApi = 1
      AdcGrpNotifCapability = 1
      AdcHwTriggerApi = (unset)
      AdcPriorityImplementation = ADC_PRIORITY_NONE
      AdcReadGroupApi = 1
      AdcResultAlignment = 
      AdcVersionInfoApi = 1
    AdcPublishedInformation: AdcChannelValueSigned=(unset), AdcGroupFirstChannelFixed=(unset), AdcMaxChannelResolution=(unset)
  module config Pwm: implementation-config-variant=VARIANT-PRE-COMPILE, module-description=Pwm
    PwmChannelConfigSet
      3 x PwmChannel, all with PwmDutycycleDefault=0, PwmIdleState=PWM_LOW, PwmPeriodDefault=0.001, PwmPolarity=PWM_HIGH, ArcPwmClkSrc=PWM_CLKSRC_INTERNAL_COUNTER, ArcPwmMode=PWM_MODE_BASIC, PwmChannelClass=PWM_FIXED_PERIOD, ArcPwmChannelPrescaler=AUTO:
        PwmChannel{0..2}: PwmChannelId={0..2}
    PwmConfigurationOfOptApiServices: PwmDeInitApi=0, PwmGetOutputState=0, PwmSetDutyCycle=1, PwmSetOutputToIdle=0, PwmSetPeriodAndDuty=0, PwmVersionInfoApi=0
    PwmGeneral:
      PwmDevErorDetect = (unset)
      PwmDevErrorDetect = 1
      PwmDutycycleUpdatedEndperiod = 1
      PwmIndex = (unset)
      PwmNotificationSupported = 0
      PwmPeriodUpdatedEndperiod = 0
      ArcPwmGlobalPrescaler = 4
  module config EcuM: implementation-config-variant=VARIANT-POST-BUILD, module-description=EcuM
    EcuMConfiguration
      EcuMCommonConfiguration: EcuMConfigConsistencyHash=(unset), EcuMDefaultAppMode=(unset), EcuMOSResource=(unset)
        EcuMDefaultShutdownTarget: EcuMDefaultState=EcuMStateOff
        EcuMSleepMode: EcuMSleepModeId=(unset), EcuMSleepModeSuspend=(unset), EcuMSleepModeMcuModeRef=RUN, EcuMWakeupSourceMask=EcuMWakeupSource
        EcuMWakeupSource: EcuMWakeupSourceId=(unset), EcuMWakeupSourcePolling=0, EcuMResetReasonRef=(unset)
      EcuMFixedConfiguration: EcuMNvramReadallTimeout=10.0, EcuMNvramWriteallTimeout=10.0, EcuMRunMinimumDuration=10.0, EcuMNormalMcuModeRef=NORMAL
        User_1 (EcuMFixedUserConfig): EcuMFixedUser=(unset)
    EcuMGeneral: EcuMDevErrorDetect=0, EcuMIncludeDem=0, EcuMIncludeDet=0, EcuMMainFunctionPeriod=0.2, EcuMVersionInfoApi=0
    EcuMFixedGeneral: EcuMIncludeComM=(unset), EcuMIncludeNvM=(unset), EcuMIncludeNvramMgr=(unset), EcuMTTIIEnabled=(unset), EcuMTTIIWakeupSourceRef=(unset)
  ecuc value collection mpc5634m_trk: ecuc-values=[Adc, Can, Dio, Spi, EcuM, Mcu, Port, Pwm]
