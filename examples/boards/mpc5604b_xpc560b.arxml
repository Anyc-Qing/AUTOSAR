AUTOSAR XML (schema 4-2-1)
package /ArcCore/Boards/mpc5604b_xpc560b
  ecuc value collection mpc5604b_xpc560b: ecuc-values=[Can, Dio, Mcu, Port, Spi, Pwm, Adc, EcuM]
  module config Can: implementation-config-variant=VARIANT-PRE-COMPILE, module-description=Can
    CanConfigSet
      CanController0 (CanController):
        CanBusoffProcessing = INTERRUPT
        CanControllerActivation = 1
        CanControllerBaseAddress = (unset)
        CanControllerId = 0
        CanRxProcessing = INTERRUPT
        CanTxProcessing = INTERRUPT
        CanWakeupProcessing = POLLING
        CanWakeupSupport = (unset)
        ArcCanControllerLoopback = 0
        ArcCanNumMessageBox = 64
        ArcCanControllerHwUnit = FLEXCAN_A
        ArcCanClockSourceOscillator = 1
        CanWakeupFunctionalityAPI = (unset)
        CanControllerDefaultBaudrate = CanControllerBaudrateConfig
        CanCpuClockRef = (unset)
        CanControllerBaudrateConfig:
          CanControllerBaudRate = 500
          CanControllerPropSeg = 6
          CanControllerSeg1 = 6
          CanControllerSeg2 = 3
          CanControllerSyncJumpWidth = 2
          CanControllerBaudRateConfigID = 0
      Ctrl_0_Rx_0 (CanHardwareObject):
        CanHandleType = BASIC
        CanIdType = STANDARD
        CanObjectId = (unset)
        CanObjectType = RECEIVE
        ArcCanFifoEnable = 0
        ArcCanMessageboxesPerHwObj = 
        CanHwObjectCount = 1
        CanControllerRef = CanController0
        CanHwFilter: CanHwFilterCode=2, CanHwFilterMask=0
      Ctrl_0_Tx_0 (CanHardwareObject):
        CanHandleType = BASIC
        CanIdType = STANDARD
        CanObjectId = (unset)
        CanObjectType = TRANSMIT
        ArcCanFifoEnable = 0
        ArcCanMessageboxesPerHwObj = 
        CanHwObjectCount = 5
        CanControllerRef = CanController0
    CanGeneral:
      CanChangeBaudrateApi = false
      CanDevErrorDetection = 1
      CanHardwareCancellation = 0
      CanIdenticalIdCancellation = (unset)
      CanIndex = (unset)
      CanMainFunctionModePeriod = (unset)
      CanMultiplexedTransmission = (unset)
      CanTimeoutDuration = (unset)
      CanVersionInfoApi = 0
      CanCounterRef = (unset)
      CanSupportTTCANRef = (unset)
      CanMainFunctionRWPeriods
  module config Dio: implementation-config-variant=VARIANT-PRE-COMPILE, module-description=Dio
    DioConfig
      PE (DioPort): DioPortId=4
        4 x DioChannel:
          LED1: DioChannelId=68
          LED2: DioChannelId=69
          KEY1: DioChannelId=64
          KEY2: DioChannelId=65
      PB (DioPort): DioPortId=1
        SpiCs (DioChannel): DioChannelId=28
    DioGeneral: DioDevErrorDetect=1, DioFlipChannelApi=(unset), DioVersionInfoApi=0
  module config Mcu: implementation-config-variant=VARIANT-PRE-COMPILE, module-description=Mcu
    McuGeneralConfiguration: McuDevErrorDetect=1, McuGetRamStateApi=1, McuInitClock=1, McuNoPll=0, McuPerformResetApi=1, McuVersionInfoApi=0
    McuModuleConfiguration: McuClockSrcFailureNotification=DISABLED, McuNumberOfMcuModes=(unset), McuRamSectors=(unset), ArcDefaultClockRef=McuClockSettingConfig
      McuClockSettingConfig: McuClockSettingId=(unset)
        PLLSettings: IDF=0, NDIV=64, ODF=2
        McuClockReferencePoint: Frequency=(unset), McuClockReferencePointFrequency=8000000.0
      3 x McuModeSettingConf, all with McuMode=(unset):
        SLEEP
        RUN
        NORMAL
    McuPublishedInformation
      McuResetReasonConf: McuResetReason=(unset)
        McuResetReasonConf: McuResetReason=(unset)
  module config Port: implementation-config-variant=VARIANT-PRE-COMPILE, module-description=Port
    PortConfigSet
      6 x PortContainer, all with PortNumberOfPortPins=(unset):
        CAN
          4 x PortPin, all with PortPinDirectionChangeable=0, PortPinInitialMode=PORT_PIN_MODE_CAN, PortPinLevelValue=PORT_PIN_LEVEL_LOW, PortPinModeChangeable=0, ArcPortPinPull=PORT_PIN_PULL_NONE, ArcPortPinSlewRate=PORT_PIN_SLEW_RATE_MAX, ArcPortPinOpenDrainEnable=0:
            CAN1TX: PortPinDirection=PORT_PIN_OUT, PortPinId=42, PortPinMode=PORT_PIN_MODE_CAN
            CAN1RX: PortPinDirection=PORT_PIN_IN, PortPinId=43, PortPinMode=PORT_PIN_MODE_CAN
            CAN0TX: PortPinDirection=PORT_PIN_OUT, PortPinId=16, PortPinMode=
            CAN0RX: PortPinDirection=PORT_PIN_IN, PortPinId=17, PortPinMode=
        LEDS
          GPIO68 (PortPin):
            PortPinDirection = PORT_PIN_OUT
            PortPinDirectionChangeable = 0
            PortPinId = 68
            PortPinInitialMode = PORT_PIN_MODE_DIO
            PortPinLevelValue = PORT_PIN_LEVEL_HIGH
            PortPinMode = PORT_PIN_MODE_DIO
            PortPinModeChangeable = 0
            ArcPortPinPull = PORT_PIN_PULL_NONE
            ArcPortPinSlewRate = PORT_PIN_SLEW_RATE_MAX
            ArcPortPinOpenDrainEnable = 0
          GPIO69 (PortPin):
            PortPinDirection = PORT_PIN_OUT
            PortPinDirectionChangeable = 0
            PortPinId = 69
            PortPinInitialMode = PORT_PIN_MODE_DIO
            PortPinLevelValue = PORT_PIN_LEVEL_HIGH
            PortPinMode = PORT_PIN_MODE_DIO
            PortPinModeChangeable = 0
            ArcPortPinPull = PORT_PIN_PULL_NONE
            ArcPortPinSlewRate = PORT_PIN_SLEW_RATE_MAX
            ArcPortPinOpenDrainEnable = 0
        SPI
          8 x PortPin, all with PortPinDirectionChangeable=0, PortPinLevelValue=PORT_PIN_LEVEL_LOW, PortPinModeChangeable=0, ArcPortPinPull=PORT_PIN_PULL_NONE, ArcPortPinSlewRate=PORT_PIN_SLEW_RATE_MAX, ArcPortPinOpenDrainEnable=0:
            SIN1: PortPinDirection=PORT_PIN_IN, PortPinId=112, PortPinInitialMode=PORT_PIN_MODE_SPI, PortPinMode=PORT_PIN_MODE_SPI
            SOUT1: PortPinDirection=PORT_PIN_OUT, PortPinId=113, PortPinInitialMode=PORT_PIN_MODE_SPI, PortPinMode=PORT_PIN_MODE_SPI
            SCK_1: PortPinDirection=PORT_PIN_OUT, PortPinId=114, PortPinInitialMode=PORT_PIN_MODE_OTHER0, PortPinMode=PORT_PIN_MODE_OTHER0
            CS0_1: PortPinDirection=PORT_PIN_OUT, PortPinId=115, PortPinInitialMode=PORT_PIN_MODE_SPI, PortPinMode=PORT_PIN_MODE_SPI
            CS1_0: PortPinDirection=PORT_PIN_OUT, PortPinId=28, PortPinInitialMode=PORT_PIN_MODE_SPI, PortPinMode=PORT_PIN_MODE_SPI
            SCK_0: PortPinDirection=PORT_PIN_OUT, PortPinId=14, PortPinInitialMode=PORT_PIN_MODE_OTHER, PortPinMode=PORT_PIN_MODE_OTHER
            SIN_0: PortPinDirection=PORT_PIN_IN, PortPinId=12, PortPinInitialMode=PORT_PIN_MODE_SPI, PortPinMode=PORT_PIN_MODE_SPI
            SOUT_0: PortPinDirection=PORT_PIN_OUT, PortPinId=13, PortPinInitialMode=PORT_PIN_MODE_SPI, PortPinMode=PORT_PIN_MODE_SPI
        ADC
          ANS0 (PortPin):
            PortPinDirection = PORT_PIN_IN
            PortPinDirectionChangeable = 0
            PortPinId = 24
            PortPinInitialMode = PORT_PIN_MODE_ADC
            PortPinLevelValue = PORT_PIN_LEVEL_LOW
            PortPinMode = PORT_PIN_MODE_OTHER
            PortPinModeChangeable = 0
            ArcPortPinPull = PORT_PIN_PULL_NONE
            ArcPortPinSlewRate = PORT_PIN_SLEW_RATE_MIN
            ArcPortPinOpenDrainEnable = 0
        PWM
          E0UC22 (PortPin):
            PortPinDirection = PORT_PIN_OUT
            PortPinDirectionChangeable = 0
            PortPinId = 70
            PortPinInitialMode = PORT_PIN_MODE_OTHER
            PortPinLevelValue = PORT_PIN_LEVEL_LOW
            PortPinMode = PORT_PIN_MODE_OTHER
            PortPinModeChangeable = 0
            ArcPortPinPull = PORT_PIN_PULL_NONE
            ArcPortPinSlewRate = PORT_PIN_SLEW_RATE_MAX
            ArcPortPinOpenDrainEnable = 0
        Switch
          GPIO64 (PortPin):
            PortPinDirection = PORT_PIN_IN
            PortPinDirectionChangeable = 0
            PortPinId = 64
            PortPinInitialMode = PORT_PIN_MODE_DIO
            PortPinLevelValue = PORT_PIN_LEVEL_LOW
            PortPinMode = PORT_PIN_MODE_DIO
            PortPinModeChangeable = 0
            ArcPortPinPull = PORT_PIN_PULL_NONE
            ArcPortPinSlewRate = PORT_PIN_SLEW_RATE_MAX
            ArcPortPinOpenDrainEnable = 0
          GPIO65 (PortPin):
            PortPinDirection = PORT_PIN_IN
            PortPinDirectionChangeable = 0
            PortPinId = 65
            PortPinInitialMode = PORT_PIN_MODE_DIO
            PortPinLevelValue = PORT_PIN_LEVEL_LOW
            PortPinMode = PORT_PIN_MODE_DIO
            PortPinModeChangeable = 0
            ArcPortPinPull = PORT_PIN_PULL_NONE
            ArcPortPinSlewRate = PORT_PIN_SLEW_RATE_MED
            ArcPortPinOpenDrainEnable = false
    PortGeneral: PortDevErrorDetect=1, PortSetPinDirectionApi=0, PortSetPinModeApi=0, PortVersionInfoApi=0
  module config Spi: implementation-config-variant=VARIANT-PRE-COMPILE, module-description=Spi
    SpiDriver
      CH_ADDR (SpiChannel): SpiChannelId=(unset), SpiChannelType=EB, SpiDataWidth=16, SpiEbMaxLength=64, SpiIbNBuffers=0, SpiTransferStart=MSB, SpiDefaultData=0
      device_1 (SpiExternalDevice):
        SpiBaudrate = 4000000
        SpiCsIdentifier = 1
        SpiCsPolarity = LOW
        SpiDataShiftEdge = LEADING
        SpiEnableCs = (unset)
        SpiHwUnit = CSIB1
        SpiShiftClockIdleLevel = LOW
        SpiTimeClk2Cs = 0.000006
        ArcCsCallback = Spi_device_1
        ArcTimeCs2Clk = 0.000006
      JOB_CMD (SpiJob): SpiJobId=(unset), SpiJobPriority=0, SpiDeviceAssignment=device_1
        cmd (SpiChannelList): SpiChannelIndex=0, SpiChannelAssignment=CH_CMD
      SEQ_CMD (SpiSequence): SpiInterruptibleSequence=(unset), SpiSequenceId=(unset), SpiJobAssignment=JOB_CMD
      3 x SpiChannel, all with SpiChannelId=(unset), SpiChannelType=EB, SpiDataWidth=8, SpiIbNBuffers=0, SpiTransferStart=MSB:
        CH_CMD: SpiEbMaxLength=64
        CH_DATA: SpiEbMaxLength=64
        CH_WREN: SpiEbMaxLength=1, SpiDefaultData=6
      3 x SpiJob, all with SpiJobId=(unset), SpiDeviceAssignment=device_1:
        JOB_CMD2: SpiJobPriority=0
          cmd (SpiChannelList): SpiChannelIndex=0, SpiChannelAssignment=CH_CMD
          data (SpiChannelList): SpiChannelIndex=1, SpiChannelAssignment=CH_DATA
        JOB_DATA: SpiJobPriority=2
          3 x SpiChannelList:
            addr: SpiChannelIndex=1, SpiChannelAssignment=CH_ADDR
            cmd: SpiChannelIndex=0, SpiChannelAssignment=CH_CMD
            data: SpiChannelIndex=2, SpiChannelAssignment=CH_DATA
        JOB_WREN: SpiJobPriority=3
          wren (SpiChannelList): SpiChannelIndex=0, SpiChannelAssignment=CH_WREN
      3 x SpiSequence, all with SpiSequenceId=(unset):
        SEQ_CMD2: SpiInterruptibleSequence=(unset), SpiJobAssignment=JOB_CMD2
        SEQ_READ: SpiInterruptibleSequence=0, SpiJobAssignment=JOB_DATA
        SEQ_WRITE: SpiInterruptibleSequence=0, SpiJobAssignment=JOB_WREN, SpiJobAssignment=JOB_DATA
      CH_WATCHDOG (SpiChannel): SpiChannelId=(unset), SpiChannelType=EB, SpiDataWidth=16, SpiEbMaxLength=0, SpiIbNBuffers=0, SpiTransferStart=MSB, SpiDefaultData=23040
    SpiGeneral:
      SpiCancelApi = 1
      SpiChannelBuffersAllowed = (unset)
      SpiDevErrorDetect = 1
      SpiHwStatusApi = 1
      SpiInterruptibleSeqAllowed = (unset)
      SpiLevelDelivered = (unset)
      SpiSupportConcurrentSyncTransmit = (unset)
      SpiVersionInfoApi = 1
      ArcImplementation = FIFO
    SpiPublishedInformation: SpiMaxHwUnit=(unset)
  module config Adc: implementation-config-variant=VARIANT-PRE-COMPILE, module-description=Adc
    AdcConfigSet
      AdcHwUnit: AdcHwUnitId=ADC_CTRL_0, ArcAdcPrescaleDivideFactor=2
        AdcChannel1 (AdcChannel): ArcAdcChannelId=ADC_CH32, AdcChannelId=(unset)
        AdcGroup1 (AdcGroup):
          AdcGroupAccessMode = ADC_ACCESS_MODE_SINGLE
          AdcGroupConversionMode = ADC_CONV_MODE_ONESHOT
          AdcGroupId = (unset)
          AdcGroupTriggSrc = 
          AdcStreamingBufferMode = ADC_STREAM_BUFFER_LINEAR
          AdcStreamingNumSamples = 1
          AdcNotification = IoHwAb_AdcConversionComplete
          ArcAdcChannelConvTimeCmpTime = ADC_INPCPM_3
          ArcAdcChannelConvTimeLatchTime = ADC_INPLATCH_1
          ArcAdcChannelConvTimeSampTime = 255
          AdcGroupDefinition = AdcChannel1
    AdcGeneral:
      AdcDeInitApi = 1
      AdcDevErrorDetect = 1
      AdcEnableLimitCheck = (unset)
      AdcEnableQueuing = (unset)
      AdcEnableStartStopGroupApi = 1
      AdcGrpNotifCapability = 1
      AdcHwTriggerApi = (unset)
      AdcPriorityImplementation = ADC_PRIORITY_NONE
      AdcReadGroupApi = 1
      AdcResultAlignment = 
      AdcVersionInfoApi = 1
    AdcPublishedInformation: AdcChannelValueSigned=(unset), AdcGroupFirstChannelFixed=(unset), AdcMaxChannelResolution=(unset)
  module config EcuM: implementation-config-variant=VARIANT-POST-BUILD, module-description=EcuM
    EcuMConfiguration
      EcuMCommonConfiguration: EcuMConfigConsistencyHash=(unset), EcuMDefaultAppMode=(unset), EcuMOSResource=(unset)
        EcuMDefaultShutdownTarget: EcuMDefaultState=EcuMStateOff
        EcuMSleepMode: EcuMSleepModeId=(unset), EcuMSleepModeSuspend=(unset), EcuMSleepModeMcuModeRef=RUN, EcuMWakeupSourceMask=EcuMWakeupSource
        EcuMWakeupSource: EcuMWakeupSourceId=(unset), EcuMWakeupSourcePolling=0, EcuMResetReasonRef=(unset)
      EcuMFixedConfiguration: EcuMNvramReadallTimeout=10.0, EcuMNvramWriteallTimeout=10.0, EcuMRunMinimumDuration=10.0, EcuMNormalMcuModeRef=NORMAL
        User_1 (EcuMFixedUserConfig): EcuMFixedUser=(unset)
    EcuMGeneral: EcuMDevErrorDetect=0, EcuMIncludeDem=0, EcuMIncludeDet=0, EcuMMainFunctionPeriod=0.2, EcuMVersionInfoApi=0
    EcuMFixedGeneral: EcuMIncludeComM=(unset), EcuMIncludeNvM=(unset), EcuMIncludeNvramMgr=(unset), EcuMTTIIEnabled=(unset), EcuMTTIIWakeupSourceRef=(unset)
  module config Pwm: implementation-config-variant=VARIANT-PRE-COMPILE, module-description=Pwm
    PwmChannelConfigSet
      Channel_LED_3 (PwmChannel):
        PwmChannelId = 22
        PwmDutycycleDefault = 16384
        PwmIdleState = PWM_HIGH
        PwmPeriodDefault = 0.001
        PwmPolarity = PWM_LOW
        ArcPwmMode = PWM_MODE_BASIC
        ArcPwmClkSrc = PWM_CLKSRC_COUNTER_BUS_A
        ArcPwmChannelPrescaler = AUTO
        PwmChannelClass = PWM_FIXED_PERIOD
      Channel_LED_4 (PwmChannel):
        PwmChannelId = 23
        PwmDutycycleDefault = 0
        PwmIdleState = PWM_HIGH
        PwmPeriodDefault = 0.001
        PwmPolarity = PWM_LOW
        ArcPwmMode = PWM_MODE_COUNTER_BUS_PROVIDER_MCB_UP
        ArcPwmClkSrc = PWM_CLKSRC_INTERNAL_COUNTER
        ArcPwmChannelPrescaler = AUTO
        PwmChannelClass = PWM_FIXED_PERIOD
    PwmConfigurationOfOptApiServices: PwmDeInitApi=0, PwmGetOutputState=0, PwmSetDutyCycle=1, PwmSetOutputToIdle=0, PwmSetPeriodAndDuty=0, PwmVersionInfoApi=0
    PwmGeneral:
      PwmDevErrorDetect = 1
      PwmDevErorDetect = (unset)
      PwmDutycycleUpdatedEndperiod = (unset)
      ArcPwmGlobalPrescalerDivisorEMIOS0 = 1
      PwmNotificationSupported = 0
      PwmPeriodUpdatedEndperiod = (unset)
      ArcPwmGlobalPrescalerDivisorEMIOS1 = 1
      PwmIndex = (unset)
      ArcPwmGlobalPrescalerDivisorEMIOS2 = 1
