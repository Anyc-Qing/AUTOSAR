AUTOSAR XML (schema 4-2-1)
package /ArcCore/Boards/jacinto5e
  ecuc value collection MyEcu: ecu-extract=Jac5, ecuc-values=[Can, Mcu, Dio, Port, Pwm, Adc]
  module config Can: implementation-config-variant=VARIANT-PRE-COMPILE, module-description=Can
    CanConfigSet
      CanController0 (CanController):
        CanBusoffProcessing = 
        CanControllerActivation = 1
        CanControllerBaseAddress = (unset)
        CanControllerId = 0
        CanRxProcessing = 
        CanTxProcessing = 
        CanWakeupFunctionalityAPI = false
        CanWakeupProcessing = 
        CanWakeupSupport = (unset)
        CanControllerDefaultBaudrate = Ctrl_0_Baudrate_500
        CanCpuClockRef = (unset)
        Ctrl_0_Baudrate_500 (CanControllerBaudrateConfig):
          CanControllerBaudRate = 500
          CanControllerBaudRateConfigID = 0
          CanControllerPropSeg = 5
          CanControllerSeg1 = 1
          CanControllerSeg2 = 1
          CanControllerSyncJumpWidth = (unset)
      Ctrl_0_Tx_0 (CanHardwareObject): CanHandleType=BASIC, CanIdType=STANDARD, CanObjectId=(unset), CanObjectType=TRANSMIT, ArcCanFifoEnable=0, CanControllerRef=CanController0
      Ctrl_0_Rx_0 (CanHardwareObject): CanHandleType=BASIC, CanIdType=STANDARD, CanObjectId=(unset), CanObjectType=RECEIVE, ArcCanFifoEnable=0, CanControllerRef=CanController0
        CanHwFilter: CanHwFilterCode=0, CanHwFilterMask=0
      CanController1 (CanController):
        CanBusoffProcessing = 
        CanControllerActivation = 1
        CanControllerBaseAddress = (unset)
        CanControllerId = 1
        CanRxProcessing = 
        CanTxProcessing = 
        CanWakeupFunctionalityAPI = false
        CanWakeupProcessing = 
        CanWakeupSupport = (unset)
        CanControllerDefaultBaudrate = Ctrl_1_Baudrate_500
        CanCpuClockRef = (unset)
        Ctrl_1_Baudrate_500 (CanControllerBaudrateConfig):
          CanControllerBaudRate = 500
          CanControllerBaudRateConfigID = 0
          CanControllerPropSeg = 5
          CanControllerSeg1 = 1
          CanControllerSeg2 = 1
          CanControllerSyncJumpWidth = (unset)
      Ctrl_0_Rx_1 (CanHardwareObject): CanHandleType=BASIC, CanIdType=STANDARD, CanObjectId=(unset), CanObjectType=RECEIVE, ArcCanFifoEnable=0, CanControllerRef=CanController1
        CanHwFilter: CanHwFilterCode=0, CanHwFilterMask=0
      Ctrl_0_Tx_1 (CanHardwareObject): CanHandleType=BASIC, CanIdType=STANDARD, CanObjectId=(unset), CanObjectType=TRANSMIT, ArcCanFifoEnable=0, CanControllerRef=CanController1
    CanGeneral:
      CanDevErrorDetection = 1
      CanHardwareCancellation = (unset)
      CanIdenticalIdCancellation = (unset)
      CanIndex = (unset)
      CanMainFunctionModePeriod = (unset)
      CanMultiplexedTransmission = (unset)
      CanTimeoutDuration = (unset)
      CanVersionInfoApi = 1
      CanCounterRef = (unset)
      CanSupportTTCANRef = (unset)
      CanMainFunctionRWPeriods
  module config Mcu: implementation-config-variant=VARIANT-PRE-COMPILE, module-description=Mcu
    McuGeneralConfiguration: McuDevErrorDetect=1, McuGetRamStateApi=(unset), McuInitClock=true, McuNoPll=true, McuPerformResetApi=0, McuVersionInfoApi=1
    McuModuleConfiguration: McuClockSrcFailureNotification=, McuNumberOfMcuModes=(unset), McuRamSectors=(unset), ArcDefaultClockRef=McuClockSettingConfig
      McuClockSettingConfig: McuClockSettingId=(unset)
        McuClockReferencePoint: McuClockReferencePointFrequency=200000000
        ArcClockSettings:
          Enable_Timer_1 = false
          Enable_Timer_2 = false
          Enable_Timer_3 = true
          Enable_Timer_{4..16} = false
          Enable_CAN0 = true
          Enable_CAN1 = true
      3 x McuModeSettingConf, all with McuMode=(unset):
        NORMAL
        SLEEP
        RUN
    McuPublishedInformation
      McuResetReasonConf: McuResetReason=(unset)
  module config Dio: implementation-config-variant=VARIANT-PRE-COMPILE, module-description=Dio
    DioConfig
      PC (DioPort): DioPortId=(unset)
        3 x DioChannel:
          DioChannel_gp0_17: DioChannelId=17
          DioChannel_gp0_14: DioChannelId=14
          DioChannel_gp0_15: DioChannelId=15
      PE (DioPort): DioPortId=
        LED1 (DioChannel): DioChannelId=32
        LED2 (DioChannel): DioChannelId=48
    DioGeneral: DioDevErrorDetect=1, DioFlipChannelApi=(unset), DioVersionInfoApi=0
  module config Port: implementation-config-variant=VARIANT-PRE-COMPILE, module-description=Port
    PortConfigSet
      3 x PortContainer:
        CAN: PortNumberOfPortPins=(unset)
          4 x PortPin, all with PortPinDirectionChangeable=(unset), PortPinInitialMode=PORT_PIN_MODE_CAN, PortPinLevelValue=PORT_PIN_LEVEL_LOW, PortPinMode=, PortPinModeChangeable=(unset), ArcPortPinPull=PORT_PIN_PULL_NONE, ArcPortPinSlewRate=PORT_PIN_SLEW_FAST:
            PortPin_dcan1_af25: PortPinDirection=PORT_PIN_OUT, PortPinId=724
            PortPin_dcan1_ae25: PortPinDirection=PORT_PIN_IN, PortPinId=696
            PortPin_dcan0_ad24: PortPinDirection=PORT_PIN_IN, PortPinId=667
            PortPin_dcan0_ae24: PortPinDirection=PORT_PIN_OUT, PortPinId=695
        PWM: PortNumberOfPortPins=
          Portpin_pwm7_e14 (PortPin):
            PortPinDirection = PORT_PIN_OUT
            PortPinDirectionChangeable = 
            PortPinId = 125
            PortPinInitialMode = PORT_PIN_MODE_PWM
            PortPinLevelValue = PORT_PIN_LEVEL_HIGH
            PortPinMode = 
            PortPinModeChangeable = 
            ArcPortPinPull = PORT_PIN_PULL_NONE
            ArcPortPinSlewRate = PORT_PIN_SLEW_FAST
        GPIOS: PortNumberOfPortPins=
          3 x PortPin, all with PortPinDirectionChangeable=, PortPinInitialMode=PORT_PIN_MODE_DIO, PortPinLevelValue=PORT_PIN_LEVEL_LOW, PortPinMode=, PortPinModeChangeable=, ArcPortPinPull=PORT_PIN_PULL_NONE, ArcPortPinSlewRate=PORT_PIN_SLEW_FAST:
            PortPin_j26: PortPinDirection=PORT_PIN_OUT, PortPinId=249
            PortPin_k26: PortPinDirection=PORT_PIN_IN, PortPinId=277
            PortPin_k27: PortPinDirection=PORT_PIN_OUT, PortPinId=278
    PortGeneral: PortDevErrorDetect=1, PortSetPinDirectionApi=0, PortSetPinModeApi=0, PortVersionInfoApi=0, ArcPortGpioReset=true
  module config Pwm: implementation-config-variant=VARIANT-PRE-COMPILE, module-description=Pwm
    PwmChannelConfigSet
      Channel_LED_3 (PwmChannel): PwmChannelId=6, PwmDutycycleDefault=8192, PwmIdleState=PWM_HIGH, PwmPeriodDefault=0.001, PwmPolarity=PWM_LOW, PwmChannelClass=PWM_VARIABLE_PERIOD
    PwmConfigurationOfOptApiServices: PwmDeInitApi=1, PwmGetOutputState=1, PwmSetDutyCycle=1, PwmSetOutputToIdle=1, PwmSetPeriodAndDuty=1, PwmVersionInfoApi=1
    PwmGeneral: PwmDevErrorDetect=1, PwmDutycycleUpdatedEndperiod=1, PwmIndex=, PwmNotificationSupported=0, PwmPeriodUpdatedEndperiod=1
  module config Adc: implementation-config-variant=VARIANT-PRE-COMPILE, module-description=Adc
    AdcConfigSet
      AdcHwUnit: AdcHwUnitId=TSC_ADC, AdcPrescale=7
        AdcGroup1 (AdcGroup):
          AdcGroupAccessMode = ADC_ACCESS_MODE_SINGLE
          AdcGroupConversionMode = ADC_CONV_MODE_ONESHOT
          AdcGroupId = 
          AdcGroupTriggSrc = 
          AdcStreamingBufferMode = ADC_STREAM_BUFFER_LINEAR
          AdcStreamingNumSamples = 1
          AdcNotification = IoHwAb_AdcConversionComplete
          AdcGroupDefinition = AdcChannel1
        AdcChannel1 (AdcChannel): AdcChannelId=5, ArcAdcChannelDiffCNTRL=SINGLE_ENDED, ArcAdcChannelSELRFM=VREFN, ArcAdcChannelSELRFP=VREFP
    AdcGeneral:
      AdcDeInitApi = 1
      AdcDevErrorDetect = 1
      AdcEnableLimitCheck = 
      AdcEnableQueuing = 
      AdcEnableStartStopGroupApi = 1
      AdcGrpNotifCapability = 1
      AdcHwTriggerApi = 
      AdcPriorityImplementation = 
      AdcReadGroupApi = 1
      AdcResultAlignment = 
      AdcVersionInfoApi = 1
    AdcPublishedInformation: AdcChannelValueSigned=, AdcGroupFirstChannelFixed=, AdcMaxChannelResolution=
