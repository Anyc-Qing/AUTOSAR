AUTOSAR XML (schema 4-2-1)
package /ArcCore/Boards/tmdx570ls12hdk
  ecuc value collection tmdx570ls12hdk: ecuc-values=[EcuM, Mcu]
  module config EcuM: implementation-config-variant=VARIANT-PRE-COMPILE, module-description=EcuM
    EcuMConfiguration
      EcuMCommonConfiguration: EcuMConfigConsistencyHash=(unset), EcuMDefaultAppMode=(unset), EcuMOSResource=(unset)
        EcuMDefaultShutdownTarget: EcuMDefaultState=EcuMStateOff
        EcuMSleepMode: EcuMSleepModeId=(unset), EcuMSleepModeSuspend=(unset), EcuMSleepModeMcuModeRef=RUN, EcuMWakeupSourceMask=EcuMWakeupSource
        EcuMWakeupSource: EcuMWakeupSourceId=(unset), EcuMWakeupSourcePolling=0, EcuMValidationTimeout=0.0, EcuMResetReasonRef=(unset)
      EcuMFixedConfiguration: EcuMNvramReadallTimeout=10.0, EcuMNvramWriteallTimeout=10.0, EcuMRunMinimumDuration=10.0, EcuMNormalMcuModeRef=NORMAL
        EcuMFixedUserConfig: EcuMFixedUser=(unset)
    EcuMGeneral: EcuMDevErrorDetect=0, EcuMIncludeDem=0, EcuMIncludeDet=0, EcuMMainFunctionPeriod=0.2, EcuMVersionInfoApi=0
  module config Mcu: implementation-config-variant=VARIANT-PRE-COMPILE, module-description=Mcu
    McuGeneralConfiguration: McuDevErrorDetect=1, McuGetRamStateApi=1, McuInitClock=1, McuNoPll=0, McuPerformResetApi=1, McuVersionInfoApi=1
    McuModuleConfiguration: McuClockSrcFailureNotification=DISABLED, McuNumberOfMcuModes=(unset), McuRamSectors=(unset), ArcDefaultClockRef=McuClockSettingConfig
      McuClockSettingConfig: McuClockSettingId=(unset)
        McuClockReferencePoint: McuClockReferencePointFrequency=16000000, McuClockReferencePointRefClkDiv=6
        PLL180Mhz (PLLSettings): NF=135, ODPLL=2, R=1
      3 x McuModeSettingConf:
        NORMAL: McuMode=(unset)
        RUN: McuMode=(unset)
        SLEEP: McuMode=
    McuPublishedInformation
      McuResetReasonConf: McuResetReason=(unset)
