AUTOSAR XML (schema 4-0-3)
package /Tests/Os/OsekAl/Boards/mpc5744p_mmb
  ecuc value collection mpc5744p_mmb: ecuc-values=[Mcu, EcuM, Os]
  module config Os: implementation-config-variant=VARIANT-PRE-COMPILE, module-description=Os
    OsAppMode
    OsOS:
      OsScalabilityClass = SC3
      OsStackMonitoring = 1
      OsStatus = EXTENDED
      OsUseGetServiceId = 0
      OsUseParameterAccess = 0
      OsUseResScheduler = 0
      ArcOsTickFrequency = 1000
      ArcOsInterruptStackSize = 2048
      ArcOsIdleStackSize = 512
      ArcOsMaxIsr = 10
      ArcSafetyPlatform = false
      ArcOsIdleApplicationRef = (unset)
      OsHooks: OsErrorHook=1, OsPostTaskHook=1, OsPreTaskHook=1, OsShutdownHook=1, OsStartupHook=1
      ArcOsDebug: OsTaskDebug=0, OsAlarmDebug=0, OsResourceDebug=0, OsScheduleTableDebug=0, OsEventDebug=0, OsDebugActivated=0
    4 x OsAlarm, all with OsAlarmAccessingApplication=OsApplication_Sys:
      act_etask_h_full: OsAlarmCounterRef=soft1
        OsAlarmAction
          OsAlarmActivateTask: OsAlarmActivateTaskRef=etask_h_full
      act_etask_l_non: OsAlarmCounterRef=soft1
        OsAlarmAction
          OsAlarmActivateTask: OsAlarmActivateTaskRef=etask_l_non
      setev_go_etask_h_full: OsAlarmCounterRef=soft1
        OsAlarmAction
          OsAlarmSetEvent: OsAlarmSetEventRef=go, OsAlarmSetEventTaskRef=etask_h_full
      sys_tick_act_etask_h_full: OsAlarmCounterRef=system_tick
        OsAlarmAction
          OsAlarmActivateTask: OsAlarmActivateTaskRef=etask_h_full
    OsApplication1 (OsApplication):
      OsTrusted = 0
      OsAppTaskRef = etask_h_full
      OsAppCounterRef = soft1
      OsAppAlarmRef = act_etask_h_full
      OsAppAlarmRef = act_etask_l_non
      OsAppAlarmRef = setev_go_etask_h_full
      OsAppAlarmRef = sys_tick_act_etask_h_full
      OsAppTaskRef = etask_l_non
      OsAppTaskRef = etask_m_full
      OsAppAlarmRef = inc_soft1
      OsAppAlarmRef = autostart_abs
      OsAppAlarmRef = autostart_rel
      OsAppCounterRef = hard1
      OsAppCounterRef = soft3
      OsApplicationHooks: OsAppErrorHook=0, OsAppShutdownHook=0, OsAppStartupHook=0
    soft1 (OsCounter): OsCounterMaxAllowedValue=65535, OsCounterMinCycle=2, OsCounterTicksPerBase=(unset), OsCounterType=SOFTWARE
    system_tick (OsCounter): OsCounterMaxAllowedValue=(unset), OsCounterMinCycle=1, OsCounterTicksPerBase=(unset), OsCounterType=OS_TICK
    3 x OsTask, all with OsTaskActivation=1, ArcOsTaskStackSize=2048, OsTaskAccessingApplication=OsApplication_Sys:
      etask_h_full: OsTaskPriority=6, OsTaskSchedule=FULL, OsTaskEventRef=go, OsTaskEventRef=go2
      etask_l_non: OsTaskPriority=4, OsTaskSchedule=NON
      etask_m_full: OsTaskPriority=5, OsTaskSchedule=FULL, OsTaskEventRef=go
        OsTaskAutostart: OsTaskAppModeRef=(unset)
    go (OsEvent): OsEventMask=1
    go2 (OsEvent): OsEventMask=2
    3 x OsAlarm, all with OsAlarmCounterRef=system_tick, OsAlarmAccessingApplication=OsApplication_Sys:
      inc_soft1
        OsAlarmAction
          OsAlarmIncrementCounter: OsAlarmIncrementCounterRef=soft1
      autostart_abs
        OsAlarmAction
          OsAlarmIncrementCounter: OsAlarmIncrementCounterRef=soft1
        OsAlarmAutostart: OsAlarmAlarmTime=10000, OsAlarmAutostartType=ABSOLUTE, OsAlarmCycleTime=20000, OsAlarmAppModeRef=(unset)
      autostart_rel
        OsAlarmAction
          OsAlarmIncrementCounter: OsAlarmIncrementCounterRef=soft1
        OsAlarmAutostart: OsAlarmAlarmTime=10000, OsAlarmAutostartType=RELATIVE, OsAlarmCycleTime=20000, OsAlarmAppModeRef=(unset)
    hard1 (OsCounter): OsCounterMaxAllowedValue=65535, OsCounterMinCycle=1, OsCounterTicksPerBase=, OsCounterType=HARDWARE
    soft3 (OsCounter): OsCounterMaxAllowedValue=255, OsCounterMinCycle=1, OsCounterTicksPerBase=, OsCounterType=SOFTWARE
    OsApplication_Sys (OsApplication): OsTrusted=true, OsAppCounterRef=system_tick
      OsApplicationHooks: OsAppErrorHook=false, OsAppShutdownHook=false, OsAppStartupHook=false
    OsApplication2 (OsApplication): OsTrusted=false
      OsApplicationHooks: OsAppErrorHook=false, OsAppShutdownHook=false, OsAppStartupHook=false
