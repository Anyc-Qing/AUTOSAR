AUTOSAR XML (schema 4-2-2)
package /ArcCore/Boards/stm32_stm3210c
  ecuc value collection stm3210c: ecuc-values=[Mcu, Can, Dio, Port, Adc, Pwm, EcuM]
  module config Can: implementation-config-variant=VARIANT-PRE-COMPILE, module-description=Can
    CanConfigSet
      CanController0 (CanController):
        CanBusoffProcessing = INTERRUPT
        CanControllerActivation = 1
        CanControllerBaseAddress = (unset)
        CanControllerId = 0
        CanRxProcessing = INTERRUPT
        CanTxProcessing = INTERRUPT
        CanWakeupProcessing = INTERRUPT
        CanWakeupSupport = 0
        ArcCanControllerLoopback = 0
        CanWakeupFunctionalityAPI = (unset)
        CanControllerDefaultBaudrate = CanControllerBaudrateConfigA1
        CanCpuClockRef = (unset)
        CanControllerBaudrateConfigA1 (CanControllerBaudrateConfig):
          CanControllerBaudRate = 500
          CanControllerPropSeg = 8
          CanControllerSeg1 = 5
          CanControllerSeg2 = 4
          CanControllerSyncJumpWidth = 1
          CanControllerBaudRateConfigID = 0
      Ctrl_0_Rx_0 (CanHardwareObject): CanHandleType=BASIC, CanIdType=STANDARD, CanObjectId=(unset), CanObjectType=RECEIVE, CanControllerRef=CanController0
        CanHwFilter: CanHwFilterCode=0, CanHwFilterMask=0
      Ctrl_0_Tx_0 (CanHardwareObject): CanHandleType=BASIC, CanIdType=STANDARD, CanIdValue=(unset), CanObjectId=(unset), CanObjectType=TRANSMIT, CanControllerRef=CanController0
    CanGeneral:
      CanChangeBaudrateApi = 1
      CanDevErrorDetection = 1
      CanHardwareCancellation = 0
      CanIdenticalIdCancellation = 0
      CanIndex = (unset)
      CanMainFunctionModePeriod = (unset)
      CanMultiplexedTransmission = 1
      CanTimeoutDuration = (unset)
      CanVersionInfoApi = 1
      CanCounterRef = (unset)
      CanSupportTTCANRef = (unset)
      CanMainFunctionRWPeriods
  module config Dio: implementation-config-variant=VARIANT-PRE-COMPILE, module-description=Dio
    DioConfig
      LED_PORT (DioPort): DioPortId=3
        4 x DioChannel:
          LED1: DioChannelId=55
          LED2: DioChannelId=51
          LED3: DioChannelId=61
          LED4: DioChannelId=52
    DioGeneral: DioDevErrorDetect=1, DioFlipChannelApi=0, DioVersionInfoApi=1
  module config Port: implementation-config-variant=VARIANT-PRE-COMPILE, module-description=Port
    PortConfigSet: ArcPortPinRemap=GPIO_Remap_TIM4, ArcPortPinRemap=GPIO_Remap2_CAN1, ArcPortPinRemap=GPIO_Remap_ETH, ArcPortPinRemap=GPIO_Remap_CAN2
      4 x PortContainer:
        ADC: PortNumberOfPortPins=4
          4 x PortPin, all with PortPinDirection=PORT_PIN_IN, PortPinDirectionChangeable=0, PortPinInitialMode=PORT_PIN_MODE_ADC, PortPinLevelValue=PORT_PIN_LEVEL_LOW, PortPinModeChangeable=0, ArcPortPinGpioMode=GPIO_ANALOG_INPUT_CNF, ArcPortPinSlewRate=PORT_PIN_SLEW_RATE_MAX, PortPinMode=:
            PortPin_A7: PortPinId=7
            PortPin_C4: PortPinId=36
            PortPin_B1: PortPinId=17
            PortPin_B0: PortPinId=16
        CAN: PortNumberOfPortPins=4
          4 x PortPin, all with PortPinDirectionChangeable=0, PortPinInitialMode=PORT_PIN_MODE_CAN, PortPinLevelValue=PORT_PIN_LEVEL_LOW, PortPinModeChangeable=0, PortPinMode=:
            PortPin_D1: PortPinDirection=PORT_PIN_OUT, PortPinId=49, ArcPortPinGpioMode=GPIO_ALT_PUSHPULL_CNF, ArcPortPinSlewRate=PORT_PIN_SLEW_RATE_MED
            PortPin_D0: PortPinDirection=PORT_PIN_IN, PortPinId=48, ArcPortPinGpioMode=GPIO_INPUT_PULLUP_CNF, ArcPortPinSlewRate=PORT_PIN_SLEW_RATE_MIN
            PortPin_B5: PortPinDirection=PORT_PIN_IN, PortPinId=21, ArcPortPinGpioMode=GPIO_INPUT_PULLUP_CNF, ArcPortPinSlewRate=PORT_PIN_SLEW_RATE_MIN
            PortPin_B6: PortPinDirection=PORT_PIN_OUT, PortPinId=22, ArcPortPinGpioMode=GPIO_ALT_PUSHPULL_CNF, ArcPortPinSlewRate=PORT_PIN_SLEW_RATE_MED
        LED: PortNumberOfPortPins=4
          4 x PortPin, all with PortPinDirection=PORT_PIN_OUT, PortPinDirectionChangeable=0, PortPinInitialMode=PORT_PIN_MODE_DIO, PortPinLevelValue=PORT_PIN_LEVEL_LOW, PortPinMode=, PortPinModeChangeable=0, ArcPortPinSlewRate=PORT_PIN_SLEW_RATE_MED:
            PortPin_D3: PortPinId=51, ArcPortPinGpioMode=GPIO_OUTPUT_PUSHPULL_CNF
            PortPin_D4: PortPinId=52, ArcPortPinGpioMode=GPIO_OUTPUT_PUSHPULL_CNF
            PortPin_D13: PortPinId=61, ArcPortPinGpioMode=GPIO_ALT_PUSHPULL_CNF
            PortPin_D7: PortPinId=55, ArcPortPinGpioMode=GPIO_OUTPUT_PUSHPULL_CNF
        ETH: PortNumberOfPortPins=7
          7 x PortPin, all with PortPinDirection=PORT_PIN_OUT, PortPinDirectionChangeable=0, PortPinInitialMode=PORT_PIN_MODE_OTHER, PortPinLevelValue=PORT_PIN_LEVEL_LOW, PortPinMode=, PortPinModeChangeable=0, ArcPortPinGpioMode=GPIO_ALT_PUSHPULL_CNF, ArcPortPinSlewRate=PORT_PIN_SLEW_RATE_MAX:
            PortPin_A2: PortPinId=2
            PortPin_A8: PortPinId=8
            PortPin_B8: PortPinId=24
            PortPin_B13: PortPinId=29
            PortPin_B12: PortPinId=28
            PortPin_B11: PortPinId=27
            PortPin_C1: PortPinId=33
    PortGeneral: PortDevErrorDetect=1, PortSetPinDirectionApi=1, PortSetPinModeApi=0, PortVersionInfoApi=1
  module config EcuM: implementation-config-variant=VARIANT-POST-BUILD, module-description=EcuM
    EcuMConfiguration
      EcuMCommonConfiguration: EcuMConfigConsistencyHash=(unset), EcuMDefaultAppMode=(unset), EcuMOSResource=(unset)
        EcuMDefaultShutdownTarget: EcuMDefaultState=EcuMStateOff
        EcuMSleepMode: EcuMSleepModeId=(unset), EcuMSleepModeSuspend=(unset), EcuMSleepModeMcuModeRef=RUN, EcuMWakeupSourceMask=EcuMWakeupSource
        EcuMWakeupSource: EcuMWakeupSourceId=(unset), EcuMWakeupSourcePolling=0, EcuMResetReasonRef=(unset)
      EcuMFixedConfiguration: EcuMNvramReadallTimeout=10.0, EcuMNvramWriteallTimeout=10.0, EcuMRunMinimumDuration=10.0, EcuMNormalMcuModeRef=NORMAL
        User_1 (EcuMFixedUserConfig): EcuMFixedUser=(unset)
    EcuMGeneral: EcuMDevErrorDetect=0, EcuMIncludeDem=0, EcuMIncludeDet=0, EcuMMainFunctionPeriod=0.2, EcuMVersionInfoApi=0
    EcuMFixedGeneral: EcuMIncludeComM=(unset), EcuMIncludeNvM=(unset), EcuMIncludeNvramMgr=(unset), EcuMTTIIEnabled=(unset), EcuMTTIIWakeupSourceRef=(unset)
  module config Adc: implementation-config-variant=VARIANT-PRE-COMPILE, module-description=Adc
    AdcConfigSet
      AdcHwUnit: AdcHwUnitId=ADC_1, AdcPrescale=2
        AdcChannel1 (AdcChannel): AdcChannelId=14, ArcAdcChannelConversionTime=239_5_CYCLES
        AdcGroup1 (AdcGroup):
          AdcGroupAccessMode = 
          AdcGroupConversionMode = ADC_CONV_MODE_ONESHOT
          AdcGroupId = (unset)
          AdcGroupTriggSrc = ADC_TRIGG_SRC_SW
          AdcStreamingBufferMode = 
          AdcStreamingNumSamples = 1
          AdcNotification = IoHwAb_AdcConversionComplete
          AdcGroupDefinition = AdcChannel1
    AdcGeneral:
      AdcDeInitApi = 1
      AdcDevErrorDetect = 1
      AdcEnableLimitCheck = (unset)
      AdcEnableQueuing = (unset)
      AdcEnableStartStopGroupApi = 1
      AdcGrpNotifCapability = 1
      AdcHwTriggerApi = (unset)
      AdcPriorityImplementation = 
      AdcReadGroupApi = 1
      AdcResultAlignment = 
      AdcVersionInfoApi = 0
    AdcPublishedInformation: AdcChannelValueSigned=(unset), AdcGroupFirstChannelFixed=(unset), AdcMaxChannelResolution=(unset)
  module config Pwm: implementation-config-variant=VARIANT-PRE-COMPILE, module-description=Pwm
    PwmChannelConfigSet
      Channel_LED_3 (PwmChannel): PwmChannelId=42, PwmDutycycleDefault=16384, PwmIdleState=PWM_LOW, PwmPeriodDefault=0.001, PwmPolarity=PWM_HIGH, PwmChannelClass=PWM_FIXED_PERIOD
    PwmConfigurationOfOptApiServices: PwmDeInitApi=0, PwmGetOutputState=0, PwmSetDutyCycle=1, PwmSetOutputToIdle=0, PwmSetPeriodAndDuty=0, PwmVersionInfoApi=0
    PwmGeneral:
      PwmDevErrorDetect = 1
      PwmDutycycleUpdatedEndperiod = 0
      PwmIndex = (unset)
      PwmNotificationSupported = 0
      PwmPeriodUpdatedEndperiod = 0
      PwmDevErorDetect = (unset)
  module config Mcu: implementation-config-variant=VARIANT-PRE-COMPILE, module-description=Mcu
    McuGeneralConfiguration: McuDevErrorDetect=1, McuGetRamStateApi=0, McuInitClock=1, McuNoPll=0, McuPerformResetApi=0, McuVersionInfoApi=0
    McuModuleConfiguration: McuClockSrcFailureNotification=DISABLED, McuNumberOfMcuModes=(unset), McuRamSectors=(unset), ArcDefaultClockRef=McuClockSettingConfig
      McuClockSettingConfig:
        McuClockSettingId = 0
        ArcAPB2ClocksEnable = GPIOD
        ArcAPB2ClocksEnable = AFIO
        ArcAPB2ClocksEnable = GPIOB
        ArcAPB2ClocksEnable = GPIOA
        ArcAPB2ClocksEnable = GPIOC
        ArcAPB2ClocksEnable = GPIOE
        ArcAHBClocksEnable = ETH_MAC
        ArcAHBClocksEnable = ETH_MAC_Tx
        ArcAHBClocksEnable = ETH_MAC_Rx
        ArcAHBClocksEnable = DMA1
        ArcAPB1ClocksEnable = TIM2
        ArcAPB2ClocksEnable = ADC1
        ArcAPB1ClocksEnable = CAN1
        ArcAPB1ClocksEnable = TIM4
        PLLSettings72MHzOn25MHzOsc (PLLSettings): IDF=9, NDIV=8, ODF=0
        McuClockReferencePoint: Frequency=, McuClockReferencePointFrequency=25E6
      3 x McuModeSettingConf, all with McuMode=(unset):
        RUN
        SLEEP
        NORMAL
    McuPublishedInformation
      McuResetReasonConf: McuResetReason=0
