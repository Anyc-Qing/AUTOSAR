AUTOSAR XML (schema 4-2-2)
package /ArcCore/Boards/mpc5606s_xpc560s
  ecuc value collection MyEcu: ecuc-values=[EcuM, Adc, Can, Dio, Gpt, Lin, Mcu, Port, Pwm, Spi]
  module config EcuM: implementation-config-variant=VARIANT-PRE-COMPILE, module-description=EcuM
    EcuMConfiguration
      EcuMCommonConfiguration: EcuMConfigConsistencyHash=(unset), EcuMDefaultAppMode=(unset), EcuMOSResource=(unset)
        EcuMDefaultShutdownTarget: EcuMDefaultState=EcuMStateReset
        EcuMSleepMode: EcuMSleepModeId=(unset), EcuMSleepModeSuspend=0, EcuMSleepModeMcuModeRef=SLEEP, EcuMWakeupSourceMask=EcuMWakeupSource
        EcuMWakeupSource: EcuMWakeupSourceId=(unset), EcuMWakeupSourcePolling=0, EcuMValidationTimeout=0, EcuMResetReasonRef=(unset)
      EcuMFixedConfiguration: EcuMNvramReadallTimeout=10.0, EcuMNvramWriteallTimeout=10.0, EcuMRunMinimumDuration=10.0, EcuMNormalMcuModeRef=NORMAL
        User_1 (EcuMFixedUserConfig): EcuMFixedUser=User_1
    EcuMGeneral: EcuMDevErrorDetect=1, EcuMIncludeDem=0, EcuMIncludeDet=0, EcuMMainFunctionPeriod=0.2, EcuMVersionInfoApi=0
    EcuMFixedGeneral: EcuMIncludeComM=(unset), EcuMIncludeNvM=(unset), EcuMIncludeNvramMgr=(unset), EcuMTTIIEnabled=(unset), EcuMTTIIWakeupSourceRef=(unset)
  module config Adc: implementation-config-variant=VARIANT-PRE-COMPILE, module-description=Adc
    AdcConfigSet
      AdcHwUnit: AdcHwUnitId=ADC_CTRL_0, ArcAdcPrescaleDivideFactor=2
        channel_32 (AdcChannel): ArcAdcChannelId=ADC_CH32, AdcChannelId=(unset)
        GROUP5 (AdcGroup):
          AdcGroupAccessMode = ADC_ACCESS_MODE_SINGLE
          AdcGroupConversionMode = ADC_CONV_MODE_ONESHOT
          AdcGroupId = 
          AdcGroupTriggSrc = ADC_TRIGG_SRC_SW
          AdcStreamingBufferMode = ADC_STREAM_BUFFER_LINEAR
          AdcStreamingNumSamples = 1
          ArcAdcChannelConvTimeSampTime = 255
          ArcAdcChannelConvTimeLatchTime = ADC_INPLATCH_1
          ArcAdcChannelConvTimeCmpTime = ADC_INPCPM_3
          AdcGroupDefinition = channel_32
          AdcGroupDefinition = channel_33
          AdcGroupDefinition = AdcChannel1
          AdcGroupDefinition = channel_{35..40}
        8 x AdcChannel, all with AdcChannelId=(unset):
          channel_33: ArcAdcChannelId=ADC_CH33
          AdcChannel1: ArcAdcChannelId=ADC_CH34
          channel_{35..40}: ArcAdcChannelId=ADC_CH{35..40}
        6 x AdcGroup, all with AdcGroupId=, ArcAdcChannelConvTimeLatchTime=ADC_INPLATCH_1, ArcAdcChannelConvTimeCmpTime=ADC_INPCPM_3:
          AdcGroup1: AdcGroupAccessMode=ADC_ACCESS_MODE_SINGLE, AdcGroupConversionMode=ADC_CONV_MODE_ONESHOT, AdcGroupTriggSrc=ADC_TRIGG_SRC_SW, AdcStreamingBufferMode=ADC_STREAM_BUFFER_LINEAR, AdcStreamingNumSamples=1, ArcAdcChannelConvTimeSampTime=255, AdcNotification=IoHwAb_AdcConversionComplete, AdcGroupDefinition=AdcChannel1
          GROUP2: AdcGroupAccessMode=ADC_ACCESS_MODE_STREAMING, AdcGroupConversionMode=ADC_CONV_MODE_ONESHOT, AdcGroupTriggSrc=ADC_TRIGG_SRC_SW, AdcStreamingBufferMode=ADC_STREAM_BUFFER_CIRCULAR, AdcStreamingNumSamples=10, ArcAdcChannelConvTimeSampTime=255, AdcGroupDefinition=channel_37, AdcGroupDefinition=channel_38
          GROUP3: AdcGroupAccessMode=ADC_ACCESS_MODE_STREAMING, AdcGroupConversionMode=ADC_CONV_MODE_ONESHOT, AdcGroupTriggSrc=ADC_TRIGG_SRC_SW, AdcStreamingBufferMode=ADC_STREAM_BUFFER_LINEAR, AdcStreamingNumSamples=1, ArcAdcChannelConvTimeSampTime=255, AdcGroupDefinition=channel_37, AdcGroupDefinition=channel_38
          GROUP4: AdcGroupAccessMode=ADC_ACCESS_MODE_SINGLE, AdcGroupConversionMode=ADC_CONV_MODE_CONTINUOUS, AdcGroupTriggSrc=ADC_TRIGG_SRC_SW, AdcStreamingBufferMode=ADC_STREAM_BUFFER_LINEAR, AdcStreamingNumSamples=1, ArcAdcChannelConvTimeSampTime=255, AdcGroupDefinition=channel_32, AdcGroupDefinition=channel_33, AdcGroupDefinition=AdcChannel1, AdcGroupDefinition=channel_35, AdcGroupDefinition=channel_36, AdcGroupDefinition=channel_37, AdcGroupDefinition=channel_38, AdcGroupDefinition=channel_39, AdcGroupDefinition=channel_40
          GROUP0: AdcGroupAccessMode=ADC_ACCESS_MODE_STREAMING, AdcGroupConversionMode=ADC_CONV_MODE_CONTINUOUS, AdcGroupTriggSrc=ADC_TRIGG_SRC_SW, AdcStreamingBufferMode=ADC_STREAM_BUFFER_CIRCULAR, AdcStreamingNumSamples=255, ArcAdcChannelConvTimeSampTime=255, AdcGroupDefinition=channel_32, AdcGroupDefinition=channel_33, AdcGroupDefinition=AdcChannel1
          HW_TRIGG_MODD_GROUP: AdcGroupAccessMode=ADC_ACCESS_MODE_SINGLE, AdcGroupConversionMode=ADC_CONV_MODE_CONTINUOUS, AdcGroupTriggSrc=ADC_TRIGG_SRC_HW, AdcStreamingBufferMode=ADC_STREAM_BUFFER_CIRCULAR, AdcStreamingNumSamples=1, ArcAdcChannelConvTimeSampTime=3, AdcGroupDefinition=channel_32, AdcGroupDefinition=channel_33
    AdcGeneral:
      AdcDeInitApi = 1
      AdcDevErrorDetect = 1
      AdcEnableLimitCheck = 0
      AdcEnableQueuing = 1
      AdcEnableStartStopGroupApi = 1
      AdcGrpNotifCapability = 1
      AdcHwTriggerApi = 0
      AdcPriorityImplementation = ADC_PRIORITY_NONE
      AdcReadGroupApi = 1
      AdcResultAlignment = ADC_ALIGN_RIGHT
      AdcVersionInfoApi = 1
    AdcPublishedInformation: AdcChannelValueSigned=0, AdcGroupFirstChannelFixed=0, AdcMaxChannelResolution=10
  module config Can: implementation-config-variant=VARIANT-PRE-COMPILE, module-description=Can
    CanConfigSet
      CanController1 (CanController):
        CanBusoffProcessing = INTERRUPT
        CanControllerActivation = 1
        CanControllerBaseAddress = (unset)
        CanControllerId = 
        CanRxProcessing = INTERRUPT
        CanTxProcessing = INTERRUPT
        CanWakeupProcessing = INTERRUPT
        CanWakeupSupport = 0
        ArcCanControllerLoopback = 0
        ArcCanNumMessageBox = 64
        ArcCanControllerHwUnit = FLEXCAN_B
        ArcCanClockSourceOscillator = 0
        CanWakeupFunctionalityAPI = (unset)
        CanControllerDefaultBaudrate = CanBaudCfg1
        CanCpuClockRef = (unset)
        CanBaudCfg1 (CanControllerBaudrateConfig):
          CanControllerBaudRate = 125
          CanControllerPropSeg = 4
          CanControllerSeg1 = 4
          CanControllerSeg2 = 4
          CanControllerSyncJumpWidth = 1
          CanControllerBaudRateConfigID = 0
      CanController0 (CanController):
        CanBusoffProcessing = INTERRUPT
        CanControllerActivation = 1
        CanControllerBaseAddress = (unset)
        CanControllerId = 
        CanRxProcessing = INTERRUPT
        CanTxProcessing = INTERRUPT
        CanWakeupProcessing = INTERRUPT
        CanWakeupSupport = 0
        ArcCanControllerLoopback = 0
        ArcCanNumMessageBox = 64
        ArcCanControllerHwUnit = FLEXCAN_A
        ArcCanClockSourceOscillator = 0
        CanWakeupFunctionalityAPI = (unset)
        CanControllerDefaultBaudrate = CanBaudCfg0
        CanCpuClockRef = (unset)
        CanBaudCfg0 (CanControllerBaudrateConfig):
          CanControllerBaudRate = 500
          CanControllerPropSeg = 6
          CanControllerSeg1 = 6
          CanControllerSeg2 = 3
          CanControllerSyncJumpWidth = 2
          CanControllerBaudRateConfigID = 0
      4 x CanHardwareObject, all with CanHandleType=BASIC, CanIdType=STANDARD, CanObjectId=(unset), ArcCanFifoEnable=0, ArcCanMessageboxesPerHwObj=:
        Ctrl_1_Rx_0: CanObjectType=RECEIVE, CanHwObjectCount=8, CanControllerRef=CanController1
          CanHwFilter: CanHwFilterCode=0, CanHwFilterMask=0
        Ctrl_0_Rx_0: CanObjectType=RECEIVE, CanHwObjectCount=32, CanControllerRef=CanController0
          CanHwFilter: CanHwFilterCode=0, CanHwFilterMask=0
        Ctrl_1_Tx_0: CanObjectType=TRANSMIT, CanHwObjectCount=8, CanControllerRef=CanController1
        Ctrl_0_Tx_0: CanObjectType=TRANSMIT, CanHwObjectCount=32, CanControllerRef=CanController0
    CanGeneral:
      CanChangeBaudrateApi = 1
      CanDevErrorDetection = 1
      CanHardwareCancellation = 0
      CanIdenticalIdCancellation = 0
      CanIndex = (unset)
      CanMainFunctionModePeriod = (unset)
      CanMultiplexedTransmission = 0
      CanTimeoutDuration = (unset)
      CanVersionInfoApi = 1
      CanCounterRef = (unset)
      CanSupportTTCANRef = (unset)
      CanMainFunctionRWPeriods
  module config Dio: implementation-config-variant=VARIANT-PRE-COMPILE, module-description=Dio
    DioConfig
      PB (DioPort): DioPortId=1
        SpiCs (DioChannel): DioChannelId=28
      PE (DioPort): DioPortId=4
        4 x DioChannel:
          KEY1: DioChannelId=62
          KEY2: DioChannelId=63
          LED1: DioChannelId=67
          LED2: DioChannelId=66
    DioGeneral: DioDevErrorDetect=1, DioFlipChannelApi=0, DioVersionInfoApi=1
  module config Gpt: implementation-config-variant=VARIANT-PRE-COMPILE, module-description=Gpt
    GptChannelConfigSet
      4 x GptChannelConfiguration, all with GptChannelId=(unset), GptChannelTickFrequency=(unset), GptChannelTickValueMax=(unset), GptEnableWakeup=0, GptChannelClkSrcRef=(unset):
        GptChannel_1: GptChannelMode=GPT_CH_MODE_CONTINUOUS, ArcCoreGptPhysicalChannel=GPT_CHANNEL_PIT_0, GptNotification=gpt_notification1
        GptChannel_3: GptChannelMode=GPT_CH_MODE_CONTINUOUS, ArcCoreGptPhysicalChannel=GPT_CHANNEL_PIT_2, GptNotification=gpt_notification3
        GptChannel_2: GptChannelMode=GPT_CH_MODE_ONESHOT, ArcCoreGptPhysicalChannel=GPT_CHANNEL_PIT_1, GptNotification=gpt_notification2
        GptChannel_4: GptChannelMode=GPT_CH_MODE_ONESHOT, ArcCoreGptPhysicalChannel=GPT_CHANNEL_PIT_3, GptNotification=gpt_notification4
    GptConfigurationOfOptApiServices: GptDeinitApi=1, GptEnableDisableNotificationApi=1, GptTimeElapsedApi=1, GptTimeRemainingApi=1, GptVersionInfoApi=1, GptWakeupFunctionalityApi=0
    GptDriverConfiguration: GptDevErrorDetect=1, GptReportWakeupSource=0, GptPredefTimer100us32bitEnable=(unset), GptPredefTimer1usEnablingGrade=
      GptClockReferencePoint: GptClockReference=(unset)
  module config Lin: implementation-config-variant=VARIANT-PRE-COMPILE, module-description=Lin
    LinGeneral: LinDevErrorDetect=1, LinIndex=0, LinTimeoutDuration=(unset), LinVersionInfoApi=1
    LinGlobalConfig
      Channel_0 (LinChannel): LinChannelBaudRate=19200, LinChannelId=0, LinChannelWakeupSupport=(unset), LinClockRef=(unset)
  module config Mcu: implementation-config-variant=VARIANT-PRE-COMPILE, module-description=Mcu
    McuGeneralConfiguration: McuDevErrorDetect=1, McuGetRamStateApi=0, McuInitClock=1, McuNoPll=0, McuPerformResetApi=1, McuVersionInfoApi=1
    McuModuleConfiguration: McuClockSrcFailureNotification=DISABLED, McuNumberOfMcuModes=(unset), McuRamSectors=(unset), ArcDefaultClockRef=Clock
      Clock (McuClockSettingConfig): McuClockSettingId=(unset)
        PLLSettings: IDF=0, NDIV=64, ODF=2
        McuClockReferencePoint: Frequency=, McuClockReferencePointFrequency=8000000.0
      3 x McuModeSettingConf:
        SLEEP: McuMode=
        NORMAL: McuMode=(unset)
        RUN: McuMode=(unset)
    McuPublishedInformation
      McuResetReasonConf: McuResetReason=(unset)
  module config Port: implementation-config-variant=VARIANT-PRE-COMPILE, module-description=Port
    PortConfigSet
      6 x PortContainer, all with PortNumberOfPortPins=:
        ADC
          ANS0 (PortPin):
            PortPinDirection = PORT_PIN_IN
            PortPinDirectionChangeable = 0
            PortPinId = 32
            PortPinInitialMode = PORT_PIN_MODE_ADC
            PortPinLevelValue = PORT_PIN_LEVEL_LOW
            PortPinMode = PORT_PIN_MODE_OTHER
            PortPinModeChangeable = 0
            ArcPortPinPull = PORT_PIN_PULL_NONE
            ArcPortPinSlewRate = PORT_PIN_SLEW_RATE_MED
            ArcPortPinOpenDrainEnable = 0
        CAN
          4 x PortPin, all with PortPinDirectionChangeable=0, PortPinInitialMode=PORT_PIN_MODE_CAN, PortPinLevelValue=PORT_PIN_LEVEL_LOW, PortPinMode=PORT_PIN_MODE_CAN, PortPinModeChangeable=0, ArcPortPinPull=PORT_PIN_PULL_NONE, ArcPortPinSlewRate=PORT_PIN_SLEW_RATE_MIN, ArcPortPinOpenDrainEnable=0:
            CAN0TX: PortPinDirection=PORT_PIN_OUT, PortPinId=16
            CAN0RX: PortPinDirection=PORT_PIN_IN, PortPinId=17
            CAN1RX: PortPinDirection=PORT_PIN_IN, PortPinId=26
            CAN1TX: PortPinDirection=PORT_PIN_OUT, PortPinId=27
        LEDS
          LED2 (PortPin):
            PortPinDirection = PORT_PIN_OUT
            PortPinDirectionChangeable = 1
            PortPinId = 67
            PortPinInitialMode = PORT_PIN_MODE_DIO
            PortPinLevelValue = PORT_PIN_LEVEL_HIGH
            PortPinMode = 
            PortPinModeChangeable = 0
            ArcPortPinPull = PORT_PIN_PULL_NONE
            ArcPortPinSlewRate = PORT_PIN_SLEW_RATE_MIN
            ArcPortPinOpenDrainEnable = 0
          LED1 (PortPin):
            PortPinDirection = PORT_PIN_OUT
            PortPinDirectionChangeable = 1
            PortPinId = 66
            PortPinInitialMode = PORT_PIN_MODE_DIO
            PortPinLevelValue = PORT_PIN_LEVEL_HIGH
            PortPinMode = 
            PortPinModeChangeable = 1
            ArcPortPinPull = PORT_PIN_PULL_NONE
            ArcPortPinSlewRate = PORT_PIN_SLEW_RATE_MIN
            ArcPortPinOpenDrainEnable = 0
        Switch
          Key2 (PortPin):
            PortPinDirection = PORT_PIN_IN
            PortPinDirectionChangeable = 1
            PortPinId = 73
            PortPinInitialMode = PORT_PIN_MODE_DIO
            PortPinLevelValue = PORT_PIN_LEVEL_LOW
            PortPinMode = 
            PortPinModeChangeable = 1
            ArcPortPinPull = PORT_PIN_PULL_NONE
            ArcPortPinSlewRate = PORT_PIN_SLEW_RATE_MIN
            ArcPortPinOpenDrainEnable = 0
          Key1 (PortPin):
            PortPinDirection = PORT_PIN_IN
            PortPinDirectionChangeable = 1
            PortPinId = 76
            PortPinInitialMode = PORT_PIN_MODE_DIO
            PortPinLevelValue = PORT_PIN_LEVEL_LOW
            PortPinMode = 
            PortPinModeChangeable = 1
            ArcPortPinPull = PORT_PIN_PULL_NONE
            ArcPortPinSlewRate = PORT_PIN_SLEW_RATE_MIN
            ArcPortPinOpenDrainEnable = 0
        PWM
          EMIOSA_22 (PortPin):
            PortPinDirection = PORT_PIN_OUT
            PortPinDirectionChangeable = 0
            PortPinId = 0
            PortPinInitialMode = PORT_PIN_MODE_PWM
            PortPinLevelValue = PORT_PIN_LEVEL_LOW
            PortPinMode = PORT_PIN_MODE_OTHER
            PortPinModeChangeable = 0
            ArcPortPinPull = PORT_PIN_PULL_NONE
            ArcPortPinSlewRate = PORT_PIN_SLEW_RATE_MAX
            ArcPortPinOpenDrainEnable = 0
        SPI
          9 x PortPin, all with PortPinDirectionChangeable=0, PortPinInitialMode=PORT_PIN_MODE_SPI, PortPinLevelValue=PORT_PIN_LEVEL_LOW, PortPinModeChangeable=0, ArcPortPinPull=PORT_PIN_PULL_NONE, ArcPortPinSlewRate=PORT_PIN_SLEW_RATE_MIN, ArcPortPinOpenDrainEnable=0:
            SIN_1: PortPinDirection=PORT_PIN_IN, PortPinId=22, PortPinMode=PORT_PIN_MODE_OTHER_3
            SOUT1: PortPinDirection=PORT_PIN_OUT, PortPinId=21, PortPinMode=PORT_PIN_MODE_OTHER_3
            SCK_1: PortPinDirection=PORT_PIN_OUT, PortPinId=20, PortPinMode=PORT_PIN_MODE_OTHER_3
            SIN_0: PortPinDirection=PORT_PIN_IN, PortPinId=23, PortPinMode=PORT_PIN_MODE_SPI
            SCK_0: PortPinDirection=PORT_PIN_OUT, PortPinId=25, PortPinMode=
            SOUT_0: PortPinDirection=PORT_PIN_OUT, PortPinId=24, PortPinMode=PORT_PIN_MODE_OTHER_3
            CS0_0: PortPinDirection=PORT_PIN_IN, PortPinId=103, PortPinMode=
            CS0_1: PortPinDirection=PORT_PIN_OUT, PortPinId=43, PortPinMode=PORT_PIN_MODE_OTHER_3
            CS1_0: PortPinDirection=PORT_PIN_IN, PortPinId=29, PortPinMode=
    PortGeneral: PortDevErrorDetect=1, PortSetPinDirectionApi=1, PortSetPinModeApi=1, PortVersionInfoApi=1
  module config Pwm: implementation-config-variant=VARIANT-PRE-COMPILE, module-description=Pwm
    PwmChannelConfigSet
      Channel_LED_3 (PwmChannel):
        PwmChannelId = 22
        PwmDutycycleDefault = 16384
        PwmIdleState = PWM_HIGH
        PwmPeriodDefault = 0.001
        PwmPolarity = PWM_LOW
        ArcPwmMode = PWM_MODE_BASIC
        ArcPwmClkSrc = PWM_CLKSRC_COUNTER_BUS_A
        ArcPwmChannelPrescaler = AUTO
      Channel_LED_4 (PwmChannel):
        PwmChannelId = 23
        PwmDutycycleDefault = 0
        PwmIdleState = PWM_LOW
        PwmPeriodDefault = 0.01
        PwmPolarity = PWM_LOW
        ArcPwmMode = PWM_MODE_BASIC
        ArcPwmClkSrc = PWM_CLKSRC_COUNTER_BUS_A
        ArcPwmChannelPrescaler = AUTO
    PwmConfigurationOfOptApiServices: PwmDeInitApi=1, PwmGetOutputState=1, PwmSetDutyCycle=1, PwmSetOutputToIdle=1, PwmSetPeriodAndDuty=0, PwmVersionInfoApi=1
    PwmGeneral:
      PwmDevErorDetect = (unset)
      PwmDevErrorDetect = 1
      PwmDutycycleUpdatedEndperiod = 1
      PwmNotificationSupported = 1
      PwmPeriodUpdatedEndperiod = 1
      ArcPwmGlobalPrescalerDivisorEMIOS0 = 4
      ArcPwmGlobalPrescalerDivisorEMIOS1 = 4
      PwmIndex = (unset)
  module config Spi: implementation-config-variant=VARIANT-PRE-COMPILE, module-description=Spi
    SpiDriver
      CH_ADDR (SpiChannel): SpiChannelId=(unset), SpiChannelType=EB, SpiDataWidth=16, SpiEbMaxLength=64, SpiIbNBuffers=0, SpiTransferStart=MSB, SpiDefaultData=0
      device_1 (SpiExternalDevice):
        SpiBaudrate = 100000
        SpiCsIdentifier = 1
        SpiCsPolarity = LOW
        SpiDataShiftEdge = LEADING
        SpiEnableCs = (unset)
        SpiHwUnit = CSIB0
        SpiShiftClockIdleLevel = LOW
        SpiTimeClk2Cs = 0.000006
        ArcCsCallback = Spi_device_1
        ArcTimeCs2Clk = 0.000006
      JOB_CMD (SpiJob): SpiJobId=(unset), SpiJobPriority=0, SpiDeviceAssignment=device_1
        cmd (SpiChannelList): SpiChannelIndex=0, SpiChannelAssignment=CH_CMD
      SEQ_CMD (SpiSequence): SpiInterruptibleSequence=(unset), SpiSequenceId=(unset), SpiJobAssignment=JOB_CMD
      3 x SpiChannel, all with SpiChannelId=(unset), SpiChannelType=EB, SpiDataWidth=8, SpiIbNBuffers=0, SpiTransferStart=MSB:
        CH_CMD: SpiEbMaxLength=64
        CH_DATA: SpiEbMaxLength=64
        CH_WREN: SpiEbMaxLength=1, SpiDefaultData=6
      3 x SpiJob, all with SpiJobId=(unset), SpiDeviceAssignment=device_1:
        JOB_CMD2: SpiJobPriority=0
          cmd (SpiChannelList): SpiChannelIndex=0, SpiChannelAssignment=CH_CMD
          data (SpiChannelList): SpiChannelIndex=1, SpiChannelAssignment=CH_DATA
        JOB_DATA: SpiJobPriority=2
          3 x SpiChannelList:
            addr: SpiChannelIndex=1, SpiChannelAssignment=CH_ADDR
            cmd: SpiChannelIndex=0, SpiChannelAssignment=CH_CMD
            data: SpiChannelIndex=2, SpiChannelAssignment=CH_DATA
        JOB_WREN: SpiJobPriority=3
          wren (SpiChannelList): SpiChannelIndex=0, SpiChannelAssignment=CH_WREN
      3 x SpiSequence, all with SpiSequenceId=(unset):
        SEQ_CMD2: SpiInterruptibleSequence=(unset), SpiJobAssignment=JOB_CMD2
        SEQ_READ: SpiInterruptibleSequence=0, SpiJobAssignment=JOB_DATA
        SEQ_WRITE: SpiInterruptibleSequence=0, SpiJobAssignment=JOB_WREN, SpiJobAssignment=JOB_DATA
    SpiGeneral:
      SpiCancelApi = 1
      SpiChannelBuffersAllowed = (unset)
      SpiDevErrorDetect = 1
      SpiHwStatusApi = 1
      SpiInterruptibleSeqAllowed = (unset)
      SpiLevelDelivered = (unset)
      SpiSupportConcurrentSyncTransmit = (unset)
      SpiVersionInfoApi = 1
      ArcImplementation = FIFO
    SpiPublishedInformation: SpiMaxHwUnit=(unset)
