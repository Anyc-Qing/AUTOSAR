AUTOSAR XML (schema 4-2-2)
package /ArcCore/Boards/mpc5748g_mpc574xg_mb
  ecuc value collection mpc5748g_mpc574xg_mb: ecuc-values=[Mcu, Can, Dio, Port, Adc, Pwm, EcuM, Spi, Wdg]
  module config Mcu: implementation-config-variant=VARIANT-PRE-COMPILE, module-description=Mcu
    McuGeneralConfiguration: McuDevErrorDetect=true, McuGetRamStateApi=false, McuInitClock=true, McuNoPll=false, McuPerformResetApi=false, McuVersionInfoApi=false
    McuModuleConfiguration: McuClockSrcFailureNotification=DISABLED, McuNumberOfMcuModes=, McuRamSectors=, ArcDefaultClockRef=McuClockSettingConfig
      McuClockSettingConfig: McuClockSettingId=
        McuClockReferencePoint: Frequency=, McuClockReferencePointFrequency=40000000.0
        ArcPLLSettings: PLLDV_PREDIV=1, PLLDV_MFD=16, PLLDV_RFDPHI=1, PLLDV_RFDPHI1=2, PLLFM_MODPRD=0, PLLFM_INCSTP=0, PLLFM_MODEN=false
      3 x McuModeSettingConf, all with McuMode=:
        NORMAL
        RUN
        SLEEP
    McuPublishedInformation
      McuResetReasonConf: McuResetReason=
  module config Can: implementation-config-variant=VARIANT-PRE-COMPILE, module-description=Can
    CanConfigSet
      CanController0 (CanController):
        CanBusoffProcessing = INTERRUPT
        CanControllerActivation = true
        CanControllerBaseAddress = 
        CanControllerId = 0
        CanRxProcessing = INTERRUPT
        CanTxProcessing = INTERRUPT
        CanWakeupFunctionalityAPI = false
        CanWakeupProcessing = INTERRUPT
        CanWakeupSupport = false
        ArcCanControllerLoopback = false
        ArcCanNumMessageBox = 64
        ArcCanControllerHwUnit = FLEXCAN_A
        ArcCanClockSourceOscillator = true
        CanControllerDefaultBaudrate = CanControllerBaudrateConfig_0
        CanCpuClockRef = (unset)
        CanControllerBaudrateConfig_0 (CanControllerBaudrateConfig):
          CanControllerBaudRate = 500
          CanControllerBaudRateConfigID = 0
          CanControllerPropSeg = 7
          CanControllerSeg1 = 6
          CanControllerSeg2 = 2
          CanControllerSyncJumpWidth = 1
      Ctrl_0_Rx_0 (CanHardwareObject):
        CanHandleType = BASIC
        CanIdType = STANDARD
        CanObjectId = 
        CanObjectType = RECEIVE
        ArcCanFifoEnable = false
        ArcCanMessageboxesPerHwObj = 
        CanHwObjectCount = 1
        CanControllerRef = CanController0
        CanHwFilter: CanHwFilterCode=0, CanHwFilterMask=0
      Ctrl_0_Tx_0 (CanHardwareObject):
        CanHandleType = BASIC
        CanIdType = STANDARD
        CanObjectId = 
        CanObjectType = TRANSMIT
        ArcCanFifoEnable = false
        ArcCanMessageboxesPerHwObj = 
        CanHwObjectCount = 1
        CanControllerRef = CanController0
    CanGeneral:
      CanDevErrorDetection = true
      CanHardwareCancellation = false
      CanIdenticalIdCancellation = false
      CanIndex = 
      CanMainFunctionModePeriod = 
      CanMultiplexedTransmission = false
      CanTimeoutDuration = 
      CanVersionInfoApi = true
      CanCounterRef = (unset)
      CanSupportTTCANRef = (unset)
      CanMainFunctionRWPeriods
  module config Dio: implementation-config-variant=VARIANT-PRE-COMPILE, module-description=Dio
    DioConfig
      PortJ (DioPort): DioPortId=9
        SpiCs (DioChannel): DioChannelId=144
      PortG (DioPort): DioPortId=6
        LED1 (DioChannel): DioChannelId=98
        LED2 (DioChannel): DioChannelId=99
    DioGeneral: DioDevErrorDetect=true, DioFlipChannelApi=, DioVersionInfoApi=false
  module config Port: implementation-config-variant=VARIANT-PRE-COMPILE, module-description=Port
    PortConfigSet
      6 x PortContainer, all with PortNumberOfPortPins=:
        GPIO
          LED1_DS2 (PortPin):
            PortPinDirection = PORT_PIN_OUT
            PortPinDirectionChangeable = 0
            PortPinId = 98
            PortPinInitialMode = PORT_PIN_MODE_DIO
            PortPinLevelValue = PORT_PIN_LEVEL_HIGH
            PortPinMode = 
            PortPinModeChangeable = 0
            ArcPortPinPull = PORT_PIN_PULL_DOWN
            ArcPortPinSlewRate = PORT_PIN_SLEW_RATE_MED
            ArcPortPinOpenDrainEnable = false
          LED2_DS3 (PortPin):
            PortPinDirection = PORT_PIN_OUT
            PortPinDirectionChangeable = 0
            PortPinId = 99
            PortPinInitialMode = PORT_PIN_MODE_DIO
            PortPinLevelValue = PORT_PIN_LEVEL_LOW
            PortPinMode = PORT_PIN_MODE_DIO
            PortPinModeChangeable = 0
            ArcPortPinPull = PORT_PIN_PULL_DOWN
            ArcPortPinSlewRate = PORT_PIN_SLEW_RATE_MED
            ArcPortPinOpenDrainEnable = false
        CAN
          CAN0TX (PortPin):
            PortPinDirection = PORT_PIN_OUT
            PortPinDirectionChangeable = 0
            PortPinId = 16
            PortPinInitialMode = PORT_PIN_MODE_CAN
            PortPinLevelValue = PORT_PIN_LEVEL_LOW
            PortPinMode = PORT_PIN_MODE_CAN
            PortPinModeChangeable = 0
            ArcPortPinPull = PORT_PIN_PULL_NONE
            ArcPortPinSlewRate = PORT_PIN_SLEW_RATE_MED
            ArcPortPinOpenDrainEnable = false
          CAN0RX (PortPin):
            PortPinDirection = PORT_PIN_IN
            PortPinDirectionChangeable = 0
            PortPinId = 17
            PortPinInitialMode = PORT_PIN_MODE_CAN
            PortPinLevelValue = PORT_PIN_LEVEL_LOW
            PortPinMode = PORT_PIN_MODE_CAN
            PortPinModeChangeable = 0
            ArcPortPinPull = PORT_PIN_PULL_NONE
            ArcPortPinSlewRate = PORT_PIN_SLEW_RATE_MED
            ArcPortPinOpenDrainEnable = false
        ANALOG
          ADC_0_ADC0_S_2 (PortPin):
            PortPinDirection = PORT_PIN_IN
            PortPinDirectionChangeable = 0
            PortPinId = 26
            PortPinInitialMode = PORT_PIN_MODE_ADC
            PortPinLevelValue = PORT_PIN_LEVEL_LOW
            PortPinMode = PORT_PIN_MODE_ADC
            PortPinModeChangeable = 0
            ArcPortPinPull = PORT_PIN_PULL_NONE
            ArcPortPinSlewRate = PORT_PIN_SLEW_RATE_MAX
            ArcPortPinOpenDrainEnable = false
        ETH
          21 x PortPin, all with PortPinDirectionChangeable=0, PortPinInitialMode=PORT_PIN_MODE_ETH, PortPinLevelValue=PORT_PIN_LEVEL_LOW, PortPinMode=PORT_PIN_MODE_ETH, PortPinModeChangeable=0, ArcPortPinPull=PORT_PIN_PULL_NONE, ArcPortPinSlewRate=PORT_PIN_SLEW_RATE_MAX, ArcPortPinOpenDrainEnable=false:
            ENET0_MII_0_RX_CLK: PortPinDirection=PORT_PIN_IN, PortPinId=3
            ENET0_MII_0_RXD_2: PortPinDirection=PORT_PIN_IN, PortPinId=7
            ENET0_MII_RMII_0_RXD_1: PortPinDirection=PORT_PIN_IN, PortPinId=8
            ENET0_MII_RMII_0_RXD_0: PortPinDirection=PORT_PIN_IN, PortPinId=9
            ENET0_MII_0_COL: PortPinDirection=PORT_PIN_IN, PortPinId=10
            ENET0_MII_RMII_0_RX_ER: PortPinDirection=PORT_PIN_IN, PortPinId=11
            ENET0_ENET0_TMR0: PortPinDirection=PORT_PIN_OUT, PortPinId=61
            ENET0_MII_0_CRS: PortPinDirection=PORT_PIN_IN, PortPinId=76
            ENET0_MII_0_RXD_3: PortPinDirection=PORT_PIN_IN, PortPinId=77
            ENET0_MII_RMII_0_MDIO: PortPinDirection=PORT_PIN_OUT, PortPinId=94
            ENET0_MII_RMII_0_RX_DV: PortPinDirection=PORT_PIN_IN, PortPinId=95
            ENET0_MII_RMII_0_MDC: PortPinDirection=PORT_PIN_OUT, PortPinId=96
            ENET0_MII_RMII_0_TX_CLK: PortPinDirection=PORT_PIN_OUT, PortPinId=97
            ENET0_MII_0_TXD_2: PortPinDirection=PORT_PIN_OUT, PortPinId=108
            ENET0_MII_0_TXD_3: PortPinDirection=PORT_PIN_OUT, PortPinId=109
            ENET0_MII_RMII_0_TXD_1: PortPinDirection=PORT_PIN_OUT, PortPinId=112
            ENET0_MII_RMII_0_TXD_0: PortPinDirection=PORT_PIN_OUT, PortPinId=113
            ENET0_MII_RMII_0_TX_EN: PortPinDirection=PORT_PIN_OUT, PortPinId=114
            ENET0_MII_0_TX_ER: PortPinDirection=PORT_PIN_OUT, PortPinId=115
            ENET0_ENET0_TMR1: PortPinDirection=PORT_PIN_OUT, PortPinId=139
            ENET0_ENET0_TMR2: PortPinDirection=PORT_PIN_OUT, PortPinId=195
        PWM
          EMIOS1_E1UC_13_H (PortPin):
            PortPinDirection = PORT_PIN_IN
            PortPinDirectionChangeable = 0
            PortPinId = 100
            PortPinInitialMode = PORT_PIN_MODE_PWM
            PortPinLevelValue = PORT_PIN_LEVEL_LOW
            PortPinMode = PORT_PIN_MODE_PWM
            PortPinModeChangeable = 0
            ArcPortPinPull = PORT_PIN_PULL_NONE
            ArcPortPinSlewRate = PORT_PIN_SLEW_RATE_MAX
            ArcPortPinOpenDrainEnable = false
          EMIOS1_E1UC_14_H (PortPin):
            PortPinDirection = PORT_PIN_OUT
            PortPinDirectionChangeable = 0
            PortPinId = 101
            PortPinInitialMode = PORT_PIN_MODE_PWM
            PortPinLevelValue = PORT_PIN_LEVEL_LOW
            PortPinMode = PORT_PIN_MODE_PWM
            PortPinModeChangeable = 0
            ArcPortPinPull = PORT_PIN_PULL_NONE
            ArcPortPinSlewRate = PORT_PIN_SLEW_RATE_MAX
            ArcPortPinOpenDrainEnable = false
        SPI
          9 x PortPin, all with PortPinDirectionChangeable=0, PortPinLevelValue=PORT_PIN_LEVEL_LOW, PortPinModeChangeable=0, ArcPortPinSlewRate=PORT_PIN_SLEW_RATE_MAX:
            DSPI_0_dSOUT_0: PortPinDirection=PORT_PIN_OUT, PortPinId=13, PortPinInitialMode=PORT_PIN_MODE_SPI, PortPinMode=PORT_PIN_MODE_SPI, ArcPortPinPull=PORT_PIN_PULL_NONE, ArcPortPinOpenDrainEnable=0
            DSPI_0_dSCLK_0: PortPinDirection=PORT_PIN_OUT, PortPinId=14, PortPinInitialMode=PORT_PIN_MODE_SPI, PortPinMode=PORT_PIN_MODE_SPI, ArcPortPinPull=PORT_PIN_PULL_UP, ArcPortPinOpenDrainEnable=0
            DSPI_0_dCS0_0: PortPinDirection=PORT_PIN_OUT, PortPinId=15, PortPinInitialMode=PORT_PIN_MODE_SPI, PortPinMode=PORT_PIN_MODE_SPI, ArcPortPinPull=PORT_PIN_PULL_UP, ArcPortPinOpenDrainEnable=0
            SIUL2_GPIO_144: PortPinDirection=PORT_PIN_OUT, PortPinId=144, PortPinInitialMode=PORT_PIN_MODE_DIO, PortPinMode=PORT_PIN_MODE_DIO, ArcPortPinPull=PORT_PIN_PULL_UP, ArcPortPinOpenDrainEnable=0
            SPI_0_SOUT_0: PortPinDirection=PORT_PIN_OUT, PortPinId=145, PortPinInitialMode=PORT_PIN_MODE_SPI, PortPinMode=PORT_PIN_MODE_SPI, ArcPortPinPull=PORT_PIN_PULL_NONE, ArcPortPinOpenDrainEnable=0
            SPI_0_SCLK_0: PortPinDirection=PORT_PIN_OUT, PortPinId=87, PortPinInitialMode=PORT_PIN_MODE_SPI, PortPinMode=PORT_PIN_MODE_SPI, ArcPortPinPull=PORT_PIN_PULL_DOWN, ArcPortPinOpenDrainEnable=0
            SPI_0_SIN_0: PortPinDirection=PORT_PIN_IN, PortPinId=142, PortPinInitialMode=PORT_PIN_MODE_SPI, PortPinMode=PORT_PIN_MODE_SPI, ArcPortPinPull=PORT_PIN_PULL_NONE, ArcPortPinOpenDrainEnable=0
            SPI_0_CS0_0: PortPinDirection=PORT_PIN_OUT, PortPinId=143, PortPinInitialMode=PORT_PIN_MODE_SPI, PortPinMode=PORT_PIN_MODE_SPI, ArcPortPinPull=PORT_PIN_PULL_UP, ArcPortPinOpenDrainEnable=0
            DSPI_0_dSIN_0: PortPinDirection=PORT_PIN_IN, PortPinId=12, PortPinInitialMode=PORT_PIN_MODE_OTHER2, PortPinMode=PORT_PIN_MODE_OTHER2, ArcPortPinPull=PORT_PIN_PULL_NONE, ArcPortPinOpenDrainEnable=false
    PortGeneral: PortDevErrorDetect=true, PortSetPinDirectionApi=false, PortSetPinModeApi=false, PortVersionInfoApi=false
  module config Adc: implementation-config-variant=VARIANT-PRE-COMPILE, module-description=Adc
    AdcConfigSet
      AdcHwUnit: AdcHwUnitId=ADC_CTRL_0, ArcAdcPrescaleDivideFactor=2
        AdcChannel1 (AdcChannel): ArcAdcChannelId=ADC_CH7, AdcChannelId=
        AdcGroup1 (AdcGroup):
          AdcGroupAccessMode = ADC_ACCESS_MODE_SINGLE
          AdcGroupConversionMode = ADC_CONV_MODE_ONESHOT
          AdcGroupId = 
          AdcGroupTriggSrc = 
          AdcStreamingBufferMode = ADC_STREAM_BUFFER_LINEAR
          AdcStreamingNumSamples = 1
          AdcNotification = IoHwAb_AdcConversionComplete
          ArcAdcChannelConvTimeSampTime = 255
          AdcGroupDefinition = AdcChannel1
    AdcGeneral:
      AdcDeInitApi = true
      AdcDevErrorDetect = true
      AdcEnableLimitCheck = 
      AdcEnableQueuing = 
      AdcEnableStartStopGroupApi = true
      AdcGrpNotifCapability = true
      AdcHwTriggerApi = 
      AdcPriorityImplementation = 
      AdcReadGroupApi = true
      AdcResultAlignment = 
      AdcVersionInfoApi = 1
    AdcPublishedInformation: AdcChannelValueSigned=, AdcGroupFirstChannelFixed=, AdcMaxChannelResolution=
  module config EcuM: implementation-config-variant=VARIANT-PRE-COMPILE, module-description=EcuM
    EcuMConfiguration
      EcuMCommonConfiguration: EcuMConfigConsistencyHash=, EcuMDefaultAppMode=(unset), EcuMOSResource=(unset)
        EcuMDefaultShutdownTarget: EcuMDefaultState=EcuMStateOff
        EcuMSleepMode: EcuMSleepModeId=, EcuMSleepModeSuspend=, EcuMSleepModeMcuModeRef=SLEEP, EcuMWakeupSourceMask=EcuMWakeupSource
        EcuMWakeupSource: EcuMWakeupSourceId=, EcuMWakeupSourcePolling=false, EcuMResetReasonRef=(unset)
      EcuMFixedConfiguration: EcuMNvramReadallTimeout=10.0, EcuMNvramWriteallTimeout=10.0, EcuMRunMinimumDuration=10.0, EcuMNormalMcuModeRef=NORMAL
        EcuMFixedUserConfig: EcuMFixedUser=
    EcuMGeneral: EcuMDevErrorDetect=false, EcuMIncludeDem=false, EcuMIncludeDet=false, EcuMMainFunctionPeriod=0.2, EcuMVersionInfoApi=false
  module config Spi: implementation-config-variant=VARIANT-PRE-COMPILE, module-description=Spi
    SpiGeneral:
      SpiCancelApi = true
      SpiChannelBuffersAllowed = 
      SpiDevErrorDetect = true
      SpiHwStatusApi = true
      SpiInterruptibleSeqAllowed = 
      SpiLevelDelivered = 1
      SpiSupportConcurrentSyncTransmit = 
      SpiVersionInfoApi = true
      ArcImplementation = FIFO
      ArcSpiAutosarCompatabilityLowerThanV4_1 = true
    SpiPublishedInformation: SpiMaxHwUnit=
    SpiDriver
      CH_ADDR (SpiChannel): SpiChannelId=, SpiChannelType=EB, SpiDataWidth=16, SpiEbMaxLength=64, SpiIbNBuffers=0, SpiTransferStart=MSB, SpiDefaultData=0
      device_1 (SpiExternalDevice):
        SpiBaudrate = 100000
        SpiCsIdentifier = 0
        SpiCsPolarity = LOW
        SpiDataShiftEdge = LEADING
        SpiEnableCs = 
        SpiHwUnit = CSIB4
        SpiShiftClockIdleLevel = LOW
        SpiTimeClk2Cs = 0.00006
        ArcTimeCs2Clk = 0.00006
        ArcCsCallback = Spi_device_1
      JOB_CMD (SpiJob): SpiJobId=, SpiJobPriority=0, SpiDeviceAssignment=device_1
        cmd (SpiChannelList): SpiChannelIndex=0, SpiChannelAssignment=CH_CMD
      SEQ_CMD (SpiSequence): SpiInterruptibleSequence=, SpiSequenceId=, SpiJobAssignment=JOB_CMD
      3 x SpiChannel, all with SpiChannelId=, SpiChannelType=EB, SpiDataWidth=8, SpiIbNBuffers=0, SpiTransferStart=MSB:
        CH_CMD: SpiEbMaxLength=64
        CH_DATA: SpiEbMaxLength=64
        CH_WREN: SpiEbMaxLength=1, SpiDefaultData=6
      JOB_CMD2 (SpiJob): SpiJobId=, SpiJobPriority=0, SpiDeviceAssignment=device_1
        cmd (SpiChannelList): SpiChannelIndex=0, SpiChannelAssignment=CH_CMD
        data (SpiChannelList): SpiChannelIndex=1, SpiChannelAssignment=CH_DATA
      JOB_DATA (SpiJob): SpiJobId=, SpiJobPriority=2, SpiDeviceAssignment=device_1
        3 x SpiChannelList:
          addr: SpiChannelIndex=1, SpiChannelAssignment=CH_ADDR
          cmd: SpiChannelIndex=0, SpiChannelAssignment=CH_CMD
          data: SpiChannelIndex=2, SpiChannelAssignment=CH_DATA
      SEQ_CMD2 (SpiSequence): SpiInterruptibleSequence=, SpiSequenceId=, SpiJobAssignment=JOB_CMD2
      SEQ_READ (SpiSequence): SpiInterruptibleSequence=, SpiSequenceId=, SpiJobAssignment=JOB_DATA
      JOB_WREN (SpiJob): SpiJobId=, SpiJobPriority=3, SpiDeviceAssignment=device_1
        wren (SpiChannelList): SpiChannelIndex=0, SpiChannelAssignment=CH_WREN
      SEQ_WRITE (SpiSequence): SpiInterruptibleSequence=, SpiSequenceId=, SpiJobAssignment=JOB_WREN, SpiJobAssignment=JOB_DATA
  module config Wdg: implementation-config-variant=VARIANT-PRE-COMPILE, module-description=Wdg
    WdgGeneral: WdgDevErrorDetect=1, WdgDisableAllowed=, WdgRunArea=, WdgTriggerLocation=, WdgVersionInfoApi=1
    WdgPublishedInformation: WdgTriggerMode=
    WdgSettingsConfig: WdgDefaultMode=WDGIF_FAST_MODE
      WdgSettingsFast: ActivationBit=1, ReloadValue=512, ArcWdgTimeoutValue=100
      WdgSettingsOff: ActivationBit=1, ReloadValue=32000
      WdgSettingsSlow: ActivationBit=1, ReloadValue=32000, ArcWdgTimeoutValue=2000
  module config Pwm: implementation-config-variant=VARIANT-PRE-COMPILE, module-description=Pwm
    PwmChannelConfigSet
      Channel_LED_3 (PwmChannel):
        PwmChannelId = 43
        PwmDutycycleDefault = 16384
        PwmIdleState = PWM_HIGH
        PwmPeriodDefault = 0.01
        PwmPolarity = PWM_LOW
        ArcPwmMode = PWM_MODE_BASIC
        ArcPwmClkSrc = PWM_CLKSRC_COUNTER_BUS_A
        ArcPwmChannelPrescaler = 1
        PwmChannelClass = PWM_FIXED_PERIOD
      Channel_LED_4 (PwmChannel):
        PwmChannelId = 44
        PwmDutycycleDefault = 0
        PwmIdleState = PWM_HIGH
        PwmPeriodDefault = 0.01
        PwmPolarity = PWM_LOW
        ArcPwmMode = PWM_MODE_COUNTER_BUS_PROVIDER_MCB_UP
        ArcPwmClkSrc = PWM_CLKSRC_INTERNAL_COUNTER
        ArcPwmChannelPrescaler = AUTO
        PwmChannelClass = PWM_FIXED_PERIOD
    PwmConfigurationOfOptApiServices: PwmDeInitApi=0, PwmGetOutputState=0, PwmSetDutyCycle=1, PwmSetOutputToIdle=0, PwmSetPeriodAndDuty=0, PwmVersionInfoApi=0
    PwmGeneral:
      PwmDevErorDetect = (unset)
      PwmDevErrorDetect = 1
      PwmDutycycleUpdatedEndperiod = 1
      PwmNotificationSupported = 1
      PwmPeriodUpdatedEndperiod = 1
      ArcPwmGlobalPrescalerDivisorEMIOS0 = 4
      ArcPwmGlobalPrescalerDivisorEMIOS1 = 4
      PwmIndex = (unset)
      ArcPwmGlobalPrescalerDivisorEMIOS2 = 1
