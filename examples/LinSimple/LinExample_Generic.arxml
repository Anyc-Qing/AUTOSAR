AUTOSAR XML (schema 4-0-1)
package /Lin_Example
  module config LinIf: implementation-config-variant=VARIANT-PRE-COMPILE, module-description=LinIf
    LinIfGeneral:
      LinIfCancelTransmitSupported = 0
      LinIfDevErrorDetect = 1
      LinIfMultipleDriversSupported = 0
      LinIfMultipleTrcvDriverSupported = 0
      LinIfNcOptionalRequestSupported = 0
      LinIfTpSupported = 0
      LinIfTrcvDriverSupported = 0
      LinIfVersionInfoApi = 0
    LinIfGlobalConfig: LinIfTimeBase=0.005
      LinIfChannel1 (LinIfChannel):
        LinIfChannelId = 0
        LinIfGotoSleepConfirmationUL = LIN_SM
        LinIfScheduleRequestConfirmationUL = LIN_SM
        LinIfStartupState = SLEEP
        LinIfWakeupConfirmationUL = LIN_SM
        LinIfChannelRef = LinChannel1
        LinIfComMNetworkHandleRef = ComMChannel1
        SCHEDULE_01 (LinIfScheduleTable): LinIfResumePosition=START_FROM_BEGINNING, LinIfRunMode=RUN_CONTINUOUS, LinIfScheduleMode=, LinIfScheduleTableIndex=0
          3 x LinIfEntry:
            SCHEDULE_01_ENTRY_01: LinIfDelay=0.010, LinIfEntryIndex=0, LinIfFrameRef=ENG_TX_01
            SCHEDULE_01_ENTRY_02: LinIfDelay=0.015, LinIfEntryIndex=1, LinIfFrameRef=ENG_RX_01
            SCHEDULE_01_ENTRY_03: LinIfDelay=0.025, LinIfEntryIndex=2, LinIfFrameRef=ENG_RX_02
        ENG_TX_01 (LinIfFrame): LinIfChecksumType=ENHANCED, LinIfFrameType=UNCONDITIONAL, LinIfLength=8, LinIfFrameId=11
          LinIfPduDirection
            TX_01 (LinIfTxPdu): LinIfTxPduId=(unset), LinIfUserTxUL=PDUR, LinIfTxPduRef=EcucPduCollection/ENG_TX
        ENG_MASTER (LinIfMaster): LinIfClusterTimeBase=0.005, LinIfJitter=0.002
        ENG_RX_01 (LinIfFrame): LinIfChecksumType=ENHANCED, LinIfFrameType=UNCONDITIONAL, LinIfLength=4, LinIfFrameId=14
          LinIfPduDirection
            RX_01 (LinIfRxPdu): LinIfUserRxIndicationUL=PDUR, LinIfRxPduRef=EcucPduCollection/LAMPS_RX
        ENG_RX_02 (LinIfFrame): LinIfChecksumType=ENHANCED, LinIfFrameType=UNCONDITIONAL, LinIfLength=8, LinIfFrameId=18
          LinIfPduDirection
            RX_02 (LinIfRxPdu): LinIfUserRxIndicationUL=PDUR, LinIfRxPduRef=EcucPduCollection/TCM_RX
  module config EcuC: implementation-config-variant=VARIANT-PRE-COMPILE, module-description=EcuC
    EcucPduCollection: PduIdTypeEnum=UINT16, PduLengthTypeEnum=UINT16
      3 x Pdu:
        ENG_TX: PduLength=8
        LAMPS_RX: PduLength=4
        TCM_RX: PduLength=8
  module config LinSM: implementation-config-variant=VARIANT-PRE-COMPILE, module-description=LinSM
    LinSMConfigSet
      LinSMChannel1 (LinSMChannel): LinSMConfirmationTimeout=0.8, LinSMSleepSupport=1, LinSMComMNetworkHandleRef=ComMChannel1
        LinSMSchedule1 (LinSMSchedule): LinSMScheduleIndex=(unset), LinSMScheduleIndexRef=SCHEDULE_01
    LinSMGeneral: LinSMDevErrorDetect=1, LinSMMainProcessingPeriod=0.1, LinSMVersionInfoApi=1
  module config ComM: implementation-config-variant=VARIANT-PRE-COMPILE, module-description=ComM
    ComMConfigSet
      ComMChannel1 (ComMChannel):
        ComMBusType = COMM_BUS_TYPE_LIN
        ComMChannelId = (unset)
        ComMFullCommRequestNotificationEnabled = false
        ComMGlobalNvmBlockDescriptor = (unset)
        ComMMainFunctionPeriod = 0.02
        ComMNoCom = false
        ComMNoWakeup = false
        ComMUserPerChannel: ComMUserChannel=ComMUser
        ComMNetworkManagement: ComMNmVariant=NONE, ComMPncNmRequest=0
      ComMUser: ComMUserIdentifier=(unset)
    ComMGeneral:
      ComMNoCom = false
      ComMEcuGroupClassification = 3
      ComMModeLimitationEnabled = false
      ComMPncSupport = false
      ComMSynchronousWakeUp = True
      ComMTMinFullComModeDuration = 5.0
      ComMVersionInfoApi = true
      ComMWakeupInhibitionEnabled = False
      ComMDevErrorDetect = false
      ArcComMASRCompatibilityLessThan4_2 = true
  module config PduR: implementation-config-variant=VARIANT-POST-BUILD, module-description=PduR
    PduRGeneral: PduRDevErrorDetect=1, PduRVersionInfoApi=0, PduRZeroCostOperation=0
    PduRRoutingTables: PduRConfigurationId=0, ArcPduRMaxRouteCount=10
      PduRRoutingTable: PduRIsMinimumRouting=
        3 x PduRRoutingPath:
          PATH_RX_01
            RX_01 (PduRDestPdu): PduRDestPduDataProvision=PDUR_DIRECT, ArcOverridenDestModule=Com, PduRDestPduRef=EcucPduCollection/LAMPS_RX
            LAMPS_RX (PduRSrcPdu): PduRSourcePduHandleId=(unset), ArcOverridenSrcModule=LinIf, PduRSrcPduRef=EcucPduCollection/LAMPS_RX
          PATH_RX_02
            RX_02 (PduRDestPdu): PduRDestPduDataProvision=PDUR_DIRECT, ArcOverridenDestModule=Com, PduRDestPduRef=EcucPduCollection/TCM_RX
            TCM_RX (PduRSrcPdu): PduRSourcePduHandleId=(unset), ArcOverridenSrcModule=LinIf, PduRSrcPduRef=EcucPduCollection/TCM_RX
          PATH_TX_01
            TX_01 (PduRDestPdu): ArcOverridenDestModule=LinIf, PduRDestPduDataProvision=PDUR_DIRECT, PduRDestPduRef=EcucPduCollection/ENG_TX
            ENG_TX (PduRSrcPdu): PduRSourcePduHandleId=(unset), ArcOverridenSrcModule=Com, PduRSrcPduRef=EcucPduCollection/ENG_TX
    LinIf (PduRBswModules):
      PduRCancelReceive = 0
      PduRCancelTransmit = (unset)
      PduRChangeParameterRequestApi = (unset)
      PduRCommunicationInterface = (unset)
      PduRLowerModule = 1
      PduRRetransmission = (unset)
      PduRTransportProtocol = (unset)
      PduRTriggertransmit = (unset)
      PduRTxConfirmation = (unset)
      PduRUpperModule = 0
      PduRUseTag = (unset)
      PduRBswModuleRef = (unset)
    Com (PduRBswModules):
      PduRCancelReceive = 0
      PduRCancelTransmit = (unset)
      PduRChangeParameterRequestApi = (unset)
      PduRCommunicationInterface = (unset)
      PduRLowerModule = 0
      PduRRetransmission = (unset)
      PduRTransportProtocol = (unset)
      PduRTriggertransmit = (unset)
      PduRTxConfirmation = (unset)
      PduRUpperModule = 1
      PduRUseTag = (unset)
      PduRBswModuleRef = (unset)
  module config Os: implementation-config-variant=VARIANT-PRE-COMPILE, module-description=Os
    OsAppMode
    OsOS:
      OsScalabilityClass = SC1
      OsStackMonitoring = 1
      OsStatus = STANDARD
      OsUseGetServiceId = 1
      OsUseParameterAccess = 1
      OsUseResScheduler = 1
      ArcOsTickFrequency = 1000
      ArcOsInterruptStackSize = 2048
      ArcOsIdleStackSize = 512
      ArcOsMaxIsr = 10
      ArcSafetyPlatform = false
      OsHooks: OsErrorHook=1, OsPostTaskHook=1, OsPreTaskHook=1, OsShutdownHook=1, OsStartupHook=1
      ArcOsDebug: OsTaskDebug=0, OsAlarmDebug=0, OsResourceDebug=0, OsScheduleTableDebug=0, OsEventDebug=0, OsDebugActivated=0
    Init (OsTask): OsTaskActivation=1, OsTaskPriority=1, OsTaskSchedule=FULL, ArcOsTaskStackSize=2048
      OsTaskAutostart: OsTaskAppModeRef=(unset)
    OsTask: OsTaskActivation=1, OsTaskPriority=1, OsTaskSchedule=FULL, ArcOsTaskStackSize=2048, OsTaskEventRef=OsEvent
      OsTaskAutostart: OsTaskAppModeRef=(unset)
    OsCounter: OsCounterMaxAllowedValue=65535, OsCounterMinCycle=1, OsCounterTicksPerBase=(unset), OsCounterType=OS_TICK
    OsEvent
    OsApplication: OsTrusted=1, OsAppAlarmRef=OsAlarm, OsAppCounterRef=OsCounter, OsAppTaskRef=Init, OsAppTaskRef=OsTask
      OsApplicationHooks: OsAppErrorHook=0, OsAppShutdownHook=0, OsAppStartupHook=0
    OsAlarm: OsAlarmCounterRef=OsCounter
      OsAlarmAction
        OsAlarmSetEvent: OsAlarmSetEventRef=OsEvent, OsAlarmSetEventTaskRef=OsTask
      OsAlarmAutostart: OsAlarmAlarmTime=50, OsAlarmAutostartType=ABSOLUTE, OsAlarmCycleTime=5, OsAlarmAppModeRef=(unset)
  module config Det: implementation-config-variant=VARIANT-PRE-COMPILE, module-description=Det
    DetGeneral:
      DetVersionInfoApi = 0
      DetUseRamlog = 1
      DetEnableCallbacks = 0
      DetWrapRamlog = 1
      DetUseStdErr = 0
      DetDeInitAPI = 0
      DetNumberOfCallbacks = 5
      DetRamlogSize = 16
      DetUseSafetyMonitor = false
  module config Com: implementation-config-variant=VARIANT-POST-BUILD, module-description=Com
    ComConfig: ComConfigurationId=(unset)
      ComTimeBase: ComRxTimeBase=10, ComTxTimeBase=10
      ENG_TX (ComIPdu):
        ComIPduDirection = SEND
        ComIPduSignalProcessing = IMMEDIATE
        ComIPduTriggerTransmitCallout = NULL
        ComIPduType = 
        ComPduIdRef = EcucPduCollection/ENG_TX
        ComIPduGroupRef = LIN
        ComIPduSignalRef = Signal_Tx_{1..3}
        ComTxIPdu: ComTxIPduUnusedAreasDefault=0
          ComTxModeTrue
            ComTxMode: ComTxModeMode=PERIODIC
      LIN (ComIPduGroup): ComIPduGroupHandleId=(unset)
      LAMPS_RX (ComIPdu):
        ComIPduDirection = RECEIVE
        ComIPduSignalProcessing = IMMEDIATE
        ComIPduTriggerTransmitCallout = NULL
        ComIPduType = 
        ComPduIdRef = EcucPduCollection/LAMPS_RX
        ComIPduGroupRef = LIN
        ComIPduSignalRef = Signal_Rx_1
        ComIPduSignalRef = Signal_Rx_2
      TCM_RX (ComIPdu):
        ComIPduDirection = RECEIVE
        ComIPduSignalProcessing = IMMEDIATE
        ComIPduTriggerTransmitCallout = NULL
        ComIPduType = 
        ComPduIdRef = EcucPduCollection/TCM_RX
        ComIPduGroupRef = LIN
        ComIPduSignalRef = Word_1
        ComIPduSignalRef = Word_2
      7 x ComSignal, all with ComHandleId=(unset), ComSignalEndianness=BIG_ENDIAN:
        Signal_Rx_1: ComBitPosition=8, ComSignalType=UINT16, ComBitSize=16
        Signal_Rx_2: ComBitPosition=24, ComSignalType=UINT16, ComBitSize=16
        Word_1: ComBitPosition=24, ComSignalType=UINT32, ComBitSize=32
        Word_2: ComBitPosition=56, ComSignalType=UINT32, ComBitSize=32
        Signal_Tx_1: ComBitPosition=0, ComSignalType=UINT8, ComBitSize=8
        Signal_Tx_2: ComBitPosition=32, ComSignalType=UINT32, ComBitSize=32
        Signal_Tx_3: ComBitPosition=56, ComSignalType=UINT32, ComBitSize=24
    ComGeneral:
      ComSupportedIPduGroups = 1
      ComVersionInfoApi = 0
      ComSupportedIPdus = 20
      ComSupportedSignals = 40
      ComSupportedGroupSignals = 40
      ComRamBufferSize = 160
      ComConfigurationUseDet = 0
      ArcMaxNumberOfSupportedIPduCounters = 2
      ArcComSupportedGatewaySourceDescriptions = 0
      ArcComOsekNmSupport = false
  module config EcuM: implementation-config-variant=VARIANT-PRE-COMPILE, module-description=EcuM
    EcuMConfiguration
      EcuMCommonConfiguration: EcuMConfigConsistencyHash=(unset), EcuMDefaultAppMode=(unset), EcuMOSResource=(unset)
        EcuMDefaultShutdownTarget: EcuMDefaultState=EcuMStateSleep
        EcuMSleepMode: EcuMSleepModeId=(unset), EcuMSleepModeSuspend=(unset), EcuMSleepModeMcuModeRef=RUN, EcuMWakeupSourceMask=EcuMWakeupSource
        EcuMWakeupSource: EcuMWakeupSourceId=(unset), EcuMWakeupSourcePolling=0, EcuMResetReasonRef=(unset)
      EcuMFixedConfiguration: EcuMNvramReadallTimeout=10.0, EcuMNvramWriteallTimeout=10.0, EcuMRunMinimumDuration=10.0, EcuMNormalMcuModeRef=NORMAL
        EcuMFixedUserConfig: EcuMFixedUser=(unset)
    EcuMGeneral: EcuMDevErrorDetect=0, EcuMIncludeDem=0, EcuMIncludeDet=0, EcuMMainFunctionPeriod=0.2, EcuMVersionInfoApi=0
    EcuMFixedGeneral: EcuMIncludeComM=(unset), EcuMIncludeNvM=(unset), EcuMIncludeNvramMgr=(unset), EcuMTTIIEnabled=(unset), EcuMTTIIWakeupSourceRef=(unset)
