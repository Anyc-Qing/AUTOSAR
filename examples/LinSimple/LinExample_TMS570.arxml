AUTOSAR XML (schema 4-0-1)
package /LinExample_TMS570
  ecuc value collection TMS570: ecuc-values=[LinIf, EcuC, LinSM, ComM, PduR, Os, Det, Com, EcuM, Port, LinExample_TMS570/Lin, LinExample_TMS570/Mcu]
  module config Lin: implementation-config-variant=VARIANT-PRE-COMPILE, module-description=Lin
    LinGeneral: LinDevErrorDetect=1, LinIndex=, LinTimeoutDuration=, LinVersionInfoApi=0
    LinGlobalConfig
      LinChannel1 (LinChannel): LinChannelId=, LinChannelWakeupSupport=, ArcUartChannel=1, LinChannelBaudRate=19200, LinClockRef=(unset)
  module config Mcu: implementation-config-variant=VARIANT-PRE-COMPILE, module-description=Mcu
    McuGeneralConfiguration: McuDevErrorDetect=1, McuGetRamStateApi=1, McuInitClock=1, McuNoPll=0, McuPerformResetApi=0, McuVersionInfoApi=1
    McuModuleConfiguration: McuClockSrcFailureNotification=DISABLED, McuNumberOfMcuModes=(unset), McuRamSectors=(unset), ArcDefaultClockRef=McuClockSettingConfig
      McuClockSettingConfig: McuClockSettingId=(unset)
        McuClock (McuClockReferencePoint): McuClockReferencePointFrequency=16000000, McuClockReferencePointRefClkDiv=6
        PLLSettings: NF=135, ODPLL=2, R=1
      3 x McuModeSettingConf, all with McuMode=(unset):
        NORMAL
        RUN
        TMS570_mode
    McuPublishedInformation
      McuResetReasonConf: McuResetReason=(unset)
  module config Port: implementation-config-variant=VARIANT-PRE-COMPILE, module-description=Port
    PortConfigSet
      PortContainer: PortNumberOfPortPins=13
        13 x PortPin, all with PortPinDirectionChangeable=0, PortPinLevelValue=PORT_PIN_LEVEL_LOW, PortPinModeChangeable=0:
          GIOA_2: PortPinDirection=PORT_PIN_IN, PortPinId=9, PortPinInitialMode=PORT_PIN_MODE_DIO, PortPinMode=PORT_PIN_MODE_DIO, ArcPortPinPull=PORT_PIN_PULL_NONE, ArcPortPinSlewRate=, ArcPortPinOpenDrainEnable=0, ArcPortPadId=C1, ArcPortSignalName=GIOA_2
          GIOA_3: PortPinDirection=PORT_PIN_IN, PortPinId=203, PortPinInitialMode=PORT_PIN_MODE_DIO, PortPinMode=PORT_PIN_MODE_DIO, ArcPortPinPull=PORT_PIN_PULL_NONE, ArcPortPinSlewRate=, ArcPortPinOpenDrainEnable=0, ArcPortPadId=(unset), ArcPortSignalName=GIOA_3
          MIBSPI1SIMO_1: PortPinDirection=PORT_PIN_OUT, PortPinId=106, PortPinInitialMode=PORT_PIN_MODE_SPI, PortPinMode=PORT_PIN_MODE_SPI, ArcPortPinPull=, ArcPortPinSlewRate=, ArcPortPinOpenDrainEnable=0, ArcPortPadId=A5, ArcPortSignalName=MIBSPI1SIMO_1
          MIBSPI1SOMI_1: PortPinDirection=PORT_PIN_IN, PortPinId=105, PortPinInitialMode=PORT_PIN_MODE_SPI, PortPinMode=PORT_PIN_MODE_SPI, ArcPortPinPull=, ArcPortPinSlewRate=, ArcPortPinOpenDrainEnable=0, ArcPortPadId=A5, ArcPortSignalName=MIBSPI1SOMI_1
          MIBSPI1NCS_1: PortPinDirection=PORT_PIN_OUT, PortPinId=130, PortPinInitialMode=PORT_PIN_MODE_SPI, PortPinMode=PORT_PIN_MODE_SPI, ArcPortPinPull=, ArcPortPinSlewRate=, ArcPortPinOpenDrainEnable=0, ArcPortPadId=A5, ArcPortSignalName=MIBSPI1NCS_1
          MIBSPI5NCS_0: PortPinDirection=PORT_PIN_OUT, PortPinId=32, PortPinInitialMode=PORT_PIN_MODE_DIO_SPI, PortPinMode=PORT_PIN_MODE_SPI, ArcPortPinPull=, ArcPortPinSlewRate=, ArcPortPinOpenDrainEnable=0, ArcPortPadId=A5, ArcPortSignalName=MIBSPI5NCS_0
          MIBSPI5SIMO_1: PortPinDirection=PORT_PIN_OUT, PortPinId=236, PortPinInitialMode=PORT_PIN_MODE_DIO_SPI, PortPinMode=PORT_PIN_MODE_DIO_SPI, ArcPortPinPull=, ArcPortPinSlewRate=, ArcPortPinOpenDrainEnable=0, ArcPortPadId=A5, ArcPortSignalName=MIBSPI5SIMO_1
          MIBSPI5SIMO_2: PortPinDirection=PORT_PIN_IN, PortPinId=237, PortPinInitialMode=PORT_PIN_MODE_DIO_SPI, PortPinMode=PORT_PIN_MODE_DIO_SPI, ArcPortPinPull=, ArcPortPinSlewRate=, ArcPortPinOpenDrainEnable=0, ArcPortPadId=A5, ArcPortSignalName=MIBSPI5SIMO_2
          N2HET1_07: PortPinDirection=PORT_PIN_OUT, PortPinId=33, PortPinInitialMode=PORT_PIN_MODE_DIO, PortPinMode=PORT_PIN_MODE_NHET, ArcPortPinPull=, ArcPortPinSlewRate=, ArcPortPinOpenDrainEnable=false, ArcPortPadId=T1, ArcPortSignalName=N2HET1_07
          GIOB_2: PortPinDirection=PORT_PIN_IN, PortPinId=55, PortPinInitialMode=PORT_PIN_MODE_DIO, PortPinMode=PORT_PIN_MODE_DIO, ArcPortPinPull=PORT_PIN_PULL_NONE, ArcPortPinSlewRate=, ArcPortPinOpenDrainEnable=false, ArcPortPadId=V10, ArcPortSignalName=GIOB_2
          ETPWM1A: PortPinDirection=PORT_PIN_OUT, PortPinId=14, PortPinInitialMode=PORT_PIN_MODE_PWM, PortPinMode=PORT_PIN_MODE_PWM, ArcPortPinPull=PORT_PIN_PULL_NONE, ArcPortPinSlewRate=PORT_PIN_SLEW_RATE_MED, ArcPortPinOpenDrainEnable=false, ArcPortPadId=B5, ArcPortSignalName=ETPWM1A
          ETPWM2A: PortPinDirection=PORT_PIN_OUT, PortPinId=22, PortPinInitialMode=PORT_PIN_MODE_PWM, PortPinMode=PORT_PIN_MODE_PWM, ArcPortPinPull=PORT_PIN_PULL_NONE, ArcPortPinSlewRate=PORT_PIN_SLEW_RATE_MED, ArcPortPinOpenDrainEnable=false, ArcPortPadId=M1, ArcPortSignalName=ETPWM2A
          GIOA_6_EPWMA1_IN: PortPinDirection=PORT_PIN_IN, PortPinId=16, PortPinInitialMode=PORT_PIN_MODE_DIO, PortPinMode=PORT_PIN_MODE_DIO, ArcPortPinPull=PORT_PIN_PULL_NONE, ArcPortPinSlewRate=PORT_PIN_SLEW_RATE_MED, ArcPortPinOpenDrainEnable=false, ArcPortPadId=H3, ArcPortSignalName=GIOA_6
    PortGeneral: PortDevErrorDetect=1, PortSetPinDirectionApi=1, PortSetPinModeApi=0, PortVersionInfoApi=1
  module config Lin: implementation-config-variant=VARIANT-PRE-COMPILE, module-description=Lin
    LinGeneral: LinDevErrorDetect=1, LinIndex=, LinTimeoutDuration=, LinVersionInfoApi=1
    LinGlobalConfig
      LinChannel1 (LinChannel): LinChannelId=0, LinChannelWakeupSupport=, ArcUartChannel=1, LinChannelBaudRate=19200, LinClockRef=(unset)
  module config Mcu: implementation-config-variant=VARIANT-PRE-COMPILE, module-description=Mcu
    McuGeneralConfiguration: McuDevErrorDetect=1, McuGetRamStateApi=1, McuInitClock=1, McuNoPll=0, McuPerformResetApi=0, McuVersionInfoApi=1
    McuModuleConfiguration:
      McuClockSrcFailureNotification = DISABLED
      McuNumberOfMcuModes = (unset)
      McuRamSectors = (unset)
      ArcDefaultClockRef = McuModuleConfiguration/McuClockSettingConfig
      McuClockSettingConfig: McuClockSettingId=(unset)
        McuClock (McuClockReferencePoint): McuClockReferencePointFrequency=16000000, McuClockReferencePointRefClkDiv=6
        PLLSettings: NF=135, ODPLL=2, R=1
      3 x McuModeSettingConf, all with McuMode=(unset):
        NORMAL
        RUN
        TMS570_mode
    McuPublishedInformation
      McuResetReasonConf: McuResetReason=(unset)
