AUTOSAR XML (schema 4-3-0)
package /DoIPSimplePkg
  ecuc value collection DoIPSimpleEcuc: ecuc-values=[EcuM, Mcu, Eth, Port, DoIP, Dcm, CddEthTrcv, ComM, Det, EcuC, EthIf, EthSM, Os, PduR, SoAd, TcpIp]
  module config EcuM: implementation-config-variant=VARIANT-PRE-COMPILE, module-description=EcuM
    EcuMConfiguration
      EcuMCommonConfiguration: EcuMConfigConsistencyHash=(unset), EcuMDefaultAppMode=(unset), EcuMOSResource=(unset)
        EcuMDefaultShutdownTarget: EcuMDefaultState=EcuMStateOff
        EcuMSleepMode: EcuMSleepModeId=(unset), EcuMSleepModeSuspend=(unset), EcuMSleepModeMcuModeRef=SLEEP, EcuMWakeupSourceMask=EcuMWakeupSource
        EcuMWakeupSource: EcuMWakeupSourceId=(unset), EcuMWakeupSourcePolling=0, EcuMResetReasonRef=(unset)
      EcuMFixedConfiguration:
        EcuMNvramReadallTimeout = 10.0
        EcuMNvramWriteallTimeout = 10.0
        EcuMRunMinimumDuration = 10.0
        EcuMNormalMcuModeRef = RUN
        EcuMComMCommunicationAllowedList = EthChnl
        EthernetUser (EcuMFixedUserConfig): EcuMFixedUser=(unset)
    EcuMGeneral: EcuMDevErrorDetect=0, EcuMIncludeDem=0, EcuMIncludeDet=0, EcuMMainFunctionPeriod=0.01, EcuMVersionInfoApi=0
  module config Mcu: implementation-config-variant=VARIANT-PRE-COMPILE, module-description=Mcu
    McuGeneralConfiguration: McuDevErrorDetect=true, McuGetRamStateApi=false, McuInitClock=true, McuNoPll=false, McuPerformResetApi=true, McuVersionInfoApi=false
    McuModuleConfiguration: McuClockSrcFailureNotification=DISABLED, McuNumberOfMcuModes=, McuRamSectors=, ArcDefaultClockRef=McuClockSettingConfig
      McuClockSettingConfig: McuClockSettingId=
        McuClockReferencePoint: Frequency=, McuClockReferencePointFrequency=40000000.0
        ArcPLLSettings: PLLDV_PREDIV=1, PLLDV_MFD=16, PLLDV_RFDPHI=1, PLLDV_RFDPHI1=2, PLLFM_MODPRD=0, PLLFM_INCSTP=0, PLLFM_MODEN=false
      3 x McuModeSettingConf, all with McuMode=:
        NORMAL
        RUN
        SLEEP
    McuPublishedInformation
      McuResetReasonConf: McuResetReason=
  module config Eth: implementation-config-variant=VARIANT-PRE-COMPILE, module-description=Eth
    EthConfigSet
      EthCtrlConfig:
        EthCtrlEnableMii = 1
        EthCtrlEnableRxInterrupt = 1
        EthCtrlEnableTxInterrupt = 1
        EthCtrlIdx = 0
        EthCtrlRxBufLenByte = 1522
        EthCtrlTxBufLenByte = 1522
        EthRxBufTotal = 25
        EthTxBufTotal = 2
        ArcEthControllerHwMIIMode = MII
        ArcEthControllerHwSpeed = MBPS_100
        ArcEthControllerHwUnit = HWUNIT_0
        ArcEthCtrlDiscardRxFCS = true
        ArcEthCtrlEnableRxChecksumOffload = true
        ArcEthCtrlEnableTxChecksumOffload = true
        ArcEthCtrlRxDMAChannel = 
        ArcEthCtrlRxQueueValue = 
        ArcEthCtrlTxDMAChannel = 
        ArcEthCtrlTxQueueValue = 
        ArcEthFifoPrio = 
        ArcEthCtrlEnableCircDesc = 
        EthCtrlPhyAddress = 00-00-00-00-00-02
    EthGeneral:
      EthDevErrorDetect = 1
      EthGetDropCountApi = 
      EthGetEtherStatsApi = 
      EthGlobalTimeSupport = 
      EthIndex = 
      EthMainFunctionPeriod = 0.1
      EthMaxCtrlsSupported = 
      EthUpdatePhysAddrFilter = false
      EthVersionInfoApi = 1
      ArcEthCpu1xclkValue = 
      ArcEthSoftReset = false
  module config Port: implementation-config-variant=VARIANT-PRE-COMPILE, module-description=Port
    PortConfigSet
      4 x PortContainer, all with PortNumberOfPortPins=:
        CAN
          4 x PortPin, all with PortPinDirectionChangeable=0, PortPinInitialMode=PORT_PIN_MODE_CAN, PortPinLevelValue=PORT_PIN_LEVEL_LOW, PortPinMode=PORT_PIN_MODE_CAN, PortPinModeChangeable=0, ArcPortPinPull=PORT_PIN_PULL_NONE, ArcPortPinSlewRate=PORT_PIN_SLEW_RATE_MED, ArcPortPinOpenDrainEnable=false:
            CAN0TX: PortPinDirection=PORT_PIN_OUT, PortPinId=13
            CAN0RX: PortPinDirection=PORT_PIN_IN, PortPinId=15
            CAN1_RXD: PortPinDirection=PORT_PIN_IN, PortPinId=35
            CAN1_TXD: PortPinDirection=PORT_PIN_OUT, PortPinId=42
        GPIO
          GPIO0 (PortPin):
            PortPinDirection = PORT_PIN_OUT
            PortPinDirectionChangeable = 1
            PortPinId = 0
            PortPinInitialMode = PORT_PIN_MODE_DIO
            PortPinLevelValue = PORT_PIN_LEVEL_LOW
            PortPinMode = 
            PortPinModeChangeable = 1
            ArcPortPinPull = PORT_PIN_PULL_NONE
            ArcPortPinSlewRate = PORT_PIN_SLEW_RATE_MIN
            ArcPortPinOpenDrainEnable = false
          GPIO1 (PortPin):
            PortPinDirection = PORT_PIN_IN
            PortPinDirectionChangeable = 1
            PortPinId = 1
            PortPinInitialMode = PORT_PIN_MODE_DIO
            PortPinLevelValue = PORT_PIN_LEVEL_LOW
            PortPinMode = PORT_PIN_MODE_DIO
            PortPinModeChangeable = 1
            ArcPortPinPull = PORT_PIN_PULL_NONE
            ArcPortPinSlewRate = PORT_PIN_SLEW_RATE_MIN
            ArcPortPinOpenDrainEnable = false
        ETH
          18 x PortPin, all with PortPinLevelValue=PORT_PIN_LEVEL_LOW, PortPinMode=PORT_PIN_MODE_ETH, PortPinModeChangeable=0, ArcPortPinPull=PORT_PIN_PULL_NONE, ArcPortPinSlewRate=PORT_PIN_SLEW_RATE_MAX, ArcPortPinOpenDrainEnable=false:
            ENET0_RXD_1: PortPinDirection=PORT_PIN_IN, PortPinDirectionChangeable=0, PortPinId=8, PortPinInitialMode=PORT_PIN_MODE_ETH
            ENET0_RXD_0: PortPinDirection=PORT_PIN_IN, PortPinDirectionChangeable=0, PortPinId=9, PortPinInitialMode=PORT_PIN_MODE_ETH
            ENET0_RXD_2: PortPinDirection=PORT_PIN_IN, PortPinDirectionChangeable=0, PortPinId=7, PortPinInitialMode=PORT_PIN_MODE_ETH
            ENET0_RXD_3: PortPinDirection=PORT_PIN_IN, PortPinDirectionChangeable=0, PortPinId=77, PortPinInitialMode=PORT_PIN_MODE_ETH
            ENET0_RX_CLK: PortPinDirection=PORT_PIN_IN, PortPinDirectionChangeable=0, PortPinId=3, PortPinInitialMode=PORT_PIN_MODE_ETH
            ENET0_RX_ER: PortPinDirection=PORT_PIN_IN, PortPinDirectionChangeable=0, PortPinId=11, PortPinInitialMode=PORT_PIN_MODE_ETH
            ENET0_RX_DV: PortPinDirection=PORT_PIN_IN, PortPinDirectionChangeable=0, PortPinId=95, PortPinInitialMode=PORT_PIN_MODE_ETH
            ENET0_COL: PortPinDirection=PORT_PIN_IN, PortPinDirectionChangeable=0, PortPinId=10, PortPinInitialMode=PORT_PIN_MODE_ETH
            ENET0_CRS: PortPinDirection=PORT_PIN_IN, PortPinDirectionChangeable=0, PortPinId=76, PortPinInitialMode=PORT_PIN_MODE_ETH
            ENET0_TX_CLK: PortPinDirection=PORT_PIN_IN, PortPinDirectionChangeable=0, PortPinId=97, PortPinInitialMode=PORT_PIN_MODE_OTHER0
            ENET0_MDIO: PortPinDirection=PORT_PIN_IN, PortPinDirectionChangeable=1, PortPinId=94, PortPinInitialMode=PORT_PIN_MODE_OTHER1
            ENET0_MDC: PortPinDirection=PORT_PIN_OUT, PortPinDirectionChangeable=0, PortPinId=96, PortPinInitialMode=PORT_PIN_MODE_ETH
            ENET0_TXD_0: PortPinDirection=PORT_PIN_OUT, PortPinDirectionChangeable=0, PortPinId=113, PortPinInitialMode=PORT_PIN_MODE_ETH
            ENET0_TXD_1: PortPinDirection=PORT_PIN_OUT, PortPinDirectionChangeable=0, PortPinId=112, PortPinInitialMode=PORT_PIN_MODE_ETH
            ENET0_TXD_2: PortPinDirection=PORT_PIN_OUT, PortPinDirectionChangeable=0, PortPinId=108, PortPinInitialMode=PORT_PIN_MODE_ETH
            ENET0_TXD_3: PortPinDirection=PORT_PIN_OUT, PortPinDirectionChangeable=0, PortPinId=109, PortPinInitialMode=PORT_PIN_MODE_ETH
            ENET0_TX_EN: PortPinDirection=PORT_PIN_OUT, PortPinDirectionChangeable=0, PortPinId=114, PortPinInitialMode=PORT_PIN_MODE_ETH
            ENET0_MDIO_OUT: PortPinDirection=PORT_PIN_OUT, PortPinDirectionChangeable=1, PortPinId=94, PortPinInitialMode=PORT_PIN_MODE_ETH
        LED
          LED1 (PortPin):
            PortPinDirection = PORT_PIN_OUT
            PortPinDirectionChangeable = 0
            PortPinId = 98
            PortPinInitialMode = PORT_PIN_MODE_DIO
            PortPinLevelValue = PORT_PIN_LEVEL_HIGH
            PortPinMode = 
            PortPinModeChangeable = 0
            ArcPortPinPull = PORT_PIN_PULL_DOWN
            ArcPortPinSlewRate = PORT_PIN_SLEW_RATE_MIN
            ArcPortPinOpenDrainEnable = false
          LED2 (PortPin):
            PortPinDirection = PORT_PIN_OUT
            PortPinDirectionChangeable = 0
            PortPinId = 99
            PortPinInitialMode = PORT_PIN_MODE_DIO
            PortPinLevelValue = PORT_PIN_LEVEL_LOW
            PortPinMode = 
            PortPinModeChangeable = 0
            ArcPortPinPull = PORT_PIN_PULL_DOWN
            ArcPortPinSlewRate = PORT_PIN_SLEW_RATE_MIN
            ArcPortPinOpenDrainEnable = false
    PortGeneral: PortDevErrorDetect=true, PortSetPinDirectionApi=true, PortSetPinModeApi=true, PortVersionInfoApi=true
  module config DoIP: implementation-config-variant=VARIANT-PRE-COMPILE, module-description=DoIP
    DoIPConfigSet: DoIPLogicalAddress=5523, DoIPEid=44444444, DoIPGid=55555555
      DoIPChannelFunc (DoIPChannel): DoIPChannelSARef=DoIPTester, DoIPChannelTARef=DoIPTargetAddressFunc
        DoIPPduRRxPduFunc (DoIPPduRRxPdu): DoIPPduRRxPduId=, DoIPPduRRxPduRef=DoIP_PduR_FuncRx
      DoIPConnections
        DoIPTargetAddressFunc (DoIPTargetAddress): DoIPTargetAddressValue=8191
        DoIPTcpConnection
          DoIPSoAdRxPdu: DoIPSoAdRxPduId=, DoIPSoAdRxPduRef=DoIP_SoAd_TCP_Rx
          DoIPSoAdTxPdu: DoIPSoAdTxPduId=, DoIPSoAdTxPduRef=DoIP_SoAd_TCP_Tx
        DoIPUdpConnection
          DoIPSoAdRxPdu: DoIPSoAdRxPduId=, DoIPSoAdRxPduRef=DoIP_SoAd_UDP_Rx
          DoIPSoAdTxPdu: DoIPSoAdTxPduId=, DoIPSoAdTxPduRef=DoIP_SoAd_UDP_Tx
        DoIPTargetAddressPhy (DoIPTargetAddress): DoIPTargetAddressValue=4609
      DoIPTester: DoIPNumByteDiagAckNack=20, DoIPTesterSA=3712, DoIPRoutingActivationRef=DoIPRoutingActivation
      DoIPChannelPhy (DoIPChannel): DoIPChannelSARef=DoIPTester, DoIPChannelTARef=DoIPTargetAddressPhy
        DoIPPduRRxPduPhy (DoIPPduRRxPdu): DoIPPduRRxPduId=, DoIPPduRRxPduRef=DoIP_PduR_PhyRx
        DoIPPduRTxPduPhy (DoIPPduRTxPdu): DoIPPduRTxPduId=, DoIPPduType=DOIP_TPPDU, DoIPPduRTxPduRef=DoIP_PduR_PhyTx
      DoIPRoutingActivation: DoIPRoutingActivationNumber=0, DoIPTargetAddressRef=DoIPTargetAddressPhy, DoIPTargetAddressRef=DoIPTargetAddressFunc
    DoIPGeneral:
      DoIPAliveCheckResponseTimeout = 1000
      DoIPDevelopmentErrorDetect = 1
      DoIPDhcpOptionVinUse = 0
      DoIPEntityStatusMaxByteFieldUse = 0
      DoIPGIDInvalidityPattern = 11
      DoIPGeneralInactivityTime = 1000
      DoIPHostNameSizeMax = 66
      DoIPInitialInactivityTime = 1000
      DoIPInitialVehicleAnnouncementTime = 1
      DoIPMainFunctionPeriod = 0.005
      DoIPMaxRequestBytes = 20
      DoIPMaxTesterConnections = 1
      DoIPMaxUDPRequestPerMessage = 1
      DoIPNodeType = DOIP_NODE
      DoIPUseEIDasGID = 1
      DoIPUseMacAddressForIdentification = 1
      DoIPUseVehicleIdentificationSyncStatus = 0
      DoIPVehicleAnnouncementInterval = 1
      DoIPVehicleAnnouncementRepetition = 5
      DoIPVersionInfoApi = 1
      DoIPVinGidMaster = 0
      DoIPVinInvalidityPattern = 11
      DoIPPowerModeCallback
  module config Dcm: implementation-config-variant=VARIANT-PRE-COMPILE, module-description=Dcm
    DcmConfigSet
      DcmDsd
        DcmDsdServiceTable_UDS (DcmDsdServiceTable): DcmDsdSidTabId=0
          UDS_0x22_ReadDataByIdentifier (DcmDsdService):
            DcmDsdSidTabServiceId = 34
            DcmDsdSidTabSubfuncAvail = false
            DcmDsdSidTabSecurityLevelRef = SecurityLevel_0
            DcmDsdSidTabSessionLevelRef = Default_Session
          UDS_0x10_DiagnosticSessionControl (DcmDsdService): DcmDsdSidTabServiceId=16, DcmDsdSidTabSubfuncAvail=true, DcmDsdSidTabSessionLevelRef=Default_Session
      DcmDsl
        DcmDslBuffer: DcmDslBufferSize=255
        DcmDslCallbackDCMRequestService
        DcmDslDiagResp: DcmDslDiagRespMaxNumRespPend=10, DcmDslDiagRespOnSecondDeclinedRequest=
        DcmDslProtocol
          DcmDslProtocolRow_UDS (DcmDslProtocolRow):
            DcmDslProtocolEndiannessConvEnabled = 
            DcmDslProtocolID = DCM_UDS_ON_CAN
            DcmDslProtocolIsParallelExecutab = 
            DcmDslProtocolPreemptTimeout = 1.0
            DcmDslProtocolPriority = 1
            DcmSendRespPendOnTransToBoot = true
            DcmTimStrP2ServerAdjust = 0.01
            DcmTimStrP2StarServerAdjust = 0.1
            DcmDslProtocolTransType = TYPE1
            DcmDslProtocolRxBufferID = DcmDslBuffer
            DcmDslProtocolSIDTable = DcmDsdServiceTable_UDS
            DcmDslProtocolTxBufferID = DcmDslBuffer
            DcmDslConnection
              DcmDslMainConnection: DcmDslProtocolRxTesterSourceAddr=0
                FunctionalRx (DcmDslProtocolRx):
                  DcmDslProtocolRxAddrType = DCM_FUNCTIONAL_TYPE
                  DcmDslProtocolRxChannelId = 
                  DcmDslProtocolRxPduId = 
                  DcmDslProtocolRxPduRef = Dcm_RxFunc
                  DcmDslProtocolRxComMChannelRef = EthChnl
                PhysicalTx (DcmDslProtocolTx): DcmDslTxConfirmationPduId=, DcmDslProtocolTxPduRef=Dcm_Tx
                PhysicalRx (DcmDslProtocolRx):
                  DcmDslProtocolRxAddrType = DCM_PHYSICAL_TYPE
                  DcmDslProtocolRxChannelId = 
                  DcmDslProtocolRxPduId = 
                  DcmDslProtocolRxPduRef = Dcm_Rx
                  DcmDslProtocolRxComMChannelRef = EthChnl
      DcmGeneral:
        DcmDevErrorDetect = false
        DcmRequestManufacturerNotificationEnabled = true
        DcmRequestSupplierNotificationEnabled = 
        DcmRespondAllRequest = true
        DcmTaskTime = 0.005
        DcmVersionInfoApi = false
        ArcDcmMaxDynamicIdSources = 10
        ArcDcmSplitTaskConceptEnable = false
        ArcDcmPeriodicTransmission:
          ArcDcmPeriodDataLimitNumber = 10
          ArcDcmPeriodicTransmissionFast = 0.1
          ArcDcmPeriodicTransmissionMedium = 10.0
          ArcDcmPeriodicTransmissionSlow = 30.0
          ArcDcmSynchPeriodicDidSampling = false
      DcmPageBufferCfg: DcmPagedBufferEnabled=
      DcmDsp
        DcmDspSecurity
          SecurityLevel_0 (DcmDspSecurityRow):
            DcmDspSecurityDelayTime = 10
            DcmDspSecurityDelayTimeOnBoot = 0
            DcmDspSecurityKeySize = 4
            DcmDspSecurityLevel = 0
            DcmDspSecurityNumAttDelay = 5
            DcmDspSecuritySeedSize = 4
        DcmDspSession
          Default_Session (DcmDspSessionRow): DcmDspSessionForBoot=DCM_NO_BOOT, DcmDspSessionLevel=1, DcmDspSessionP2ServerMax=0.05, DcmDspSessionP2StarServerMax=5.0
          Programming_Session (DcmDspSessionRow): DcmDspSessionForBoot=DCM_SYS_BOOT_RESPAPP, DcmDspSessionLevel=2, DcmDspSessionP2ServerMax=0.05, DcmDspSessionP2StarServerMax=5.0
        DID_0xE103_Data (DcmDspData):
          DcmDspDataSize = 8
          DcmDspDataUsePort = USE_DATA_SYNCH_FNC
          DcmDspDataConditionCheckReadFnc = DID_0xE103_ConditionCheck
          DcmDspDataReadFnc = DID_0xE103_Read
          DcmDspDataInfoRef = DcmDspDataInfo
        DcmDspDataInfo: DcmDspDataFixedLength=true
        DID_0xE103 (DcmDspDid): DcmDspDidIdentifier=57603, DcmDspDidUsed=true, DcmDspDidInfoRef=DcmDspDidInfoStaticReadOnly
          DcmDspDidSignal: DcmDspDidDataPos=0, DcmDspDidDataRef=DID_0xE103_Data
        DcmDspDidInfoStaticReadOnly (DcmDspDidInfo): DcmDspDidDynamicallyDefined=false
          DcmDspDidAccess
            DcmDspDidRead: DcmDspDidReadSecurityLevelRef=SecurityLevel_0, DcmDspDidReadSessionRef=Default_Session
  module config CddEthTrcv: implementation-config-variant=VARIANT-PRE-COMPILE, module-description=CddEthTrcv
    EthTrcvConfigSet
    EthTrcvGeneral: EthTrcvAutoNegotiate=false, EthTrcvAutoFindAddress=true
  module config ComM: implementation-config-variant=VARIANT-PRE-COMPILE, module-description=ComM
    ComMConfigSet
      EthChnl (ComMChannel):
        ComMBusType = COMM_BUS_TYPE_ETH
        ComMChannelId = 
        ComMFullCommRequestNotificationEnabled = false
        ComMGlobalNvmBlockDescriptor = false
        ComMMainFunctionPeriod = 0.01
        ComMNoCom = false
        ComMNoWakeup = false
        ComMNetworkManagement: ComMNmVariant=NONE, ComMPncNmRequest=false
        ComMUserPerChannel: ComMUserChannel=EthChnlUser
      EthChnlUser (ComMUser): ComMUserIdentifier=
    ComMGeneral:
      ComMNoCom = false
      ComMEcuGroupClassification = 3
      ComMModeLimitationEnabled = false
      ComMPncSupport = false
      ComMSynchronousWakeUp = true
      ComMTMinFullComModeDuration = 5.0
      ComMVersionInfoApi = false
      ComMWakeupInhibitionEnabled = false
      ComMDevErrorDetect = true
      ArcComMASRCompatibilityLessThan4_2 = true
  module config Det: implementation-config-variant=VARIANT-PRE-COMPILE, module-description=Det
    DetGeneral:
      DetVersionInfoApi = 0
      DetUseRamlog = 1
      DetEnableCallbacks = 0
      DetWrapRamlog = 1
      DetUseStdErr = 0
      DetDeInitAPI = 0
      DetNumberOfCallbacks = 5
      DetRamlogSize = 16
      DetUseSafetyMonitor = false
  module config EcuC: implementation-config-variant=VARIANT-PRE-COMPILE, module-description=EcuC
    EcucPduCollection: PduIdTypeEnum=UINT16, PduLengthTypeEnum=UINT16
      10 x Pdu:
        Dcm_Rx: PduLength=8
        Dcm_Tx: PduLength=8
        DoIP_PduR_PhyRx: PduLength=50
        DoIP_PduR_PhyTx: PduLength=50
        Dcm_RxFunc: PduLength=8
        DoIP_PduR_FuncRx: PduLength=50
        DoIP_SoAd_TCP_Rx: PduLength=50
        DoIP_SoAd_TCP_Tx: PduLength=50
        DoIP_SoAd_UDP_Rx: PduLength=50
        DoIP_SoAd_UDP_Tx: PduLength=50
  module config EthIf: implementation-config-variant=VARIANT-PRE-COMPILE, module-description=EthIf
    EthIfConfigSet
      EthIfController: EthIfCtrlIdx=, EthIfCtrlMtu=1500, EthIfMaxTxBufsTotal=2, EthIfEthCtrlRef=EthCtrlConfig
      EthIfFrameOwnerConfig1 (EthIfFrameOwnerConfig): EthIfFrameType=2048, EthIfOwner=, ArcEthIfRxIndication=EthIfRxIndicationConfig1
      EthIfRxIndicationConfig1 (EthIfRxIndicationConfig): EthIfRxIndicationFunction=TcpIp_RxIndication
      EthIfTrcvLinkStateChgConfig: EthIfTrcvLinkStateChgFunction=
      EthIfRxIndicationConfig2 (EthIfRxIndicationConfig): EthIfRxIndicationFunction=TcpIp_RxIndication
      EthIfFrameOwnerConfig2 (EthIfFrameOwnerConfig): EthIfFrameType=2054, EthIfOwner=, ArcEthIfRxIndication=EthIfRxIndicationConfig2
    EthIfGeneral:
      EthIfDevErrorDetect = 1
      EthIfEnableRxInterrupt = 1
      EthIfEnableTxInterrupt = 1
      EthIfGetBaudRate = 0
      EthIfGetCounterState = 0
      EthIfGlobalTimeSupport = 0
      EthIfMainFunctionPeriod = 0.01
      EthIfMaxTrcvsTotal = 1
      EthIfStartAutoNegotiation = 0
      EthIfTrcvLinkStateChgMainReload = 2
      EthIfVersionInfoApi = 1
      EthIfVersionInfoApiMacro = 1
      EthIfWakeUpSupport = false
      EthIfRxIndicationIterations = 1
      ArcEthIfMaxFrameOwnerConfig = 5
  module config EthSM: implementation-config-variant=VARIANT-PRE-COMPILE, module-description=EthSM
    EthSMGeneral: EthSMDevErrorDetect=1, EthSMMainFunctionPeriod=0.01, EthSMDummyMode=1, EthSMVersionInfoApi=1
    EthSMNetwork: EthSMConfirmationTimeout=1, EthSMComMNetworkHandleRef=EthChnl, EthSMEthIfControllerRef=EthIfController
  module config Os: implementation-config-variant=VARIANT-PRE-COMPILE, module-description=Os
    OsAppMode
    OsOS:
      OsScalabilityClass = SC1
      OsStackMonitoring = 1
      OsStatus = EXTENDED
      OsUseGetServiceId = 1
      OsUseParameterAccess = 1
      OsUseResScheduler = 1
      ArcOsTickFrequency = 1000
      ArcOsInterruptStackSize = 2048
      ArcOsIdleStackSize = 512
      ArcOsMaxIsr = 200
      ArcSafetyPlatform = false
      OsHooks: OsErrorHook=1, OsPostTaskHook=0, OsPreTaskHook=0, OsShutdownHook=1, OsStartupHook=1
      ArcOsDebug: OsTaskDebug=0, OsAlarmDebug=0, OsResourceDebug=0, OsScheduleTableDebug=0, OsEventDebug=0, OsDebugActivated=0
    OsApplication:
      OsTrusted = 1
      OsAppAlarmRef = OsAlarmLWIPMain
      OsAppCounterRef = OsCounter
      OsAppTaskRef = MainLWIPTask
      OsAppTaskRef = OsStartupTask
      OsAppTaskRef = tcpip_task
      OsAppAlarmRef = OsAlarmBswService
      OsAppTaskRef = OsBswServiceTask
      OsApplicationHooks: OsAppErrorHook=0, OsAppShutdownHook=0, OsAppStartupHook=0
    OsCounter:
      OsCounterMaxAllowedValue = 65535
      OsCounterMinCycle = 1
      OsCounterTicksPerBase = (unset)
      OsCounterType = OS_TICK
      OsCounterAccessingApplication = OsApplication
    OsAlarmLWIPMain (OsAlarm): OsAlarmCounterRef=OsCounter
      OsAlarmAction
        OsAlarmSetEvent: OsAlarmSetEventRef=LWIP_MAIN, OsAlarmSetEventTaskRef=MainLWIPTask
    MainLWIPTask (OsTask): OsTaskActivation=1, OsTaskPriority=4, OsTaskSchedule=FULL, ArcOsTaskStackSize=2048, OsTaskEventRef=LWIP_MAIN
      OsTaskAutostart: OsTaskAppModeRef=(unset)
    OsStartupTask (OsTask): OsTaskActivation=1, OsTaskPriority=4, OsTaskSchedule=FULL, ArcOsTaskStackSize=1024, OsTaskEventRef=START_TCPIP
      OsTaskAutostart: OsTaskAppModeRef=(unset)
    START_TCPIP (OsEvent)
    tcpip_task (OsTask): OsTaskActivation=1, OsTaskPriority=4, OsTaskSchedule=FULL, ArcOsTaskStackSize=4096, OsTaskEventRef=START_TCPIP
      OsTaskAutostart: OsTaskAppModeRef=(unset)
    LWIP_MAIN (OsEvent)
    OsBswServiceTask (OsTask): OsTaskActivation=1, OsTaskPriority=5, OsTaskSchedule=FULL, ArcOsTaskStackSize=2048, OsTaskEventRef=OsBwmMainEvent
    OsAlarmBswService (OsAlarm): OsAlarmCounterRef=OsCounter
      OsAlarmAction
        OsAlarmSetEvent: OsAlarmSetEventRef=OsBwmMainEvent, OsAlarmSetEventTaskRef=OsBswServiceTask
    ModeSwitchOsEvent (OsEvent)
    OsBwmMainEvent (OsEvent)
  module config PduR: implementation-config-variant=VARIANT-PRE-COMPILE, module-description=PduR
    PduRGeneral: PduRDevErrorDetect=1, PduRVersionInfoApi=0, PduRZeroCostOperation=0
    PduRRoutingTables: PduRConfigurationId=0, ArcPduRMaxRouteCount=30
      PduRRoutingTable: PduRIsMinimumRouting=0
        3 x PduRRoutingPath:
          PduRRoutingPathDoIPFuncRx
            PduRDestPdu: ArcOverridenDestModule=Dcm, PduRDestPduRef=Dcm_RxFunc
            PduRSrcPdu: PduRSourcePduHandleId=, ArcOverridenSrcModule=DoIPTp, PduRSrcPduRef=DoIP_PduR_FuncRx
          PduRRoutingPathDoIPPhyRx
            PduRDestPdu: ArcOverridenDestModule=Dcm, PduRDestPduRef=Dcm_Rx
            PduRSrcPdu: PduRSourcePduHandleId=, ArcOverridenSrcModule=DoIPTp, PduRSrcPduRef=DoIP_PduR_PhyRx
          PduRRoutingPathDoIPPhyTx
            PduRDestPdu: ArcOverridenDestModule=DoIPTp, PduRDestPduRef=DoIP_PduR_PhyTx
            PduRSrcPdu: PduRSourcePduHandleId=, ArcOverridenSrcModule=Dcm, PduRSrcPduRef=Dcm_Tx
    Dcm (PduRBswModules):
      PduRCancelReceive = false
      PduRCancelTransmit = 
      PduRChangeParameterRequestApi = 
      PduRCommunicationInterface = 
      PduRLowerModule = 0
      PduRRetransmission = 
      PduRTransportProtocol = 
      PduRTriggertransmit = 
      PduRTxConfirmation = 
      PduRUpperModule = 1
      PduRUseTag = 
      PduRBswModuleRef = (unset)
    DoIP (PduRBswModules):
      PduRCancelReceive = false
      PduRCancelTransmit = 
      PduRChangeParameterRequestApi = 
      PduRCommunicationInterface = 
      PduRLowerModule = 1
      PduRRetransmission = 
      PduRTransportProtocol = 
      PduRTriggertransmit = 
      PduRTxConfirmation = 
      PduRUpperModule = 0
      PduRUseTag = 
      PduRBswModuleRef = (unset)
  module config SoAd: implementation-config-variant=VARIANT-PRE-COMPILE, module-description=SoAd
    SoAdConfig
      SoAdSocketConnectionGroup_DoIP_TCP (SoAdSocketConnectionGroup):
        SoAdPduHeaderEnable = 0
        SoAdResourceManagementEnable = 0
        SoAdSocketAutomaticSoConSetup = false
        SoAdSocketIpAddrAssignmentChgNotification = false
        SoAdSocketLocalPort = 13400
        SoAdSocketMsgAcceptanceFilterEnabled = false
        SoAdSocketSoConModeChgNotification = true
        SoAdSocketLocalAddressRef = TcpIpLocalAddr
        SoAdSocketConnection_DoIP_TCP (SoAdSocketConnection): SoAdSocketId=
          SoAdSocketRemoteAddress: SoAdSocketRemoteIpAddress=198.18.32.1, SoAdSocketRemotePort=0
        SoAdSocketProtocol
          SoAdSocketTcp: SoAdSocketTcpImmediateTpTxConfirmation=false, SoAdSocketTcpInitiate=0, SoAdSocketTcpKeepAlive=false
      SoAdSocketRoute_DoIP_UDP (SoAdSocketRoute): SoAdRxSocketConnOrSocketConnBundleRef=SoAdSocketConnection_DoIP_UDP
        SoAdSocketRouteDest: SoAdRxUpperLayerType=IF, SoAdRxPduRef=DoIP_SoAd_UDP_Rx
      SoAdPduRoute_DoIP_UDP (SoAdPduRoute): SoAdTxPduId=, SoAdTxUpperLayerType=IF, SoAdTxPduRef=DoIP_SoAd_UDP_Tx
        SoAdPduRouteDest: SoAdTxUdpTriggerMode=TRIGGER_ALWAYS, SoAdTxSocketConnOrSocketConnBundleRef=SoAdSocketConnection_DoIP_UDP
      SoAdRoutingGroup: SoAdRoutingGroupId=, SoAdRoutingGroupIsEnabledAtInit=1, SoAdRoutingGroupTxTriggerable=false
      SoAdPduRoute_DoIP_TCP (SoAdPduRoute): SoAdTxPduId=, SoAdTxUpperLayerType=TP, SoAdTxPduRef=DoIP_SoAd_TCP_Tx
        SoAdPduRouteDest: SoAdTxSocketConnOrSocketConnBundleRef=SoAdSocketConnection_DoIP_TCP
      SoAdSocketRoute_DoIP_TCP (SoAdSocketRoute): SoAdRxSocketConnOrSocketConnBundleRef=SoAdSocketConnection_DoIP_TCP
        SoAdSocketRouteDest: SoAdRxUpperLayerType=TP, SoAdRxPduRef=DoIP_SoAd_TCP_Rx
      SoAdSocketConnectionGroup_DoIP_UDP (SoAdSocketConnectionGroup):
        SoAdPduHeaderEnable = 0
        SoAdResourceManagementEnable = 0
        SoAdSocketAutomaticSoConSetup = false
        SoAdSocketIpAddrAssignmentChgNotification = false
        SoAdSocketLocalPort = 13400
        SoAdSocketMsgAcceptanceFilterEnabled = false
        SoAdSocketSoConModeChgNotification = true
        SoAdSocketLocalAddressRef = TcpIpLocalAddr
        SoAdSocketConnection_DoIP_UDP (SoAdSocketConnection): SoAdSocketId=
          SoAdSocketRemoteAddress: SoAdSocketRemoteIpAddress=198.18.32.1, SoAdSocketRemotePort=0
        SoAdSocketProtocol
          SoAdSocketUdp: SoAdSocketUdpListenOnly=false, SoAdSocketUdpStrictHeaderLenCheckEnabled=false
    SoAdGeneral: SoAdDevErrorDetect=1, SoAdIPv6AddressEnabled=0, SoAdMainFunctionPeriod=0.005, SoAdRoutingGroupMax=10, SoAdSoConMax=10, SoAdVersionInfoApi=1
    DoIP (SoAdBswModules):
      SoAdIf = 1
      SoAdIfTriggerTransmit = false
      SoAdIfTxConfirmation = 1
      SoAdLocalIpAddrAssigmentChg = 0
      SoAdSoConModeChg = 1
      SoAdTp = 1
      SoAdUseCallerInfix = true
      SoAdUseTypeInfix = true
      SoAdBswModuleRef = DoIP
  module config TcpIp: implementation-config-variant=VARIANT-PRE-COMPILE, module-description=TcpIp
    TcpIpConfig
      TcpIpCtrl: TcpIpEthIfCtrlRef=EthIfController
        TcpIpIpVXCtrl
          TcpIpIpV4Ctrl:
            TcpIpDhcpConfigRef = (unset)
            TcpIpArpConfigRef = TcpIpArpConfig1
            TcpIpAutoIpConfigRef = (unset)
            TcpIpFragmentationConfigRef = TcpIpIpFragmentationConfig
        TcpIpCtrlDemEventParameterRefs
      TcpIpLocalAddr: TcpIpAddrId=1, TcpIpAddressType=TCPIP_UNICAST, TcpIpDomainType=TCPIP_AF_INET, TcpIpCtrlRef=TcpIpCtrl
        TcpIpStaticIpAddressConfig: TcpIpStaticIpAddress=198.18.34.1, TcpIpNetmask=16
        TcpIpAddrAssignment: TcpIpAssignmentMethod=TCPIP_STATIC, TcpIpAssignmentPriority=1, TcpIpAssignmentTrigger=TCPIP_AUTOMATIC
      TcpIpSocketOwnerConfig
        SoAd (TcpIpSocketOwner): TcpIpSocketOwnerUpperLayerType=SOAD
      TcpIpIpConfig
        TcpIpIpV4Config
          TcpIpArpConfig1 (TcpIpArpConfig): TcpIpArpNumGratuitousARPonStartup=, TcpIpArpPacketQueueEnabled=false, TcpIpArpTableEntryTimeout=, TcpIpArpTableSizeMax=10
          TcpIpArpConfig2 (TcpIpArpConfig): TcpIpArpNumGratuitousARPonStartup=, TcpIpArpPacketQueueEnabled=false, TcpIpArpTableEntryTimeout=, TcpIpArpTableSizeMax=5
          TcpIpIpFragmentationConfig: TcpIpIpFragmentationRxEnabled=true, ArcTcpIpIpMaxNofBufs=10, ArcTcpIpIpMaxReceiveBufferSize=1500, TcpIpIpReassTimeout=60
    TcpIpGeneral:
      TcpIpBufferMemory = 5200
      TcpIpDevErrorDetect = 1
      TcpIpDhcpServerEnabled = 
      TcpIpMainFunctionPeriod = 0.005
      TcpIpResetIpAssignmentApi = 1
      TcpIpScalabilityClass = SC1
      TcpIpTcpEnabled = 1
      TcpIpTcpSocketMax = 3
      TcpIpUdpEnabled = 1
      TcpIpUdpSocketMax = 3
      TcpIpVersionInfoApi = 1
      TcpIpIpV4General:
        TcpIpArpEnabled = 1
        TcpIpAutoIpEnabled = 0
        TcpIpDhcpClientEnabled = 0
        TcpIpIcmpEnabled = 1
        TcpIpIpV4Enabled = 1
        TcpIpLocalAddrIpv4EntriesMax = 10
        TcpIpPathMtuDiscoveryEnabled = 1
      TcpIpIpV6General:
        TcpIpDhcpV6ClientEnabled = 
        TcpIpIpV6Enabled = 
        TcpIpIpV6PathMtuDiscoveryEnabled = 
        TcpIpLocalAddrIpv6EntriesMax = 
        TcpIpNdpAddressResolutionUnrechabilityDetectionEnabled = 
        TcpIpNdpPrefixAndRouterDiscoveryEnabled = 
    ArcLwIpConfig:
      LwIpMempNumNetConn = 6
      LwIpPoolSize = 30
      LwIpMemSize = 20000
      LwIpMempNumPBuf = 30
      LwIpEthernetMacAddress = 00-00-00-00-00-02
      LwIpTrcvAddress = 0
      LwIpMaxMTU = 1500
      LwIpMaxMRU = 1500
      LwIpTcpWnd = 20000
      LwIpStats = 1
