AUTOSAR XML (schema 4-0-3)
package /EthernetSimple_jacinto6_Ecu
  ecuc value collection EthernetSimple_jacinto6_Ecu: ecu-extract=EthernetSimple, ecuc-values=[Det, PduR, EcuC, Com, Os, Xcp, Rte, BswM, ComM, EcuM, EthSM, Dio, Mcu, Port, Eth, IoHwAb, Dlt, CddPduR, SoAd, TcpIp, EthIf, CddEthTrcv]
  module config Dio: implementation-config-variant=VARIANT-PRE-COMPILE, module-description=Dio
    DioConfig
      LED (DioPort): DioPortId=(unset)
        LED1 (DioChannel): DioChannelId=174
        LED2 (DioChannel): DioChannelId=175
      PHY (DioPort): DioPortId=
        Ph_en (DioChannel): DioChannelId=61
    DioGeneral: DioDevErrorDetect=1, DioFlipChannelApi=(unset), DioVersionInfoApi=0
  module config Mcu: implementation-config-variant=VARIANT-PRE-COMPILE, module-description=Mcu
    McuGeneralConfiguration: McuDevErrorDetect=1, McuGetRamStateApi=(unset), McuInitClock=true, McuNoPll=true, McuPerformResetApi=0, McuVersionInfoApi=1
    McuModuleConfiguration: McuClockSrcFailureNotification=, McuNumberOfMcuModes=(unset), McuRamSectors=(unset), ArcDefaultClockRef=McuClockSettingConfig
      McuClockSettingConfig: McuClockSettingId=(unset)
        McuClockReferencePoint: McuClockReferencePointFrequency=212800000
        ArcClockSettings:
          Enable_Timer_{1..16} = false
          Enable_CAN0 = false
          Enable_CAN1 = false
      3 x McuModeSettingConf, all with McuMode=(unset):
        NORMAL
        SLEEP
        RUN
    McuPublishedInformation
      McuResetReasonConf: McuResetReason=(unset)
  module config Port: implementation-config-variant=VARIANT-PRE-COMPILE, module-description=Port
    PortConfigSet
      ETH (PortContainer): PortNumberOfPortPins=
        14 x PortPin, all with PortPinDirectionChangeable=, PortPinLevelValue=PORT_PIN_LEVEL_LOW, PortPinMode=, PortPinModeChangeable=, ArcPortPinSlewRate=PORT_PIN_SLEW_FAST:
          eth_mdio_u4: PortPinDirection=PORT_PIN_IN, PortPinId=451, PortPinInitialMode=PORT_PIN_MODE_ETH_MDIO, ArcPortPinPull=PORT_PIN_PULL_UP
          eth_mdc_v1: PortPinDirection=PORT_PIN_OUT, PortPinId=476, PortPinInitialMode=PORT_PIN_MODE_ETH_MDIO, ArcPortPinPull=PORT_PIN_PULL_UP
          eth_rgmii0_rxc_u5: PortPinDirection=PORT_PIN_IN, PortPinId=452, PortPinInitialMode=PORT_PIN_MODE_ETH_RGMII, ArcPortPinPull=PORT_PIN_PULL_NONE
          eth_rgmii0_rxctl_v5: PortPinDirection=PORT_PIN_IN, PortPinId=480, PortPinInitialMode=PORT_PIN_MODE_ETH_RGMII, ArcPortPinPull=PORT_PIN_PULL_NONE
          eth_rgmii0_rxd0_w2: PortPinDirection=PORT_PIN_IN, PortPinId=505, PortPinInitialMode=PORT_PIN_MODE_ETH_RGMII, ArcPortPinPull=PORT_PIN_PULL_NONE
          eth_rgmii0_rxd1_y2: PortPinDirection=PORT_PIN_IN, PortPinId=533, PortPinInitialMode=PORT_PIN_MODE_ETH_RGMII, ArcPortPinPull=PORT_PIN_PULL_NONE
          eth_rgmii0_rxd2_v3: PortPinDirection=PORT_PIN_IN, PortPinId=478, PortPinInitialMode=PORT_PIN_MODE_ETH_RGMII, ArcPortPinPull=PORT_PIN_PULL_NONE
          eth_rgmii0_rxd3_v4: PortPinDirection=PORT_PIN_IN, PortPinId=479, PortPinInitialMode=PORT_PIN_MODE_ETH_RGMII, ArcPortPinPull=PORT_PIN_PULL_NONE
          eth_rgmii0_txc_w9: PortPinDirection=PORT_PIN_OUT, PortPinId=512, PortPinInitialMode=PORT_PIN_MODE_ETH_RGMII, ArcPortPinPull=PORT_PIN_PULL_NONE
          eth_rgmii0_txctl_v9: PortPinDirection=PORT_PIN_OUT, PortPinId=484, PortPinInitialMode=PORT_PIN_MODE_ETH_RGMII, ArcPortPinPull=PORT_PIN_PULL_NONE
          eth_rgmii0_txd0_u6: PortPinDirection=PORT_PIN_OUT, PortPinId=453, PortPinInitialMode=PORT_PIN_MODE_ETH_RGMII, ArcPortPinPull=PORT_PIN_PULL_NONE
          eth_rgmii0_txd1_v6: PortPinDirection=PORT_PIN_OUT, PortPinId=481, PortPinInitialMode=PORT_PIN_MODE_ETH_RGMII, ArcPortPinPull=PORT_PIN_PULL_NONE
          eth_rgmii0_txd2_u7: PortPinDirection=PORT_PIN_OUT, PortPinId=454, PortPinInitialMode=PORT_PIN_MODE_ETH_RGMII, ArcPortPinPull=PORT_PIN_PULL_NONE
          eth_rgmii0_txd3_v7: PortPinDirection=PORT_PIN_OUT, PortPinId=482, PortPinInitialMode=PORT_PIN_MODE_ETH_RGMII, ArcPortPinPull=PORT_PIN_PULL_NONE
    PortGeneral: PortDevErrorDetect=1, PortSetPinDirectionApi=0, PortSetPinModeApi=0, PortVersionInfoApi=1, ArcPortGpioReset=true
  module config Eth: implementation-config-variant=VARIANT-PRE-COMPILE, module-description=Eth
    EthConfigSet
      EthCtrlConfig:
        EthCtrlEnableMii = 1
        EthCtrlEnableRxInterrupt = 1
        EthCtrlEnableTxInterrupt = 1
        EthCtrlIdx = 0
        EthCtrlRxBufLenByte = 1518
        EthCtrlTxBufLenByte = 1518
        EthRxBufTotal = 5
        EthTxBufTotal = 2
        EthCtrlPhyAddress = 00-00-00-00-00-02
        ArcEthControllerHwUnit = HWUNIT_0
        ArcEthControllerHwSpeed = MBPS_100
        ArcEthCtrlEnableRxChecksumOffload = true
        ArcEthCtrlEnableTxChecksumOffload = true
        ArcEthCtrlDiscardRxFCS = true
        ArcEthControllerHwMIIMode = RGMII
        ArcEthCtrlTxDMAChannel = 0
        ArcEthCtrlRxDMAChannel = 0
        ArcEthCtrlRxQueueValue = 1
        ArcEthCtrlTxQueueValue = 1
        ArcEthTCI = 0
        ArcEthFifoPrio = NORMAL_PRIO
        ArcEthCtrlEnableCircDesc = 0
    EthGeneral:
      EthDevErrorDetect = 1
      EthIndex = (unset)
      EthMaxCtrlsSupported = (unset)
      EthUpdatePhysAddrFilter = true
      EthVersionInfoApi = 1
      ArcEthCpu1xclkValue = 
      ArcEthSoftReset = true
      EthGetDropCountApi = 
      EthGetEtherStatsApi = 
      EthGlobalTimeSupport = 
      EthMainFunctionPeriod = 0.01
  module config IoHwAb: implementation-config-variant=VARIANT-PRE-COMPILE, module-description=IoHwAb
    ArcIoHwAbGeneral: ArcIoHwAbDevErrorDetect=1, ArcIoHwAbAnalogMaxVoltage=5.0, ArcIoHwAbUsePort=1, ArcIoHwCalibrationEnabled=0
    DigitalSignal_LED1 (ArcIoHwAbDigitalSignal):
      ArcIoHwAbDigitalDefaultValue = IOHWAB_HIGH
      ArcIoHwAbDigitalInverted = 0
      ArcIoHwAbDigitalMethod = IOHWAB_DIGITAL_WRITE
      ArcIoHwAbDigitalType = IOHWAB_DIO
      ArcIoHwAbDioChannelRef = LED1
    DigitalSignal_LED2 (ArcIoHwAbDigitalSignal):
      ArcIoHwAbDigitalDefaultValue = IOHWAB_HIGH
      ArcIoHwAbDigitalInverted = 0
      ArcIoHwAbDigitalMethod = IOHWAB_DIGITAL_WRITE
      ArcIoHwAbDigitalType = IOHWAB_DIO
      ArcIoHwAbDioChannelRef = LED2
    ArcIoHwAbScaling: ArcIoHwAbScalingOffset=0.0, ArcIoHwAbScalingScale=1.0, ArcIoHwAbScalingType=Volt
  module config EcuM: implementation-config-variant=VARIANT-PRE-COMPILE, module-description=EcuM
    EcuMConfiguration
      EcuMCommonConfiguration: EcuMConfigConsistencyHash=(unset), EcuMDefaultAppMode=(unset), EcuMOSResource=(unset)
        EcuMDefaultShutdownTarget: EcuMDefaultState=EcuMStateOff
        EcuMSleepMode: EcuMSleepModeId=(unset), EcuMSleepModeSuspend=(unset), EcuMSleepModeMcuModeRef=SLEEP, EcuMWakeupSourceMask=EcuMWakeupSource
        EcuMWakeupSource: EcuMWakeupSourceId=(unset), EcuMWakeupSourcePolling=0, EcuMResetReasonRef=(unset)
      EcuMFixedConfiguration:
        EcuMNvramReadallTimeout = 10.0
        EcuMNvramWriteallTimeout = 10.0
        EcuMRunMinimumDuration = 10.0
        EcuMNormalMcuModeRef = NORMAL
        EcuMComMCommunicationAllowedList = ComMChannel
        EthernetUser (EcuMFixedUserConfig): EcuMFixedUser=(unset)
    EcuMGeneral: EcuMDevErrorDetect=0, EcuMIncludeDem=0, EcuMIncludeDet=0, EcuMMainFunctionPeriod=0.01, EcuMVersionInfoApi=0
