AUTOSAR XML (schema 4-3-0)
package /BSWConfiguration_stm32f107
  ecuc value collection BSWConfiguration_stm32f107: ecu-extract=InteriorLightCANEcuExtract, ecuc-values=[Port, Dio, Mcu, Can, BswM, Com, ComM, PduR, Rte, CanSM, Det, EcuC, Os, EcuM, IoHwAb, CanIf, Crc]
  module config Port: implementation-config-variant=VARIANT-PRE-COMPILE, module-description=Port
    PortConfigSet: ArcPortPinRemap=GPIO_Remap2_CAN1
      3 x PortContainer, all with PortNumberOfPortPins=:
        LED
          PD7 (PortPin):
            PortPinDirection = PORT_PIN_OUT
            PortPinDirectionChangeable = 
            PortPinId = 55
            PortPinInitialMode = 
            PortPinLevelValue = PORT_PIN_LEVEL_LOW
            PortPinMode = 
            PortPinModeChangeable = 
            ArcPortPinGpioMode = GPIO_OUTPUT_PUSHPULL_CNF
            ArcPortPinSlewRate = PORT_PIN_SLEW_RATE_MED
          PD13 (PortPin):
            PortPinDirection = PORT_PIN_OUT
            PortPinDirectionChangeable = 
            PortPinId = 61
            PortPinInitialMode = 
            PortPinLevelValue = PORT_PIN_LEVEL_LOW
            PortPinMode = 
            PortPinModeChangeable = 
            ArcPortPinGpioMode = GPIO_OUTPUT_PUSHPULL_CNF
            ArcPortPinSlewRate = PORT_PIN_SLEW_RATE_MED
        SWITCH
          PE12 (PortPin):
            PortPinDirection = PORT_PIN_IN
            PortPinDirectionChangeable = 
            PortPinId = 76
            PortPinInitialMode = 
            PortPinLevelValue = PORT_PIN_LEVEL_LOW
            PortPinMode = 
            PortPinModeChangeable = 
            ArcPortPinGpioMode = GPIO_INPUT_PULLUP_CNF
            ArcPortPinSlewRate = PORT_PIN_SLEW_RATE_MED
          PE13 (PortPin):
            PortPinDirection = PORT_PIN_IN
            PortPinDirectionChangeable = 
            PortPinId = 77
            PortPinInitialMode = 
            PortPinLevelValue = PORT_PIN_LEVEL_LOW
            PortPinMode = 
            PortPinModeChangeable = 
            ArcPortPinGpioMode = GPIO_INPUT_PULLUP_CNF
            ArcPortPinSlewRate = PORT_PIN_SLEW_RATE_MED
        CAN
          4 x PortPin, all with PortPinLevelValue=PORT_PIN_LEVEL_LOW, PortPinMode=:
            PD0: PortPinDirection=PORT_PIN_IN, PortPinDirectionChangeable=, PortPinId=48, PortPinInitialMode=, PortPinModeChangeable=, ArcPortPinGpioMode=GPIO_INPUT_PULLUP_CNF, ArcPortPinSlewRate=PORT_PIN_SLEW_RATE_MIN
            PD1: PortPinDirection=PORT_PIN_OUT, PortPinDirectionChangeable=, PortPinId=49, PortPinInitialMode=, PortPinModeChangeable=, ArcPortPinGpioMode=GPIO_ALT_PUSHPULL_CNF, ArcPortPinSlewRate=PORT_PIN_SLEW_RATE_MED
            PortPin_B6: PortPinDirection=PORT_PIN_OUT, PortPinDirectionChangeable=00, PortPinId=2222, PortPinInitialMode=PORT_PIN_MODE_CAN, PortPinModeChangeable=00, ArcPortPinGpioMode=GPIO_ALT_PUSHPULL_CNF, ArcPortPinSlewRate=PORT_PIN_SLEW_RATE_MED
            PortPin_B5: PortPinDirection=PORT_PIN_IN, PortPinDirectionChangeable=0, PortPinId=21, PortPinInitialMode=PORT_PIN_MODE_CAN, PortPinModeChangeable=0, ArcPortPinGpioMode=GPIO_INPUT_PULLUP_CNF, ArcPortPinSlewRate=PORT_PIN_SLEW_RATE_MIN
    PortGeneral: PortDevErrorDetect=false, PortSetPinDirectionApi=false, PortSetPinModeApi=false, PortVersionInfoApi=false
  module config Dio: implementation-config-variant=VARIANT-PRE-COMPILE, module-description=Dio
    DioConfig
      D (DioPort): DioPortId=3
        LED1 (DioChannel): DioChannelId=55
        LED2 (DioChannel): DioChannelId=61
      E (DioPort): DioPortId=4
        D8 (DioChannel): DioChannelId=77
        D7 (DioChannel): DioChannelId=76
    DioGeneral: DioDevErrorDetect=false, DioFlipChannelApi=, DioVersionInfoApi=false
  module config Mcu: implementation-config-variant=VARIANT-PRE-COMPILE, module-description=Mcu
    McuGeneralConfiguration: McuDevErrorDetect=true, McuGetRamStateApi=false, McuInitClock=true, McuNoPll=false, McuPerformResetApi=false, McuVersionInfoApi=false
    McuModuleConfiguration: McuClockSrcFailureNotification=DISABLED, McuNumberOfMcuModes=, McuRamSectors=, ArcDefaultClockRef=McuClockSettingConfig
      McuClockSettingConfig: McuClockSettingId=, ArcAPB2ClocksEnable=GPIOD, ArcAPB1ClocksEnable=CAN1, ArcAPB2ClocksEnable=GPIOE, ArcAPB2ClocksEnable=AFIO
        McuClockReferencePoint: Frequency=, McuClockReferencePointFrequency=25E6
        PLLSettings72MHzOn25MHzOsc (PLLSettings): IDF=9, NDIV=8, ODF=0
      3 x McuModeSettingConf, all with McuMode=:
        NORMAL
        RUN
        SLEEP
    McuPublishedInformation
      McuResetReasonConf: McuResetReason=
  module config Can: implementation-config-variant=VARIANT-PRE-COMPILE, module-description=Can
    CanConfigSet
      CanController:
        CanBusoffProcessing = 
        CanControllerActivation = true
        CanControllerBaseAddress = 
        CanControllerId = 0
        CanRxProcessing = 
        CanTxProcessing = 
        CanWakeupFunctionalityAPI = false
        CanWakeupProcessing = 
        CanWakeupSupport = false
        ArcCanControllerLoopback = false
        CanControllerDefaultBaudrate = CanControllerBaudrateConfig
        CanCpuClockRef = (unset)
        CanControllerBaudrateConfig:
          CanControllerBaudRate = 500
          CanControllerBaudRateConfigID = 0
          CanControllerPropSeg = 8
          CanControllerSeg1 = 5
          CanControllerSeg2 = 4
          CanControllerSyncJumpWidth = 1
      CanHardwareObjectRx (CanHardwareObject): CanHandleType=BASIC, CanIdType=STANDARD, CanObjectId=, CanObjectType=RECEIVE, CanControllerRef=CanController
        CanHwFilter: CanHwFilterCode=0, CanHwFilterMask=0
      CanHardwareObjectTx (CanHardwareObject): CanHandleType=BASIC, CanIdType=STANDARD, CanObjectId=, CanObjectType=TRANSMIT, CanControllerRef=CanController
    CanGeneral:
      CanDevErrorDetection = true
      CanHardwareCancellation = false
      CanIdenticalIdCancellation = false
      CanIndex = 
      CanMainFunctionModePeriod = 
      CanMultiplexedTransmission = 
      CanTimeoutDuration = 
      CanVersionInfoApi = true
      CanCounterRef = (unset)
      CanSupportTTCANRef = (unset)
      CanMainFunctionRWPeriods
  module config CanIf: implementation-config-variant=VARIANT-PRE-COMPILE, module-description=CanIf
    CanIfCtrlDrvCfg: CanIfCtrlDrvTxCancellation=false, CanIfCtrlDrvInitHohConfigRef=CanIfInitHohCfg, CanIfCtrlDrvNameRef=(unset)
      CanIfCtrlCfg: CanIfCtrlId=, CanIfCtrlWakeupSupport=false, CanIfCtrlCanCtrlRef=CanController
    CanIfDispatchCfg:
      CanIfDispatchUserConfirmPnAvailabilityName = 
      CanIfDispatchUserConfirmPnAvailabilityUL = 
      CanIfDispatchUserCtrlBusOffUL = CAN_SM
      CanIfDispatchUserCtrlModeIndicationUL = CAN_SM
    CanIfInitCfg: CanIfInitCfgSet=
      CanIfInitHohCfg: CanIfInitRefCfgSet=(unset)
        CanIfHrhCfg: CanIfHrhSoftwareFilter=true, CanIfHrhCanCtrlIdRef=CanIfCtrlCfg, CanIfHrhIdSymRef=CanHardwareObjectRx
        CanIfHthCfg: CanIfHthCanCtrlIdRef=CanIfCtrlCfg, CanIfHthIdSymRef=CanHardwareObjectTx
      CanIfRxPduCfg:
        CanIfRxPduCanIdType = STANDARD_CAN
        CanIfRxPduDlc = 8
        CanIfRxPduId = 
        CanIfRxPduReadData = false
        CanIfRxPduReadNotifyStatus = false
        CanIfRxPduCanId = 1
        CanIfRxPduUserRxIndicationUL = PDUR
        CanIfRxPduBswSchExclAreaIdRef = (unset)
        CanIfRxPduHrhIdRef = CanIfHrhCfg
        CanIfRxPduRef = PduRx
      CanIfTxPduCfg:
        CanIfTxPduCanId = 2
        CanIfTxPduCanIdType = STANDARD_CAN
        CanIfTxPduDlc = 8
        CanIfTxPduId = 
        CanIfTxPduReadNotifyStatus = false
        CanIfTxPduType = STATIC
        CanIfTxPduUserTxConfirmationUL = PDUR
        CanIfTxPduBswSchExclAreaIdRef = (unset)
        CanIfTxPduBufferRef = CanIfBufferCfg
        CanIfTxPduRef = PduTx
      CanIfBufferCfg: CanIfBufferSize=0, CanIfBufferHthRef=CanIfHthCfg
    CanIfPrivateCfg: CanIfPrivateDlcCheck=true, CanIfPrivateSoftwareFilterType=LINEAR, CanIfSupportTTCAN=false
    CanIfPublicCfg:
      CanIfPublicCancelTransmitSupport = false
      CanIfPublicChangeBaudrateSupport = false
      CanIfPublicDevErrorDetect = true
      CanIfPublicHandleTypeEnum = 
      CanIfPublicMultipleDrvSupport = true
      CanIfPublicNumberOfCanHwUnits = 1
      CanIfPublicPnSupport = false
      CanIfPublicReadRxPduDataApi = false
      CanIfPublicReadRxPduNotifyStatusApi = false
      CanIfPublicReadTxPduNotifyStatusApi = false
      CanIfPublicSetDynamicTxIdApi = false
      CanIfPublicTxBuffering = false
      CanIfPublicTxConfirmPollingSupport = false
      CanIfPublicVersionInfoApi = false
      CanIfPublicWakeupCheckValidSupport = false
      ArcCanIfPublicTxBufferSize = 1
      ArcCanIfPublicMaxNumberOfTxBuffers = 1
      ArcCanIfOsekNmSupport = false
      ArcCanIfCanFDSupport = false
  module config Crc: implementation-config-variant=VARIANT-PRE-COMPILE, module-description=Crc
    CrcGeneral: Crc32P4Mode=CRC_32P4_RUNTIME
