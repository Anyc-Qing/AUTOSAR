AUTOSAR XML (schema 4-3-0)
package /BSWConfiguration
  ecuc value collection BSWConfiguration: ecu-extract=InteriorLightCANEcuExtract, ecuc-values=[BswM, Com, ComM, Det, EcuC, EthSM, Os, PduR, Rte, TcpIp, Dio, EcuM, IoHwAb, Mcu, Port, SoAd, EthIf]
  module config BswM: implementation-config-variant=VARIANT-PRE-COMPILE, module-description=BswM
    BswMConfig
      BswMArbitration: ArcBswMMaxRuleCount=20
        BswComMIndication (BswMModeRequestPort): BswMRequestProcessing=BSWM_DEFERRED
          BswMModeRequestSource
            BswMComMIndication: BswMComMChannelRef=ComMChannel
        EnablePduGroupsRule (BswMRule):
          BswMNestedExecutionOnly = false
          BswMRuleInitState = BSWM_FALSE
          BswMRuleExpressionRef = ComMFullCommuncationlExpression
          BswMRuleTrueActionList = EnablePdusActions
        ComMFullCommunicationCondition (BswMModeCondition): BswMConditionType=BSWM_EQUALS, BswMConditionMode=BswComMIndication
          BswMConditionValue
            BswMBswMode: BswMBswRequestedMode=COMM_FULL_COMMUNICATION
        ComMFullCommuncationlExpression (BswMLogicalExpression): BswMArgumentRef=ComMFullCommunicationCondition
        SwcStartCommunication (BswMModeRequestPort): BswMRequestProcessing=BSWM_DEFERRED
          BswMModeRequestSource
            BswMSwcModeRequest: BswMSwcModeRequestModeDeclarationGroupPrototypeRef=currentMode
        StartCommunicationCondition (BswMModeCondition): BswMConditionType=BSWM_EQUALS_NOT, BswMConditionMode=SwcStartCommunication
          BswMConditionValue
            BswMBswMode: BswMBswRequestedMode=COMM_NO_COMMUNICATION
        StartCommunicationRule (BswMRule):
          BswMNestedExecutionOnly = false
          BswMRuleInitState = BSWM_FALSE
          BswMRuleExpressionRef = StartCommunicationExpression
          BswMRuleTrueActionList = StartCommuncationActions
        StartCommunicationExpression (BswMLogicalExpression): BswMArgumentRef=StartCommunicationCondition
      BswMModeControl
        EnablePdusActions (BswMActionList): BswMActionListExecution=BSWM_TRIGGER
          BswMActionListItem: BswMAbortOnFail=false, BswMActionListItemIndex=0, BswMActionListItemRef=IPduStart
        IPduStart (BswMAction)
          BswMAvailableActions
            BswMPduGroupSwitch: BswMPduGroupSwitchReinit=false, BswMEnabledPduGroupRef=ComIPduGroupRx, BswMEnabledPduGroupRef=ComIPduGroupTx
        StartCommuncationActions (BswMActionList): BswMActionListExecution=BSWM_TRIGGER
          BswMActionListItem: BswMAbortOnFail=false, BswMActionListItemIndex=0, BswMActionListItemRef=RequestFullCom
        RequestFullCom (BswMAction)
          BswMAvailableActions
            BswMComMModeSwitch: BswMComMRequestedMode=BSWM_FULL_COM, BswMComMUserRef=ComMUser
    BswMGeneral: BswMDevErrorDetect=true, BswMVersionInfoApi=true, BswMComMEnabled=1, BswMEcuMEnabled=1, BswMCanSMEnabled=0, BswMEthSMEnabled=1, BswMSdEnabled=false
  module config Com: implementation-config-variant=VARIANT-PRE-COMPILE, module-description=Com
    ComConfig: ComConfigurationId=(unset)
      ComTimeBase: ComRxTimeBase=0.01, ComTxTimeBase=0.01
      IPDU_UDP6661_RX (ComIPdu):
        ComIPduDirection = RECEIVE
        ComIPduSignalProcessing = DEFERRED
        ComIPduTriggerTransmitCallout = NULL
        ComIPduType = 
        ComPduIdRef = PDU_UDP6661_RX
        ComIPduGroupRef = ComIPduGroupRx
        ComIPduSignalRef = ComSignal_RxUDP
      ComIPduGroupRx (ComIPduGroup): ComIPduGroupHandleId=(unset)
      IPDU_UDP6661_TX (ComIPdu):
        ComIPduDirection = SEND
        ComIPduSignalProcessing = IMMEDIATE
        ComIPduTriggerTransmitCallout = NULL
        ComIPduType = 
        ComPduIdRef = PDU_UDP6661_TX
        ComIPduGroupRef = ComIPduGroupTx
        ComIPduSignalRef = ComSignal_TxUDP
        ComTxIPdu: ComTxIPduUnusedAreasDefault=0
          ComTxModeTrue
            ComTxMode: ComTxModeMode=DIRECT
      ComSignal_TxUDP (ComSignal):
        ComBitPosition = 0
        ComHandleId = (unset)
        ComSignalEndianness = opaque
        ComSignalType = UINT32
        ComTransferProperty = TRIGGERED
        ComBitSize = 32
        ComSystemTemplateSystemSignalRef = TxMessageMapping
      ComSignal_RxUDP (ComSignal):
        ComBitPosition = 0
        ComHandleId = (unset)
        ComSignalEndianness = opaque
        ComSignalType = UINT32
        ComBitSize = 32
        ComSystemTemplateSystemSignalRef = RxMessageMapping
      ComIPduGroupTx (ComIPduGroup): ComIPduGroupHandleId=(unset)
    ComGeneral:
      ComSupportedIPduGroups = 4
      ComVersionInfoApi = 0
      ComSupportedIPdus = 20
      ComSupportedSignals = 40
      ComSupportedGroupSignals = 40
      ComRamBufferSize = 100
      ArcMaxNumberOfSupportedIPduCounters = 10
      ArcComSupportedGatewaySourceDescriptions = 0
      ArcComOsekNmSupport = false
  module config ComM: implementation-config-variant=VARIANT-PRE-COMPILE, module-description=ComM
    ComMConfigSet
      ComMChannel:
        ComMBusType = COMM_BUS_TYPE_ETH
        ComMChannelId = 
        ComMFullCommRequestNotificationEnabled = false
        ComMGlobalNvmBlockDescriptor = false
        ComMMainFunctionPeriod = 0.01
        ComMNoCom = false
        ComMNoWakeup = false
        ComMNetworkManagement: ComMNmVariant=NONE, ComMPncNmRequest=false
        ComMUserPerChannel: ComMUserChannel=ComMUser
      ComMUser: ComMUserIdentifier=
    ComMGeneral:
      ComMNoCom = false
      ComMEcuGroupClassification = 3
      ComMModeLimitationEnabled = false
      ComMPncSupport = false
      ComMSynchronousWakeUp = true
      ComMTMinFullComModeDuration = 5.0
      ComMVersionInfoApi = false
      ComMWakeupInhibitionEnabled = false
      ComMDevErrorDetect = true
      ArcComMASRCompatibilityLessThan4_2 = true
  module config Det: implementation-config-variant=VARIANT-PRE-COMPILE, module-description=Det
    DetGeneral:
      DetVersionInfoApi = 0
      DetUseRamlog = 1
      DetEnableCallbacks = 0
      DetWrapRamlog = 1
      DetUseStdErr = 0
      DetDeInitAPI = 0
      DetNumberOfCallbacks = 5
      DetRamlogSize = 16
      DetUseSafetyMonitor = false
  module config EcuC: implementation-config-variant=VARIANT-PRE-COMPILE, module-description=EcuC
    EcucPduCollection: PduIdTypeEnum=UINT16, PduLengthTypeEnum=UINT16
      11 x Pdu:
        Dcm_Rx: PduLength=8
        Dcm_Tx: PduLength=8
        PDU_UDP6661_RX: PduLength=4
        PDU_UDP6661_TX: PduLength=4
        Dcm_RxFunc: PduLength=8
        XCP_RX_PDU: PduLength=8
        XCP_TX_PDU: PduLength=8
        Dlt_Tx: PduLength=500
        Dlt_Rx: PduLength=500
        Test_Tx: PduLength=500
        Test_Rx: PduLength=500
  module config EthSM: implementation-config-variant=VARIANT-PRE-COMPILE, module-description=EthSM
    EthSMGeneral: EthSMDevErrorDetect=1, EthSMMainFunctionPeriod=0.01, EthSMDummyMode=1, EthSMVersionInfoApi=1
    EthSMNetwork: EthSMConfirmationTimeout=1, EthSMComMNetworkHandleRef=ComMChannel, EthSMEthIfControllerRef=EthIfController
  module config Os: implementation-config-variant=VARIANT-PRE-COMPILE, module-description=Os
    OsAppMode
    OsOS:
      OsScalabilityClass = SC1
      OsStackMonitoring = 1
      OsStatus = EXTENDED
      OsUseGetServiceId = 1
      OsUseParameterAccess = 1
      OsUseResScheduler = 1
      ArcOsTickFrequency = 1000
      ArcOsInterruptStackSize = 2048
      ArcOsIdleStackSize = 512
      ArcOsMaxIsr = 200
      ArcSafetyPlatform = false
      OsHooks: OsErrorHook=1, OsPostTaskHook=0, OsPreTaskHook=0, OsShutdownHook=1, OsStartupHook=1
      ArcOsDebug: OsTaskDebug=0, OsAlarmDebug=0, OsResourceDebug=0, OsScheduleTableDebug=0, OsEventDebug=0, OsDebugActivated=0
    OsApplication:
      OsTrusted = 1
      OsAppAlarmRef = OsAlarmLWIPMain
      OsAppCounterRef = OsCounter
      OsAppTaskRef = MainLWIPTask
      OsAppTaskRef = OsStartupTask
      OsAppTaskRef = tcpip_task
      OsAppAlarmRef = OsAlarmBswService
      OsAppTaskRef = OsBswServiceTask
      OsAppAlarmRef = OsAlarm100ms
      OsAppAlarmRef = OsAlarm1000ms
      OsAppTaskRef = OsRteTask
      OsAppAlarmRef = OsAlarm1msTimer
      OsApplicationHooks: OsAppErrorHook=0, OsAppShutdownHook=0, OsAppStartupHook=0
    OsCounter: OsCounterMaxAllowedValue=255, OsCounterMinCycle=1, OsCounterTicksPerBase=(unset), OsCounterType=OS_TICK, OsCounterAccessingApplication=OsApplication
    OsAlarmLWIPMain (OsAlarm): OsAlarmCounterRef=OsCounter, OsAlarmAccessingApplication=OsApplication
      OsAlarmAction
        OsAlarmSetEvent: OsAlarmSetEventRef=LWIP_MAIN, OsAlarmSetEventTaskRef=MainLWIPTask
    MainLWIPTask (OsTask): OsTaskActivation=1, OsTaskPriority=3, OsTaskSchedule=FULL, ArcOsTaskStackSize=2048, OsTaskAccessingApplication=OsApplication, OsTaskEventRef=LWIP_MAIN
      OsTaskAutostart: OsTaskAppModeRef=(unset)
    OsStartupTask (OsTask):
      OsTaskActivation = 1
      OsTaskPriority = 4
      OsTaskSchedule = FULL
      ArcOsTaskStackSize = 1024
      OsTaskAccessingApplication = OsApplication
      OsTaskEventRef = OsEvent1
      OsTaskEventRef = OsEvent{10..19}
      OsTaskEventRef = OsEvent2
      OsTaskEventRef = OsEvent{20..25}
      OsTaskEventRef = OsEvent{3..9}
      OsTaskAutostart: OsTaskAppModeRef=(unset)
    26 x OsEvent:
      OsEvent1
      OsEvent25
      OsEvent24
      OsEvent23
      OsEvent22
      OsEvent21
      OsEvent20
      OsEvent19
      OsEvent18
      OsEvent17
      OsEvent16
      OsEvent15
      OsEvent14
      OsEvent13
      OsEvent12
      OsEvent11
      OsEvent10
      OsEvent9
      OsEvent8
      OsEvent7
      OsEvent6
      OsEvent5
      OsEvent4
      OsEvent3
      OsEvent2
      START_TCPIP
    tcpip_task (OsTask):
      OsTaskActivation = 1
      OsTaskPriority = 4
      OsTaskSchedule = FULL
      ArcOsTaskStackSize = 3072
      OsTaskEventRef = OsEvent1
      OsTaskEventRef = OsEvent{10..19}
      OsTaskEventRef = OsEvent2
      OsTaskEventRef = OsEvent{20..25}
      OsTaskEventRef = OsEvent{3..9}
      OsTaskEventRef = START_TCPIP
      OsTaskAutostart: OsTaskAppModeRef=(unset)
    LWIP_MAIN (OsEvent)
    OsBswServiceTask (OsTask): OsTaskActivation=1, OsTaskPriority=5, OsTaskSchedule=FULL, ArcOsTaskStackSize=2048, OsTaskAccessingApplication=OsApplication
      OsTaskAutostart: OsTaskAppModeRef=(unset)
    OsAlarmBswService (OsAlarm): OsAlarmCounterRef=OsCounter, OsAlarmAccessingApplication=OsApplication
      OsAlarmAction
        OsAlarmActivateTask: OsAlarmActivateTaskRef=OsBswServiceTask
      OsAlarmAutostart: OsAlarmAlarmTime=5, OsAlarmAutostartType=RELATIVE, OsAlarmCycleTime=5, OsAlarmAppModeRef=(unset)
    OsAlarm100ms (OsAlarm): OsAlarmCounterRef=OsCounter, OsAlarmAccessingApplication=OsApplication
      OsAlarmAction
        OsAlarmSetEvent: OsAlarmSetEventRef=OsRteEvent1, OsAlarmSetEventTaskRef=OsRteTask
      OsAlarmAutostart: OsAlarmAlarmTime=100, OsAlarmAutostartType=RELATIVE, OsAlarmCycleTime=100, OsAlarmAppModeRef=(unset)
    3 x OsEvent:
      OsRteEvent1
      OsRteEvent2
      ModeSwitchOsEvent
    OsRteTask (OsTask):
      OsTaskActivation = 1
      OsTaskPriority = 2
      OsTaskSchedule = FULL
      ArcOsTaskStackSize = 2048
      OsTaskAccessingApplication = OsApplication
      OsTaskEventRef = OsRteEvent1
      OsTaskEventRef = OsRteEvent2
      OsTaskEventRef = ModeSwitchOsEvent
      OsTaskAutostart: OsTaskAppModeRef=(unset)
    OsAlarm1000ms (OsAlarm): OsAlarmCounterRef=OsCounter, OsAlarmAccessingApplication=OsApplication
      OsAlarmAction
        OsAlarmSetEvent: OsAlarmSetEventRef=OsRteEvent2, OsAlarmSetEventTaskRef=OsRteTask
      OsAlarmAutostart: OsAlarmAlarmTime=1000, OsAlarmAutostartType=RELATIVE, OsAlarmCycleTime=1000, OsAlarmAppModeRef=(unset)
    OsAlarm1msTimer (OsAlarm): OsAlarmCounterRef=OsCounter, OsAlarmAccessingApplication=OsApplication
      OsAlarmAction
        OsAlarmSetEvent: OsAlarmSetEventRef=OsEvent1, OsAlarmSetEventTaskRef=tcpip_task
  module config PduR: implementation-config-variant=VARIANT-PRE-COMPILE, module-description=PduR
    PduRGeneral: PduRDevErrorDetect=1, PduRVersionInfoApi=0, PduRZeroCostOperation=0
    PduRRoutingTables: PduRConfigurationId=0, ArcPduRMaxRouteCount=30
      PduRRoutingTable: PduRIsMinimumRouting=0
        PduRRoutingPath1 (PduRRoutingPath)
          PduRDestPdu: ArcOverridenDestModule=Com, PduRDestPduRef=PDU_UDP6661_RX
          PduRSrcPdu: PduRSourcePduHandleId=(unset), ArcOverridenSrcModule=SoAdIf, PduRSrcPduRef=PDU_UDP6661_RX
        PduRRoutingPath2 (PduRRoutingPath)
          PduRDestPdu: ArcOverridenDestModule=SoAdIf, PduRDestPduDataProvision=PDUR_DIRECT, PduRDestPduRef=PDU_UDP6661_TX
          PduRSrcPdu: PduRSourcePduHandleId=(unset), ArcOverridenSrcModule=Com, PduRSrcPduRef=PDU_UDP6661_TX
    Com (PduRBswModules):
      PduRCancelReceive = 0
      PduRCancelTransmit = (unset)
      PduRChangeParameterRequestApi = (unset)
      PduRCommunicationInterface = (unset)
      PduRLowerModule = 1
      PduRRetransmission = (unset)
      PduRTransportProtocol = (unset)
      PduRTriggertransmit = (unset)
      PduRTxConfirmation = (unset)
      PduRUpperModule = 1
      PduRUseTag = (unset)
      PduRBswModuleRef = (unset)
    SoAdIf (PduRBswModules):
      PduRCancelReceive = 0
      PduRCancelTransmit = (unset)
      PduRChangeParameterRequestApi = (unset)
      PduRCommunicationInterface = (unset)
      PduRLowerModule = 1
      PduRRetransmission = (unset)
      PduRTransportProtocol = (unset)
      PduRTriggertransmit = (unset)
      PduRTxConfirmation = (unset)
      PduRUpperModule = 0
      PduRUseTag = (unset)
      PduRBswModuleRef = (unset)
  module config Rte: implementation-config-variant=VARIANT-PRE-COMPILE, module-description=Rte
    RteBswGeneral: RteSchMVersionInfoApi=(unset), RteUseComShadowSignalApi=0
    RteGeneration:
      RteCalibrationSupport = NONE
      RteCodeVendorId = (unset)
      RteDevErrorDetect = 0
      RteDevErrorDetectUninit = 0
      RteGenerationMode = COMPATIBILITY_MODE
      RteIocInteractionReturnValue = RTE_IOC
      RteMeasurementSupport = 0
      RteOptimizationMode = RUNTIME
      RteValueRangeCheckEnabled = 0
      RteVfbTraceEnabled = 0
    RteInitializationBehavior: RteInitializationStrategy=, RteSectionInitializationPolicy=
    RteOsInteraction
    RtePostBuildVariantConfiguration: RtePostBuildUsedPredefinedVariant=(unset)
    9 x RteSwComponentInstance:
      bswM: RteSoftwareComponentInstanceRef=bswM
      ecuM: RteSoftwareComponentInstanceRef=ecuM
      frontLightActuator: RteSoftwareComponentInstanceRef=frontLightActuator
        lightActuatorMainEvent_OsRteTask (RteEventToTaskMapping): RteImmediateRestart=false, RteEventRef=lightActuatorMainEvent, RteMappedToTaskRef=OsRteTask, RteUsedOsEventRef=OsRteEvent1
      ioHwAb: RteSoftwareComponentInstanceRef=ioHwAb
      leftDoorSensor: RteSoftwareComponentInstanceRef=leftDoorSensor
        doorSensorMainEvent_OsRteTask (RteEventToTaskMapping): RteImmediateRestart=false, RteEventRef=doorSensorMainEvent, RteMappedToTaskRef=OsRteTask, RteUsedOsEventRef=OsRteEvent1
      lightManager: RteSoftwareComponentInstanceRef=lightManager
        interiorLightManagerMainEvent_OsRteTask (RteEventToTaskMapping): RteImmediateRestart=false, RteEventRef=interiorLightManagerMainEvent, RteMappedToTaskRef=OsRteTask, RteUsedOsEventRef=OsRteEvent1
      modeManager: RteSoftwareComponentInstanceRef=modeManager
        modeManagerInitEvent_OsRteTask (RteEventToTaskMapping): RteImmediateRestart=false, RteEventRef=modeManagerInitEvent, RteMappedToTaskRef=OsRteTask, RteUsedOsEventRef=OsRteEvent1
      rightDoorSensor: RteSoftwareComponentInstanceRef=rightDoorSensor
        doorSensorMainEvent_OsRteTask (RteEventToTaskMapping): RteImmediateRestart=false, RteEventRef=doorSensorMainEvent, RteMappedToTaskRef=OsRteTask, RteUsedOsEventRef=OsRteEvent1
      comM: RteSoftwareComponentInstanceRef=comM
  module config TcpIp: implementation-config-variant=VARIANT-PRE-COMPILE, module-description=TcpIp
    TcpIpConfig
      TcpIpCtrl: TcpIpEthIfCtrlRef=EthIfController
        TcpIpIpVXCtrl
          TcpIpIpV4Ctrl:
            TcpIpDhcpConfigRef = (unset)
            TcpIpArpConfigRef = TcpIpArpConfig1
            TcpIpAutoIpConfigRef = (unset)
            TcpIpFragmentationConfigRef = TcpIpIpFragmentationConfig
        TcpIpCtrlDemEventParameterRefs
      TcpIpLocalAddr: TcpIpAddrId=1, TcpIpAddressType=TCPIP_UNICAST, TcpIpDomainType=TCPIP_AF_INET, TcpIpCtrlRef=TcpIpCtrl
        TcpIpStaticIpAddressConfig: TcpIpStaticIpAddress=192.168.0.10, TcpIpDefaultRouter=192.168.0.1, TcpIpNetmask=24
        TcpIpAddrAssignment: TcpIpAssignmentMethod=TCPIP_STATIC, TcpIpAssignmentPriority=1, TcpIpAssignmentTrigger=TCPIP_AUTOMATIC
      TcpIpSocketOwnerConfig
        SoAd (TcpIpSocketOwner): TcpIpSocketOwnerUpperLayerType=SOAD
      TcpIpIpConfig
        TcpIpIpV4Config
          TcpIpArpConfig1 (TcpIpArpConfig): TcpIpArpNumGratuitousARPonStartup=, TcpIpArpPacketQueueEnabled=false, TcpIpArpTableEntryTimeout=, TcpIpArpTableSizeMax=10
          TcpIpArpConfig2 (TcpIpArpConfig): TcpIpArpNumGratuitousARPonStartup=, TcpIpArpPacketQueueEnabled=false, TcpIpArpTableEntryTimeout=, TcpIpArpTableSizeMax=5
          TcpIpIpFragmentationConfig: TcpIpIpFragmentationRxEnabled=true, ArcTcpIpIpMaxNofBufs=10, ArcTcpIpIpMaxReceiveBufferSize=1500, TcpIpIpReassTimeout=60
      TcpIpLocalAddrMult (TcpIpLocalAddr): TcpIpAddrId=2, TcpIpAddressType=TCPIP_MULTICAST, TcpIpDomainType=TCPIP_AF_INET, TcpIpCtrlRef=TcpIpCtrl
        TcpIpAddrAssignment: TcpIpAssignmentMethod=TCPIP_STATIC, TcpIpAssignmentPriority=3, TcpIpAssignmentTrigger=TCPIP_MANUAL
      TcpIpLocalAddrMultAuto (TcpIpLocalAddr): TcpIpAddrId=3, TcpIpAddressType=TCPIP_MULTICAST, TcpIpDomainType=TCPIP_AF_INET, TcpIpCtrlRef=TcpIpCtrl
        TcpIpAddrAssignment: TcpIpAssignmentMethod=TCPIP_STATIC, TcpIpAssignmentPriority=2, TcpIpAssignmentTrigger=TCPIP_AUTOMATIC
        TcpIpStaticIpAddressConfig: TcpIpStaticIpAddress=225.0.0.1
    TcpIpGeneral:
      TcpIpBufferMemory = 5200
      TcpIpDevErrorDetect = 1
      TcpIpDhcpServerEnabled = 
      TcpIpMainFunctionPeriod = 0.005
      TcpIpResetIpAssignmentApi = 1
      TcpIpScalabilityClass = SC1
      TcpIpTcpEnabled = 1
      TcpIpTcpSocketMax = 3
      TcpIpUdpEnabled = 1
      TcpIpUdpSocketMax = 3
      TcpIpVersionInfoApi = 1
      TcpIpIpV4General:
        TcpIpArpEnabled = 1
        TcpIpAutoIpEnabled = 0
        TcpIpDhcpClientEnabled = 0
        TcpIpIcmpEnabled = 1
        TcpIpIpV4Enabled = 1
        TcpIpLocalAddrIpv4EntriesMax = 10
        TcpIpPathMtuDiscoveryEnabled = 1
      TcpIpIpV6General:
        TcpIpDhcpV6ClientEnabled = 
        TcpIpIpV6Enabled = 
        TcpIpIpV6PathMtuDiscoveryEnabled = 
        TcpIpLocalAddrIpv6EntriesMax = 
        TcpIpNdpAddressResolutionUnrechabilityDetectionEnabled = 
        TcpIpNdpPrefixAndRouterDiscoveryEnabled = 
    ArcLwIpConfig:
      LwIpMempNumNetConn = 6
      LwIpPoolSize = 10
      LwIpMemSize = 20000
      LwIpMempNumPBuf = 10
      LwIpEthernetMacAddress = 00-00-00-00-00-02
      LwIpTrcvAddress = 0
      LwIpMaxMTU = 1500
      LwIpMaxMRU = 1500
      LwIpTcpWnd = 7480
      LwIpStats = 1
  module config Dio: implementation-config-variant=VARIANT-PRE-COMPILE, module-description=Dio
    DioConfig
      D (DioPort): DioPortId=3
        4 x DioChannel:
          LED1: DioChannelId=55
          LED2: DioChannelId=61
          LED3: DioChannelId=51
          LED4: DioChannelId=52
      E (DioPort): DioPortId=4
        D8 (DioChannel): DioChannelId=77
        D7 (DioChannel): DioChannelId=76
    DioGeneral: DioDevErrorDetect=1, DioFlipChannelApi=0, DioVersionInfoApi=1
  module config EcuM: implementation-config-variant=VARIANT-PRE-COMPILE, module-description=EcuM
    EcuMConfiguration
      EcuMCommonConfiguration: EcuMConfigConsistencyHash=(unset), EcuMDefaultAppMode=(unset), EcuMOSResource=(unset)
        EcuMDefaultShutdownTarget: EcuMDefaultState=EcuMStateOff
        EcuMSleepMode: EcuMSleepModeId=(unset), EcuMSleepModeSuspend=(unset), EcuMSleepModeMcuModeRef=SLEEP, EcuMWakeupSourceMask=EcuMWakeupSource
        EcuMWakeupSource: EcuMWakeupSourceId=(unset), EcuMWakeupSourcePolling=0, EcuMResetReasonRef=(unset)
      EcuMFixedConfiguration:
        EcuMNvramReadallTimeout = 10.0
        EcuMNvramWriteallTimeout = 10.0
        EcuMRunMinimumDuration = 10.0
        EcuMNormalMcuModeRef = RUN
        EcuMComMCommunicationAllowedList = ComMChannel
        EthernetUser (EcuMFixedUserConfig): EcuMFixedUser=(unset)
    EcuMGeneral: EcuMDevErrorDetect=0, EcuMIncludeDem=0, EcuMIncludeDet=0, EcuMMainFunctionPeriod=0.01, EcuMVersionInfoApi=0
  module config IoHwAb: implementation-config-variant=VARIANT-PRE-COMPILE, module-description=IoHwAb
    ArcIoHwAbGeneral: ArcIoHwAbDevErrorDetect=1, ArcIoHwAbAnalogMaxVoltage=5.0, ArcIoHwAbUsePort=1, ArcIoHwCalibrationEnabled=0
    3 x ArcIoHwAbDigitalSignal, all with ArcIoHwAbDigitalDefaultValue=IOHWAB_LOW, ArcIoHwAbDigitalInverted=false, ArcIoHwAbDigitalType=IOHWAB_DIO:
      FrontDoorLeft: ArcIoHwAbDigitalMethod=IOHWAB_DIGITAL_READ, ArcIoHwAbDioChannelRef=D8
      FrontDoorRight: ArcIoHwAbDigitalMethod=IOHWAB_DIGITAL_READ, ArcIoHwAbDioChannelRef=D7
      FrontLight: ArcIoHwAbDigitalMethod=IOHWAB_DIGITAL_WRITE, ArcIoHwAbDioChannelRef=LED1
  module config Mcu: implementation-config-variant=VARIANT-PRE-COMPILE, module-description=Mcu
    McuGeneralConfiguration: McuDevErrorDetect=1, McuGetRamStateApi=0, McuInitClock=1, McuNoPll=0, McuPerformResetApi=0, McuVersionInfoApi=0
    McuModuleConfiguration: McuClockSrcFailureNotification=DISABLED, McuNumberOfMcuModes=(unset), McuRamSectors=(unset), ArcDefaultClockRef=McuClockSettingConfig
      McuClockSettingConfig:
        McuClockSettingId = 0
        ArcAPB2ClocksEnable = GPIOD
        ArcAPB2ClocksEnable = AFIO
        ArcAPB2ClocksEnable = GPIOB
        ArcAPB2ClocksEnable = GPIOA
        ArcAPB2ClocksEnable = GPIOC
        ArcAPB2ClocksEnable = GPIOE
        ArcAHBClocksEnable = ETH_MAC
        ArcAHBClocksEnable = ETH_MAC_Tx
        ArcAHBClocksEnable = ETH_MAC_Rx
        ArcAHBClocksEnable = DMA1
        ArcAPB1ClocksEnable = TIM2
        ArcAPB2ClocksEnable = ADC1
        ArcAPB1ClocksEnable = CAN1
        ArcAPB1ClocksEnable = CAN2
        PLLSettings72MHzOn25MHzOsc (PLLSettings): IDF=9, NDIV=8, ODF=0
        McuClockReferencePoint: Frequency=, McuClockReferencePointFrequency=25E6
      3 x McuModeSettingConf, all with McuMode=(unset):
        RUN
        SLEEP
        NORMAL
    McuPublishedInformation
      McuResetReasonConf: McuResetReason=0
  module config Port: implementation-config-variant=VARIANT-PRE-COMPILE, module-description=Port
    PortConfigSet: ArcPortPinRemap=GPIO_Remap_TIM4, ArcPortPinRemap=GPIO_Remap2_CAN1, ArcPortPinRemap=GPIO_Remap_ETH, ArcPortPinRemap=GPIO_Remap_CAN2
      5 x PortContainer:
        ADC: PortNumberOfPortPins=(unset)
          4 x PortPin, all with PortPinDirection=PORT_PIN_IN, PortPinDirectionChangeable=(unset), PortPinInitialMode=PORT_PIN_MODE_ADC, PortPinLevelValue=PORT_PIN_LEVEL_LOW, PortPinModeChangeable=(unset), ArcPortPinGpioMode=GPIO_ANALOG_INPUT_CNF, ArcPortPinSlewRate=PORT_PIN_SLEW_RATE_MIN, PortPinMode=:
            PortPin_A7: PortPinId=7
            PortPin_C4: PortPinId=36
            PortPin_B1: PortPinId=17
            PortPin_B0: PortPinId=16
        CAN: PortNumberOfPortPins=(unset)
          4 x PortPin, all with PortPinDirectionChangeable=(unset), PortPinInitialMode=PORT_PIN_MODE_CAN, PortPinLevelValue=PORT_PIN_LEVEL_LOW, PortPinModeChangeable=(unset), PortPinMode=:
            PortPin_D1: PortPinDirection=PORT_PIN_OUT, PortPinId=49, ArcPortPinGpioMode=GPIO_ALT_PUSHPULL_CNF, ArcPortPinSlewRate=PORT_PIN_SLEW_RATE_MED
            PortPin_D0: PortPinDirection=PORT_PIN_IN, PortPinId=48, ArcPortPinGpioMode=GPIO_INPUT_PULLUP_CNF, ArcPortPinSlewRate=PORT_PIN_SLEW_RATE_MIN
            PortPin_B5: PortPinDirection=PORT_PIN_IN, PortPinId=21, ArcPortPinGpioMode=GPIO_INPUT_PULLUP_CNF, ArcPortPinSlewRate=PORT_PIN_SLEW_RATE_MIN
            PortPin_B6: PortPinDirection=PORT_PIN_OUT, PortPinId=22, ArcPortPinGpioMode=GPIO_ALT_PUSHPULL_CNF, ArcPortPinSlewRate=PORT_PIN_SLEW_RATE_MED
        LED: PortNumberOfPortPins=(unset)
          4 x PortPin, all with PortPinDirection=PORT_PIN_OUT, PortPinDirectionChangeable=(unset), PortPinInitialMode=PORT_PIN_MODE_DIO, PortPinLevelValue=PORT_PIN_LEVEL_LOW, PortPinMode=, PortPinModeChangeable=(unset), ArcPortPinGpioMode=GPIO_OUTPUT_PUSHPULL_CNF, ArcPortPinSlewRate=PORT_PIN_SLEW_RATE_MED:
            PortPin_D3: PortPinId=51
            PortPin_D4: PortPinId=52
            PortPin_D13: PortPinId=61
            PortPin_D7: PortPinId=55
        ETH: PortNumberOfPortPins=(unset)
          7 x PortPin, all with PortPinDirection=PORT_PIN_OUT, PortPinDirectionChangeable=(unset), PortPinInitialMode=, PortPinLevelValue=PORT_PIN_LEVEL_LOW, PortPinMode=, PortPinModeChangeable=(unset), ArcPortPinGpioMode=GPIO_ALT_PUSHPULL_CNF, ArcPortPinSlewRate=PORT_PIN_SLEW_RATE_MAX:
            PortPin_A2: PortPinId=2
            PortPin_A8: PortPinId=8
            PortPin_B8: PortPinId=24
            PortPin_B13: PortPinId=29
            PortPin_B12: PortPinId=28
            PortPin_B11: PortPinId=27
            PortPin_C1: PortPinId=33
        SWITCH: PortNumberOfPortPins=
          PE12 (PortPin):
            PortPinDirection = PORT_PIN_IN
            PortPinDirectionChangeable = 
            PortPinId = 76
            PortPinInitialMode = 
            PortPinLevelValue = PORT_PIN_LEVEL_LOW
            PortPinMode = 
            PortPinModeChangeable = 
            ArcPortPinGpioMode = GPIO_INPUT_PULLUP_CNF
            ArcPortPinSlewRate = PORT_PIN_SLEW_RATE_MED
          PE13 (PortPin):
            PortPinDirection = PORT_PIN_IN
            PortPinDirectionChangeable = 
            PortPinId = 77
            PortPinInitialMode = 
            PortPinLevelValue = PORT_PIN_LEVEL_LOW
            PortPinMode = 
            PortPinModeChangeable = 
            ArcPortPinGpioMode = GPIO_INPUT_PULLUP_CNF
            ArcPortPinSlewRate = PORT_PIN_SLEW_RATE_MED
    PortGeneral: PortDevErrorDetect=1, PortSetPinDirectionApi=1, PortSetPinModeApi=0, PortVersionInfoApi=1
  module config SoAd: implementation-config-variant=VARIANT-PRE-COMPILE, module-description=SoAd
    SoAdConfig
      SoAdSocketConnectionGroupUDPCom (SoAdSocketConnectionGroup):
        SoAdPduHeaderEnable = 0
        SoAdResourceManagementEnable = 0
        SoAdSocketAutomaticSoConSetup = true
        SoAdSocketIpAddrAssignmentChgNotification = false
        SoAdSocketLocalPort = 1234
        SoAdSocketMsgAcceptanceFilterEnabled = true
        SoAdSocketSoConModeChgNotification = false
        SoAdSocketLocalAddressRef = TcpIpLocalAddr
        SoAdSocketConnectionUdpCom (SoAdSocketConnection): SoAdSocketId=
          SoAdSocketRemoteAddress: SoAdSocketRemoteIpAddress=192.168.0.5, SoAdSocketRemotePort=6666
        SoAdSocketProtocol
          SoAdSocketUdp: SoAdSocketUdpListenOnly=false, SoAdSocketUdpStrictHeaderLenCheckEnabled=false
      SoAdPduRouteTxUDP6661 (SoAdPduRoute): SoAdTxPduId=, SoAdTxUpperLayerType=IF, SoAdTxPduRef=PDU_UDP6661_TX
        SoAdPduRouteDest: SoAdTxSocketConnOrSocketConnBundleRef=SoAdSocketConnectionUdpCom, SoAdTxRoutingGroupRef=AlwaysEnable
      SoAdSocketRouteRxUdp6661 (SoAdSocketRoute): SoAdRxSocketConnOrSocketConnBundleRef=SoAdSocketConnectionUdpCom
        SoAdSocketRouteDest: SoAdRxUpperLayerType=IF, SoAdRxPduRef=PDU_UDP6661_RX
      AlwaysEnable (SoAdRoutingGroup): SoAdRoutingGroupId=, SoAdRoutingGroupIsEnabledAtInit=1, SoAdRoutingGroupTxTriggerable=false
    SoAdGeneral: SoAdDevErrorDetect=1, SoAdIPv6AddressEnabled=0, SoAdMainFunctionPeriod=0.004, SoAdRoutingGroupMax=10, SoAdSoConMax=10, SoAdVersionInfoApi=1
    SoAdBswModulesPduR (SoAdBswModules):
      SoAdIf = 1
      SoAdIfTriggerTransmit = false
      SoAdIfTxConfirmation = 1
      SoAdLocalIpAddrAssigmentChg = 0
      SoAdSoConModeChg = 0
      SoAdTp = 0
      SoAdUseCallerInfix = true
      SoAdUseTypeInfix = true
      SoAdBswModuleRef = PduR
  module config EthIf: implementation-config-variant=VARIANT-PRE-COMPILE, module-description=EthIf
    EthIfConfigSet
      EthIfController: EthIfCtrlIdx=, EthIfCtrlMtu=1500, EthIfMaxTxBufsTotal=2, EthIfEthCtrlRef=EthCtrlConfig
      EthIfFrameOwnerConfig1 (EthIfFrameOwnerConfig): EthIfFrameType=2048, EthIfOwner=, ArcEthIfRxIndication=EthIfRxIndicationConfig1
      EthIfRxIndicationConfig1 (EthIfRxIndicationConfig): EthIfRxIndicationFunction=TcpIp_RxIndication
      EthIfTrcvLinkStateChgConfig: EthIfTrcvLinkStateChgFunction=
      EthIfRxIndicationConfig2 (EthIfRxIndicationConfig): EthIfRxIndicationFunction=TcpIp_RxIndication
      EthIfFrameOwnerConfig2 (EthIfFrameOwnerConfig): EthIfFrameType=2054, EthIfOwner=, ArcEthIfRxIndication=EthIfRxIndicationConfig2
    EthIfGeneral:
      EthIfDevErrorDetect = 1
      EthIfEnableRxInterrupt = 1
      EthIfEnableTxInterrupt = 1
      EthIfGetBaudRate = 0
      EthIfGetCounterState = 0
      EthIfGlobalTimeSupport = 0
      EthIfMainFunctionPeriod = 0.01
      EthIfMaxTrcvsTotal = 1
      EthIfStartAutoNegotiation = 0
      EthIfTrcvLinkStateChgMainReload = 2
      EthIfVersionInfoApi = 1
      EthIfVersionInfoApiMacro = 1
      EthIfWakeUpSupport = false
      EthIfRxIndicationIterations = 1
      ArcEthIfMaxFrameOwnerConfig = 5
